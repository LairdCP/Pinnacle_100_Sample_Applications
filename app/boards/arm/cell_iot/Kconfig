## app/boards/arm/cell_iot/Kconfig
```kconfig
# Kconfig - nRF52840 PCA10056 board configuration
#
# Copyright (c) 2016 Nordic Semiconductor ASA
#
# SPDX-License-Identifier: Apache-2.0

if BOARD_CELL_IOT

config GPIO_AS_PINRESET
	bool "GPIO as pin reset (reset button)"
	default y

endif # BOARD_CELL_IOT
```

## app/boards/arm/cell_iot/Kconfig.board
```kconfig
# Kconfig - nRF52840 PCA10056 board configuration
#
# Copyright (c) 2016 Nordic Semiconductor ASA
#
# SPDX-License-Identifier: Apache-2.0

config  BOARD_CELL_IOT
	bool "Cell IOT"
	depends on SOC_NRF52840_QIAA
```

## app/boards/arm/newcastle/Kconfig
```kconfig
# Kconfig - nRF52840 PCA10056 board configuration
#
# Copyright (c) 2016 Nordic Semiconductor ASA
#
# SPDX-License-Identifier: Apache-2.0

if BOARD_NEWCASTLE

config BOARD_HAS_DCDC
	bool "Board has DCDC circuitry"
	select SOC_DCDC_NRF52X
	default y

config GPIO_AS_PINRESET
	bool "GPIO as pin reset (reset button)"
	default y

endif # BOARD_NEWCASTLE
```

## app/boards/arm/newcastle/Kconfig.board
```kconfig
# Kconfig - nRF52840 PCA10056 board configuration
#
# Copyright (c) 2016 Nordic Semiconductor ASA
#
# SPDX-License-Identifier: Apache-2.0

config  BOARD_NEWCASTLE
	bool "Newcastle"
	depends on SOC_NRF52840_QIAA
```

## app/boards/arm/newcastle/Kconfig.defconfig
```kconfig
# Kconfig - nRF52 PCA10040 board configuration
#
# Copyright (c) 2016 Nordic Semiconductor ASA
#
# SPDX-License-Identifier: Apache-2.0

if BOARD_NEWCASTLE

config BOARD
	default "newcastle"

if GPIO_NRF5

config GPIO_NRF5_P0
	default y

endif # GPIO_NRF5

if UART_NRFX

config UART_0_NRF_TX_PIN
	default 3

config UART_0_NRF_RX_PIN
	default 4

config UART_0_NRF_RTS_PIN
	default 28

config UART_0_NRF_CTS_PIN
	default 29

#config UART_0_NRF5_FLOW_CONTROL
#    default y

endif # UART_NRFX

if USB

config USB_NRF52840
	def_bool y

config USB_DEVICE_STACK
	def_bool y

endif # USB

if SPI

if SPI_0

config SPI_0_NAME
	default "SPI_0"

config SPI_0_OP_MODES
	default 1

config SPI_0_IRQ_PRI
	default 50

config SPI_0_NRF_SCK_PIN
	default 19

config SPI_0_NRF_MOSI_PIN
	default 20

config SPI_0_NRF_MISO_PIN
	default 21

endif # SPI_0

endif # SPI

if FLASH

config FLASH_HAS_DRIVER_ENABLED
	def_bool y

config FLASH_HAS_PAGE_LAYOUT
	def_bool y

config SOC_FLASH_NRF
	def_bool y

config SOC_FLASH_NRF_RADIO_SYNC
	def_bool y

config SPI_FLASH_W25QXXDV
	def_bool y

config SPI_FLASH_W25QXXDV_SPI_NAME
	default "SPI_0"

config SPI_FLASH_W25QXXDV_DRV_NAME
	default "W25QXXDV"

config SPI_FLASH_W25QXXDV_INIT_PRIORITY
	default 80

config SPI_FLASH_W25QXXDV_SPI_FREQ_0
	default 8000000

config SPI_FLASH_W25QXXDV_SPI_SLAVE
	default 1

config SPI_FLASH_W25QXXDV_GPIO_SPI_CS
	def_bool y

config SPI_FLASH_W25QXXDV_GPIO_SPI_CS_DRV_NAME
	default "GPIO_0"

config SPI_FLASH_W25QXXDV_GPIO_SPI_CS_PIN
	default 17

config SPI_FLASH_W25QXXDV_GPIO_CS_WAIT_DELAY
	default 50

config SPI_FLASH_W25QXXDV_FLASH_SIZE
	default 67108864

config SPI_FLASH_W25QXXDV_DEVICE_ID
	default 0x00c22817

endif # FLASH


endif # BOARD_NEWCASTLE
```

## app/boards/arm/newcastle/newcastle_defconfig
```kconfig
CONFIG_ARM=y
CONFIG_SOC_FAMILY_NRF=y
CONFIG_SOC_SERIES_NRF52X=y
CONFIG_SOC_NRF52840_QIAA=y
CONFIG_BOARD_NEWCASTLE=y

# Enable MPU
CONFIG_ARM_MPU_NRF52X=y

# enable uart driver
CONFIG_SERIAL=y
CONFIG_UART_NRFX=y
CONFIG_UART_0_NRF_UART=y

# enable console
CONFIG_CONSOLE=y
CONFIG_UART_CONSOLE=n
CONFIG_HAS_SEGGER_RTT=y
CONFIG_RTT_CONSOLE=y

# additional board options
CONFIG_GPIO_AS_PINRESET=y

# bluetooth
CONFIG_BT=y
CONFIG_BT_CTLR=y

# spi
CONFIG_SPI=y
CONFIG_SPI_0=y
CONFIG_SPI_NRFX=y
CONFIG_NRFX_SPI=y
CONFIG_SPI_0_NRF_SPI=y

# flash
CONFIG_FLASH=y
```

## boards/arm/newcastle/Kconfig.defconfig
```kconfig
# Kconfig - nRF52 PCA10056 board configuration
#
# Copyright (c) 2016 Nordic Semiconductor ASA
#
# SPDX-License-Identifier: Apache-2.0

if BOARD_NEWCASTLE

config BOARD
	default "newcastle"

if USB

config USB_NRF52840
	def_bool y

config USB_DEVICE_STACK
	def_bool y

endif # USB

if FLASH

config FLASH_HAS_DRIVER_ENABLED
	def_bool y

config FLASH_HAS_PAGE_LAYOUT
	def_bool y

config SOC_FLASH_NRF
	def_bool y

config SOC_FLASH_NRF_RADIO_SYNC
	def_bool y

config SPI_FLASH_W25QXXDV
	def_bool y

config SPI_FLASH_W25QXXDV_SPI_NAME
	default "SPI_0"

config SPI_FLASH_W25QXXDV_DRV_NAME
	default "W25QXXDV"

config SPI_FLASH_W25QXXDV_INIT_PRIORITY
	default 80

config SPI_FLASH_W25QXXDV_SPI_FREQ_0
	default 8000000

config SPI_FLASH_W25QXXDV_SPI_SLAVE
	default 1

config SPI_FLASH_W25QXXDV_GPIO_SPI_CS
	def_bool y

config SPI_FLASH_W25QXXDV_GPIO_SPI_CS_DRV_NAME
	default "GPIO_0"

config SPI_FLASH_W25QXXDV_GPIO_SPI_CS_PIN
	default 17

config SPI_FLASH_W25QXXDV_GPIO_CS_WAIT_DELAY
	default 50

config SPI_FLASH_W25QXXDV_FLASH_SIZE
	default 67108864

config SPI_FLASH_W25QXXDV_DEVICE_ID
	default 0x00c22817

endif # FLASH


endif # BOARD_NEWCASTLE
```

## boards/arm/sirrus_100_dvk/Kconfig
```kconfig
# Kconfig - Sirrus(TM) 100 DVK board configuration
#
# Copyright (c) 2018 Laird Technologies
#
# SPDX-License-Identifier: Apache-2.0

if BOARD_SIRRUS_100_DVK

config BOARD_ENABLE_DCDC
        bool "Enable DCDC mode"
        select SOC_DCDC_NRF52X
        default y

endif # BOARD_SIRRUS_100_DVK
```

## boards/arm/sirrus_100_dvk/Kconfig.board
```kconfig
# Kconfig - Sirrus(TM) 100 DVK board configuration
#
# Copyright (c) 2019 Laird Connectivity
#
# SPDX-License-Identifier: Apache-2.0

config  BOARD_SIRRUS_100_DVK
	bool "Sirrus 100 DVK"
	depends on SOC_NRF52840_QIAA
```

## boards/arm/sirrus_100_dvk/Kconfig.defconfig
```kconfig
# Kconfig - Sirrus(TM) 100 DVK board configuration
#
# Copyright (c) 2019 Laird Connectivity
#
# SPDX-License-Identifier: Apache-2.0

if BOARD_SIRRUS_100_DVK

config BOARD
	default "sirrus_100_dvk"

config GPIO
	default y

if ADC

config ADC_0
	default y

endif # ADC

if I2C

config I2C_0
	default y

endif # I2C

if SPI

config SPI_0
	default y

endif # SPI

if USB

config USB_NRF52840
	def_bool y

config USB_DEVICE_STACK
	def_bool y

endif # USB

if IEEE802154

config IEEE802154_NRF5
	default y

endif # IEEE802154

if FLASH && SPI

config SPI_FLASH_W25QXXDV
	default y

if SPI_FLASH_W25QXXDV

config SPI_FLASH_W25QXXDV_GPIO_SPI_CS
	default y

endif # SPI_FLASH_W25QXXDV

endif # FLASH && SPI

endif # BOARD_SIRRUS_100_DVK
```

## boards/arm/sirrus_100_dvk/sirrus_100_dvk_defconfig
```kconfig
CONFIG_ARM=y
CONFIG_SOC_FAMILY_NRF=y
CONFIG_SOC_SERIES_NRF52X=y
CONFIG_SOC_NRF52840_QIAA=y
CONFIG_BOARD_SIRRUS_100_DVK=y

# Enable MPU
CONFIG_ARM_MPU=y

# Enable RTT
CONFIG_HAS_SEGGER_RTT=y
CONFIG_USE_SEGGER_RTT=y

# enable uart driver
CONFIG_SERIAL=y
CONFIG_UART_0_NRF_UART=y

# enable console
CONFIG_CONSOLE=y
CONFIG_UART_CONSOLE=y
CONFIG_RTT_CONSOLE=y

# additional board options
CONFIG_GPIO_AS_PINRESET=y

# bluetooth
CONFIG_BT=y
CONFIG_BT_CTLR=y

# Flash
CONFIG_FLASH=y

# Spi
CONFIG_SPI=y

# UART 1
CONFIG_UART_1_NRF_UARTE=y
CONFIG_UART_1_INTERRUPT_DRIVEN=y

# Reboot support
CONFIG_REBOOT=y
```

## west.yml
```yaml
manifest:
  remotes:
    - name: LairdCellular
      url-base: git@git.devops.rfpros.com:cp_cellular
    - name: LairdProdEng
      url-base: git@git.devops.rfpros.com:prod_eng

  # Please add items below based on alphabetical order.
  # These dependencies may need updating if new features are added to the firmware.
  projects:
    - name: zephyr
      west-commands: scripts/west-commands.yml
      revision: laird/hl7800_zephyr_2.3.x
      remote: LairdCellular
      import: true
    - name: zephyr-hal-lairdconnectivity
      path: zephyr/ext/hal/lairdconnectivity
      revision: 1c357f06c6f79515930743e94a94855dd997c679
      remote: LairdCellular
    - name: zephyr_boards
      path: zephyr/boards/arm
      revision: master
      remote: LairdProdEng
    - name: zephyr_lib
      path: modules/zephyr_lib
      revision: master
      remote: LairdProdEng
  self:
    path: pinnacle_firmware
```
