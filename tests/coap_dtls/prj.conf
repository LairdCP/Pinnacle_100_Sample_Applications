## CMakeLists.txt
```
# SPDX-License-Identifier: Apache-2.0

cmake_minimum_required(VERSION 3.13.1)
include($ENV{ZEPHYR_BASE}/cmake/app/boilerplate.cmake NO_POLICY_SCOPE)
project(coap_dtls)

FILE(GLOB app_sources src/*.c)
target_sources(app PRIVATE ${app_sources})
target_include_directories(app PRIVATE $ENV{ZEPHYR_BASE}/subsys/net/ip)
include_directories(${CMAKE_SOURCE_DIR}/include)

set(gen_dir ${ZEPHYR_BINARY_DIR}/include/generated/)
generate_inc_file_for_target(
    app
    src/certs/laird-dev-nbiot-caTrustStore.der
    ${gen_dir}/laird-dev-nbiot-caTrustStore.der.inc
    )

generate_inc_file_for_target(
    app
    src/certs/pinnacle_test_cert.der
    ${gen_dir}/pinnacle_test_cert.der.inc
    )

generate_inc_file_for_target(
    app
    src/certs/pinnacle_test_key_nopass.der
    ${gen_dir}/pinnacle_test_key_nopass.der.inc
    )
```

## prj.conf
```kconfig
# Copyright (c) 2020 Laird Connectivity
# SPDX-License-Identifier: Apache-2.0

# General
CONFIG_MAIN_STACK_SIZE=4096
# Change this to 0 if not using Laird bootloader
CONFIG_FLASH_LOAD_OFFSET=0x1000

# Generic networking options
CONFIG_NET_SOCKETS=y
CONFIG_NET_SOCKETS_POSIX_NAMES=y
CONFIG_NET_SOCKETS_POLL_MAX=4
CONFIG_NET_MGMT=y
CONFIG_NET_MGMT_EVENT=y
CONFIG_NETWORKING=y
CONFIG_NEWLIB_LIBC=y
CONFIG_DNS_RESOLVER=y
# networking buffers
CONFIG_NET_PKT_RX_COUNT=8
CONFIG_NET_BUF_RX_COUNT=64

# CoAP
CONFIG_COAP=y

# Security
CONFIG_NET_SOCKETS_SOCKOPT_TLS=y
CONFIG_NET_SOCKETS_ENABLE_DTLS=y
# TLS configuration
CONFIG_MBEDTLS=y
CONFIG_MBEDTLS_DTLS=y
CONFIG_MBEDTLS_BUILTIN=y
CONFIG_MBEDTLS_ENABLE_HEAP=y
CONFIG_MBEDTLS_HEAP_SIZE=50000
CONFIG_MBEDTLS_SSL_MAX_CONTENT_LEN=8192
CONFIG_MBEDTLS_PEM_CERTIFICATE_FORMAT=y
# MBEDTLS ciphers
CONFIG_MBEDTLS_KEY_EXCHANGE_ALL_ENABLED=y
CONFIG_MBEDTLS_CIPHER_ALL_ENABLED=y
CONFIG_MBEDTLS_MAC_ALL_ENABLED=y
CONFIG_MBEDTLS_ECP_ALL_ENABLED=y

# Kernel options
CONFIG_ENTROPY_GENERATOR=y

# Logging
CONFIG_PRINTK=y
CONFIG_NET_LOG=y

# Network Shell
CONFIG_NET_SHELL=y

CONFIG_HEAP_MEM_POOL_SIZE=2048

# Modem settings
# CONFIG_MODEM_LOG_LEVEL_DBG=y
CONFIG_MODEM_HL7800_APN_NAME=""
CONFIG_MODEM_HL7800_BAND_1=n
CONFIG_MODEM_HL7800_BAND_2=n
CONFIG_MODEM_HL7800_BAND_3=n
CONFIG_MODEM_HL7800_BAND_4=n
CONFIG_MODEM_HL7800_BAND_5=n
CONFIG_MODEM_HL7800_BAND_8=n
CONFIG_MODEM_HL7800_BAND_9=n
CONFIG_MODEM_HL7800_BAND_10=n
CONFIG_MODEM_HL7800_BAND_12=n
CONFIG_MODEM_HL7800_BAND_13=n
CONFIG_MODEM_HL7800_BAND_14=n
CONFIG_MODEM_HL7800_BAND_17=n
CONFIG_MODEM_HL7800_BAND_18=n
CONFIG_MODEM_HL7800_BAND_19=n
CONFIG_MODEM_HL7800_BAND_20=y
CONFIG_MODEM_HL7800_BAND_25=n
CONFIG_MODEM_HL7800_BAND_26=n
CONFIG_MODEM_HL7800_BAND_27=n
CONFIG_MODEM_HL7800_BAND_28=n
CONFIG_MODEM_HL7800_BAND_66=n

# DEBUGGING
# CONFIG_NO_OPTIMIZATIONS=y
# CONFIG_DEBUG_OPTIMIZATIONS=y
CONFIG_LOG=y
CONFIG_LOG_BUFFER_SIZE=10240
CONFIG_LOG_STRDUP_MAX_STRING=128
CONFIG_LOG_STRDUP_BUF_COUNT=16

# CONFIG_NET_LOG=y
# CONFIG_NET_MGMT_EVENT_LOG_LEVEL_DBG=y
# CONFIG_NET_UDP_LOG_LEVEL_DBG=y
# CONFIG_NET_CONN_LOG_LEVEL_DBG=y
# CONFIG_NET_SOCKETS_LOG_LEVEL_DBG=y
# CONFIG_MBEDTLS_DEBUG=y
# CONFIG_MBEDTLS_DEBUG_LEVEL=1
```

## src/main.c
```c
/*
 * Copyright (c) 2020 Laird Connectivity
 *
 * SPDX-License-Identifier: Apache-2.0
 */

#include <logging/log.h>
LOG_MODULE_REGISTER(coap_dtls, LOG_LEVEL_DBG);

#include "laird_coap.h"
#include "lte.h"
#include "certificate.h"
#include <kernel.h>

#define MAIN_LOG_ERR(...) LOG_ERR(__VA_ARGS__)
#define MAIN_LOG_WRN(...) LOG_WRN(__VA_ARGS__)
#define MAIN_LOG_INF(...) LOG_INF(__VA_ARGS__)
#define MAIN_LOG_DBG(...) LOG_DBG(__VA_ARGS__)

#define SUCCESS_MSG "Success"
#define PUT_OBS_VAL "Updated the observable endpoint!"
/* TODO: hopefully we can remove this delay in the future */
#define DELAY_TIME_SECONDS 5

K_SEM_DEFINE(lte_ready_sem, 0, 1);

static void lteEvent(enum lte_event event)
{
	switch (event) {
	case LTE_EVT_READY:
		k_sem_give(&lte_ready_sem);
		break;
	case LTE_EVT_DISCONNECTED:
		/* No need to trigger a reconnect.
		*  If next sensor data TX fails we will reconnect. 
		*/
		break;
	}
}

void main(void)
{
	int r;
	struct coap_packet reply;
	const u8_t *replyPayload = NULL;
	u16_t replyPayloadLength;

	lteRegisterEventCallback(lteEvent);
	r = lteInit();
	if (r < 0) {
		MAIN_LOG_ERR("LTE init (%d)", r);
		goto err;
	}

	if (!lteIsReady()) {
		MAIN_LOG_INF("Waiting for network");
		/* Wait for LTE read evt */
		k_sem_reset(&lte_ready_sem);
		k_sem_take(&lte_ready_sem, K_FOREVER);
	}

	r = laird_coap_init(ca_certificate, sizeof(ca_certificate),
			    dev_certificate, sizeof(dev_certificate), dev_key,
			    sizeof(dev_key));
	if (r < 0) {
		goto err;
	}

	r = laird_coap_get_server_addr();
	if (r < 0) {
		goto err;
	}

	MAIN_LOG_DBG("Start CoAP DTLS");
	r = laird_coap_start_client();
	if (r < 0) {
		goto err;
	}

	MAIN_LOG_INF("Test GET /ping");
	r = laird_coap_send_request_wait_for_reply(COAP_METHOD_GET,
						   COAP_PATH_PING, NULL, 0,
						   &reply, &replyPayload,
						   &replyPayloadLength);
	if (r < 0) {
		goto err;
	}
	/* compare response with expected response */
	r = strcmp(COAP_RESPONSE_PING, replyPayload);
	if (r != 0) {
		MAIN_LOG_ERR("%s response [%s] does not match expected [%s]",
			     COAP_PATH_PING, replyPayload, COAP_RESPONSE_PING);
	} else {
		MAIN_LOG_INF(SUCCESS_MSG);
	}
	/* free coap packet data now that we are done with it*/
	laird_coap_free_pkt_data(&reply);

	MAIN_LOG_INF("Test GET /observable");
	r = laird_coap_send_request_wait_for_reply(COAP_METHOD_GET,
						   COAP_PATH_OBSERVABLE, NULL,
						   0, &reply, &replyPayload,
						   &replyPayloadLength);
	if (r < 0) {
		goto err;
	}
	/* compare response with expected response */
	r = strcmp(COAP_RESPONSE_DEFAULT_OBSERVABLE, replyPayload);
	if (r != 0) {
		MAIN_LOG_ERR("%s response [%s] does not match expected [%s]",
			     COAP_PATH_OBSERVABLE, replyPayload,
			     COAP_RESPONSE_DEFAULT_OBSERVABLE);
	} else {
		MAIN_LOG_INF(SUCCESS_MSG);
	}
	/* free coap packet data now that we are done with it*/
	laird_coap_free_pkt_data(&reply);

	MAIN_LOG_INF("Test PUT /observable");
	r = laird_coap_send_request(COAP_METHOD_PUT, COAP_PATH_OBSERVABLE,
				    PUT_OBS_VAL, strlen(PUT_OBS_VAL));
	if (r < 0) {
		goto err;
	}

	/* wait some time for server update to take effect */
	k_sleep(K_SECONDS(DELAY_TIME_SECONDS));

	MAIN_LOG_INF("Test MODIFIED GET /observable");
	r = laird_coap_send_request_wait_for_reply(COAP_METHOD_GET,
						   COAP_PATH_OBSERVABLE, NULL,
						   0, &reply, &replyPayload,
						   &replyPayloadLength);
	if (r < 0) {
		goto err;
	}
	/* compare response with expected response */
	r = strcmp(PUT_OBS_VAL, replyPayload);
	if (r != 0) {
		MAIN_LOG_ERR("%s response [%s] does not match expected [%s]",
			     COAP_PATH_OBSERVABLE, replyPayload, PUT_OBS_VAL);
	} else {
		MAIN_LOG_INF(SUCCESS_MSG);
	}
	/* free coap packet data now that we are done with it*/
	laird_coap_free_pkt_data(&reply);

	MAIN_LOG_INF("Test DELETE /observable");
	r = laird_coap_send_request(COAP_METHOD_DELETE, COAP_PATH_OBSERVABLE,
				    NULL, 0);
	if (r < 0) {
		goto err;
	}

	/* wait some time for server update to take effect */
	k_sleep(K_SECONDS(DELAY_TIME_SECONDS));

	MAIN_LOG_INF("Test GET /observable is set back to default");
	r = laird_coap_send_request_wait_for_reply(COAP_METHOD_GET,
						   COAP_PATH_OBSERVABLE, NULL,
						   0, &reply, &replyPayload,
						   &replyPayloadLength);
	if (r < 0) {
		goto err;
	}
	/* compare response with expected response */
	r = strcmp(COAP_RESPONSE_DEFAULT_OBSERVABLE, replyPayload);
	if (r != 0) {
		MAIN_LOG_ERR("%s response [%s] does not match expected [%s]",
			     COAP_PATH_OBSERVABLE, replyPayload,
			     COAP_RESPONSE_DEFAULT_OBSERVABLE);
	} else {
		MAIN_LOG_INF(SUCCESS_MSG);
	}
	/* free coap packet data now that we are done with it*/
	laird_coap_free_pkt_data(&reply);

	MAIN_LOG_DBG("Done");
	goto done;
err:
	MAIN_LOG_ERR("quit");
done:
	/* Close the socket */
	(void)laird_coap_close_client();
}
```

## include/certificate.h
```c
/*
 * Copyright (c) 2020 Laird Connectivity
 *
 * SPDX-License-Identifier: Apache-2.0
 */

#ifndef __CERTIFICATE_H__
#define __CERTIFICATE_H__

#define CA_TAG 1
#define DEVICE_CERT_TAG 2

static const unsigned char ca_certificate[] = {
#include "laird-dev-nbiot-caTrustStore.der.inc"
};

static const unsigned char dev_certificate[] = {
#include "pinnacle_test_cert.der.inc"
};

static const unsigned char dev_key[] = {
#include "pinnacle_test_key_nopass.der.inc"
};

#endif /* __CERTIFICATE_H__ */
```

## include/config.h
```c
/*
 * Copyright (c) 2020 Laird Connectivity
 *
 * SPDX-License-Identifier: Apache-2.0
 */

#ifndef __CONFIG_H__
#define __CONFIG_H__

// #define USE_DNS

#define SERVER_HOST "nbiot.sparassidae.com"
#define SERVER_PORT_STR "5684"

#ifdef USE_DNS
#define DNS_RETRIES 3
#define DNS_RETRY_TIME_SECONDS 2
#else
#define SERVER_IP_ADDR "54.86.200.135"
#endif /* USE_DNS */

#endif /* __CONFIG_H__ */
```

## include/laird_coap.h
```c
/*
 * Copyright (c) 2020 Laird Connectivity
 *
 * SPDX-License-Identifier: Apache-2.0
 */

#ifndef __LAIRD_COAP_H__
#define __LAIRD_COAP_H__

#include <net/coap.h>

#define MAX_COAP_MSG_LEN 256

#define COAP_PATH_PING "ping"
#define COAP_PATH_OBSERVABLE "observable"

#define COAP_RESPONSE_PING "pong"
#define COAP_RESPONSE_DEFAULT_OBSERVABLE "i am observable, change me\n"

int laird_coap_init(const u8_t *rootCa, size_t rootCaLen, const u8_t *cert,
		    size_t certLen, const u8_t *key, size_t keyLen);

int laird_coap_get_server_addr();

int laird_coap_start_client();

int laird_coap_send_request(enum coap_method method, const char *path,
			    u8_t *payload, u16_t payloadSize);

int laird_coap_send_request_wait_for_reply(enum coap_method method,
					   const char *path, u8_t *payload,
					   u16_t payloadSize,
					   struct coap_packet *reply,
					   const u8_t **replyPayload,
					   u16_t *replyPayloadLen);

void laird_coap_free_pkt_data(struct coap_packet *reply);

int laird_coap_close_client();

#endif /* __LAIRD_COAP_H__ */
```

## src/laird_coap.c
```c
/*
 * Copyright (c) 2020 Laird Connectivity
 *
 * SPDX-License-Identifier: Apache-2.0
 */

#include <logging/log.h>
#define LOG_LEVEL LOG_LEVEL_DBG
LOG_MODULE_REGISTER(laird_coap);

#include <errno.h>
#include <sys/byteorder.h>
#include <zephyr.h>
#include <mbedtls/ssl.h>
#include <net/tls_credentials.h>
#include <net/socket.h>
#include <net/net_mgmt.h>
#include <net/net_ip.h>
#include <net/udp.h>

#include "config.h"
#include "laird_coap.h"

#define COAP_LOG_ERR(...) LOG_ERR(__VA_ARGS__)
#define COAP_LOG_WRN(...) LOG_WRN(__VA_ARGS__)
#define COAP_LOG_INF(...) LOG_INF(__VA_ARGS__)
#define COAP_LOG_DBG(...) LOG_DBG(__VA_ARGS__)

#define CA_TAG 1
#define DEVICE_CERT_TAG 2
#define POLL_FOREVER -1

/* CoAP client socket fd */
static int sock;

static struct pollfd fds[1];
static int nfds;

#ifdef CONFIG_DNS_RESOLVER
static struct addrinfo server_addr;
static struct addrinfo *saddr;
#endif

static const sec_tag_t sock_sec_tags[] = { CA_TAG, DEVICE_CERT_TAG };

static void wait(void)
{
	if (poll(fds, nfds, POLL_FOREVER) < 0) {
		COAP_LOG_ERR("Error in poll:%d", errno);
	}
}

static void prepare_fds()
{
	if (nfds >= 1) {
		nfds = 0;
	}
	fds[nfds].fd = sock;
	fds[nfds].events = POLLIN;
	nfds++;
}

static void clear_fds(void)
{
	fds[0].fd = 0;
	nfds = 0;
}

static int tls_init(const u8_t *rootCa, size_t rootCaLen, const u8_t *cert,
		    size_t certLen, const u8_t *key, size_t keyLen)
{
	int err = -EINVAL;

	tls_credential_delete(CA_TAG, TLS_CREDENTIAL_CA_CERTIFICATE);
	err = tls_credential_add(CA_TAG, TLS_CREDENTIAL_CA_CERTIFICATE, rootCa,
				 rootCaLen);
	if (err < 0) {
		COAP_LOG_ERR("Failed to register public certificate: %d", err);
		return err;
	}

	tls_credential_delete(DEVICE_CERT_TAG,
			      TLS_CREDENTIAL_SERVER_CERTIFICATE);
	err = tls_credential_add(DEVICE_CERT_TAG,
				 TLS_CREDENTIAL_SERVER_CERTIFICATE, cert,
				 certLen);
	if (err < 0) {
		COAP_LOG_ERR("Failed to register device certificate: %d", err);
		return err;
	}

	tls_credential_delete(DEVICE_CERT_TAG, TLS_CREDENTIAL_PRIVATE_KEY);
	err = tls_credential_add(DEVICE_CERT_TAG, TLS_CREDENTIAL_PRIVATE_KEY,
				 key, keyLen);
	if (err < 0) {
		COAP_LOG_ERR("Failed to register device key: %d", err);
		return err;
	}

	return err;
}

int laird_coap_init(const u8_t *rootCa, size_t rootCaLen, const u8_t *cert,
		    size_t certLen, const u8_t *key, size_t keyLen)
{
	return tls_init(rootCa, rootCaLen, cert, certLen, key, keyLen);
}

int laird_coap_get_server_addr(void)
{
	int r = 0;

#ifdef CONFIG_DNS_RESOLVER
	int dns_retries;
	/* Resolve server with DNS */
	server_addr.ai_family = AF_INET;
	server_addr.ai_socktype = SOCK_DGRAM;
	dns_retries = DNS_RETRIES;
	do {
		r = getaddrinfo(SERVER_HOST, SERVER_PORT_STR, &server_addr,
				&saddr);
		if (r != 0) {
			k_sleep(K_SECONDS(DNS_RETRY_TIME_SECONDS));
		}
		dns_retries--;
	} while (r != 0 && dns_retries != 0);
	if (r != 0) {
		COAP_LOG_ERR("Unable to resolve '%s'", SERVER_HOST);
	}
#endif /* CONFIG_DNS_RESOLVER */

	return r;
}

int laird_coap_start_client()
{
	int ret = 0;
	struct sockaddr_in dest;

	sock = socket(AF_INET, SOCK_DGRAM, IPPROTO_DTLS_1_2);
	if (sock < 0) {
		COAP_LOG_ERR("creating socket failed");
		return 1;
	}

	ret = setsockopt(sock, SOL_TLS, TLS_SEC_TAG_LIST, sock_sec_tags,
			 sizeof(sock_sec_tags));
	if (ret < 0) {
		COAP_LOG_ERR("Socket options (%d)", ret);
		return ret;
	}

	ret = setsockopt(sock, SOL_TLS, TLS_HOSTNAME, SERVER_HOST,
			 sizeof(SERVER_HOST));
	if (ret < 0) {
		COAP_LOG_ERR("Socket host name (%d)", ret);
		return ret;
	}

#ifdef CONFIG_DNS_RESOLVER
	dest.sin_family = saddr->ai_family;
	dest.sin_port = htons(strtol(SERVER_PORT_STR, NULL, 0));
	net_ipaddr_copy(&dest.sin_addr, &net_sin(saddr->ai_addr)->sin_addr);
#else
	// For use with sever IP addr instead of DNS
	dest.sin_family = AF_INET;
	dest.sin_port = htons(strtol(SERVER_PORT_STR, NULL, 0));
	ret = net_addr_pton(AF_INET, SERVER_IP_ADDR, &dest.sin_addr);
	if (ret < 0) {
		COAP_LOG_ERR("setting dest IP addr failed (%d)", ret);
		return ret;
	}
#endif /* CONFIG_DNS_RESOLVER */

	ret = connect(sock, (struct sockaddr *)&dest, sizeof(dest));
	if (ret < 0) {
		COAP_LOG_ERR("connect socket failed (%d)", ret);
		return ret;
	}

	prepare_fds(sock);

	return 0;
}

int laird_coap_send_request(enum coap_method method, const char *path,
			    u8_t *payload, u16_t payloadSize)
{
	struct coap_packet request;
	u8_t *data;
	int r;

	data = (u8_t *)k_malloc(MAX_COAP_MSG_LEN);
	if (!data) {
		return -ENOMEM;
	}

	r = coap_packet_init(&request, data, MAX_COAP_MSG_LEN, 1, COAP_TYPE_CON,
			     8, coap_next_token(), method, coap_next_id());
	if (r < 0) {
		COAP_LOG_ERR("Failed to init CoAP message");
		goto end;
	}

	r = coap_packet_append_option(&request, COAP_OPTION_URI_PATH, path,
				      strlen(path));
	if (r < 0) {
		COAP_LOG_ERR("Unable add option to request");
		goto end;
	}

	switch (method) {
	case COAP_METHOD_GET:
	case COAP_METHOD_DELETE:
		break;

	case COAP_METHOD_PUT:
	case COAP_METHOD_POST:
		r = coap_packet_append_payload_marker(&request);
		if (r < 0) {
			COAP_LOG_ERR("Unable to append payload marker");
			goto end;
		}

		r = coap_packet_append_payload(&request, payload, payloadSize);
		if (r < 0) {
			COAP_LOG_ERR("Not able to append payload");
			goto end;
		}

		break;
	default:
		r = -EINVAL;
		goto end;
	}

	LOG_HEXDUMP_INF(request.data, request.offset, "Request");

	r = send(sock, request.data, request.offset, 0);
	if (r < 0) {
		COAP_LOG_ERR("Send req err [%d]", r);
	}

end:
	k_free(data);

	return r;
}

static int process_coap_reply(struct coap_packet *reply,
			      const u8_t **replyPayload, u16_t *replyPayloadLen)
{
	u8_t *data;
	int rcvd;
	int ret;

	wait();

	data = (u8_t *)k_malloc(MAX_COAP_MSG_LEN);
	if (!data) {
		return -ENOMEM;
	}

	rcvd = recv(sock, data, MAX_COAP_MSG_LEN, MSG_DONTWAIT);
	if (rcvd == 0) {
		ret = -EIO;
		goto err;
	}

	if (rcvd < 0) {
		if (errno == EAGAIN || errno == EWOULDBLOCK) {
			ret = 0;
		} else {
			ret = -errno;
		}

		goto err;
	}

	LOG_HEXDUMP_INF(data, rcvd, "Response");

	ret = coap_packet_parse(reply, data, rcvd, NULL, 0);
	if (ret < 0) {
		COAP_LOG_ERR("Invalid data received");
		goto err;
	}

	*replyPayload = coap_packet_get_payload(reply, replyPayloadLen);

	goto done;
err:
	k_free(data);
done:
	return ret;
}

int laird_coap_send_request_wait_for_reply(enum coap_method method,
					   const char *path, u8_t *payload,
					   u16_t payloadSize,
					   struct coap_packet *reply,
					   const u8_t **replyPayload,
					   u16_t *replyPayloadLen)
{
	int r;

	r = laird_coap_send_request(method, path, payload, payloadSize);
	if (r < 0) {
		return r;
	}

	r = process_coap_reply(reply, replyPayload, replyPayloadLen);
	if (r < 0) {
		return r;
	}
	return 0;
}

void laird_coap_free_pkt_data(struct coap_packet *reply)
{
	k_free(reply->data);
}

int laird_coap_close_client()
{
	clear_fds();
	return close(sock);
}
```

## src/lte.c
```c
/*
 * Copyright (c) 2020 Laird Connectivity
 *
 * SPDX-License-Identifier: Apache-2.0
 */

#include <logging/log.h>
#define LOG_LEVEL LOG_LEVEL_DBG
LOG_MODULE_REGISTER(coap_lte);

#include <zephyr.h>
#include <net/net_if.h>
#include <net/net_core.h>
#include <net/net_context.h>
#include <net/net_mgmt.h>
#include <net/socket.h>

#include <drivers/modem/hl7800.h>

#include "lte.h"

#define LTE_LOG_ERR(...) LOG_ERR(__VA_ARGS__)
#define LTE_LOG_WRN(...) LOG_WRN(__VA_ARGS__)
#define LTE_LOG_INF(...) LOG_INF(__VA_ARGS__)
#define LTE_LOG_DBG(...) LOG_DBG(__VA_ARGS__)

struct mgmt_events {
	u32_t event;
	net_mgmt_event_handler_t handler;
	struct net_mgmt_event_callback cb;
};

static struct net_if *iface;
static struct net_if_config *cfg;
#ifdef CONFIG_DNS_RESOLVER
static struct dns_resolve_context *dns;
#endif
static struct lte_status lteStatus;
static lte_event_function_t lteCallbackFunction = NULL;

static void onLteEvent(enum lte_event event)
{
	if (lteCallbackFunction != NULL) {
		lteCallbackFunction(event);
	}
}

static void iface_ready_evt_handler(struct net_mgmt_event_callback *cb,
				    u32_t mgmt_event, struct net_if *iface)
{
#ifdef CONFIG_DNS_RESOLVER
	if (mgmt_event != NET_EVENT_DNS_SERVER_ADD) {
		return;
	}
	LTE_LOG_DBG("LTE DNS addr added!");
#else
	if (mgmt_event != NET_EVENT_IPV4_ADDR_ADD) {
		return;
	}
	LTE_LOG_DBG("LTE IP addr added!");
#endif
	onLteEvent(LTE_EVT_READY);
}

static void iface_down_evt_handler(struct net_mgmt_event_callback *cb,
				   u32_t mgmt_event, struct net_if *iface)
{
	if (mgmt_event != NET_EVENT_IF_DOWN) {
		return;
	}

	LTE_LOG_DBG("LTE is down");
	onLteEvent(LTE_EVT_DISCONNECTED);
}

static struct mgmt_events iface_events[] = {
	{
#ifdef CONFIG_DNS_RESOLVER
		.event = NET_EVENT_DNS_SERVER_ADD,
#else
		.event = NET_EVENT_IPV4_ADDR_ADD,
#endif
		.handler = iface_ready_evt_handler },
	{ .event = NET_EVENT_IF_DOWN, .handler = iface_down_evt_handler },
	{ 0 } // The for loop below requires this extra location.
};

static void setup_iface_events(void)
{
	int i;

	for (i = 0; iface_events[i].event; i++) {
		net_mgmt_init_event_callback(&iface_events[i].cb,
					     iface_events[i].handler,
					     iface_events[i].event);

		net_mgmt_add_event_callback(&iface_events[i].cb);
	}
}

static void modemEventCallback(enum mdm_hl7800_event event, void *event_data)
{
	switch (event) {
	case HL7800_EVENT_NETWORK_STATE_CHANGE:

		switch (((struct mdm_hl7800_compound_event *)event_data)->code) {
		case HL7800_HOME_NETWORK:

			break;

		case HL7800_REGISTRATION_DENIED:

			break;

		case HL7800_NOT_REGISTERED:
		case HL7800_OUT_OF_COVERAGE:
		case HL7800_SEARCHING:

			break;

		case HL7800_EMERGENCY:
		case HL7800_ROAMING:
		default:
			// Don't do anything.
			break;
		}
		break;

	case HL7800_EVENT_APN_UPDATE:

		break;

	case HL7800_EVENT_RSSI:

		break;

	case HL7800_EVENT_SINR:

		break;

	case HL7800_EVENT_STARTUP_STATE_CHANGE:

		switch (((struct mdm_hl7800_compound_event *)event_data)->code) {
		case HL7800_STARTUP_STATE_READY:
		case HL7800_STARTUP_STATE_WAITING_FOR_ACCESS_CODE:
			// don't do anything
			break;

		case HL7800_STARTUP_STATE_SIM_NOT_PRESENT:
		case HL7800_STARTUP_STATE_SIMLOCK:
		case HL7800_STARTUP_STATE_UNRECOVERABLE_ERROR:
		case HL7800_STARTUP_STATE_UNKNOWN:
		case HL7800_STARTUP_STATE_INACTIVE_SIM:
		default:

			break;
		}
		break;

	default:
		LOG_ERR("Unknown modem event");
		break;
	}
}

void lteRegisterEventCallback(lte_event_function_t callback)
{
	lteCallbackFunction = callback;
}

int lteInit(void)
{
	int rc = LTE_ERR_NONE;
	mdm_hl7800_register_event_callback(modemEventCallback);
	setup_iface_events();

	/* wait for network interface to be ready */
	iface = net_if_get_default();
	if (!iface) {
		LTE_LOG_ERR("Could not get iface");
		rc = LTE_ERR_NO_IFACE;
		goto exit;
	}

	cfg = net_if_get_config(iface);
	if (!cfg) {
		LTE_LOG_ERR("Could not get iface config");
		rc = LTE_ERR_IFACE_CFG;
		goto exit;
	}

#ifdef CONFIG_DNS_RESOLVER
	dns = dns_resolve_get_default();
	if (!dns) {
		LTE_LOG_ERR("Could not get DNS context");
		rc = LTE_ERR_DNS_CFG;
		goto exit;
	}
#endif

	lteStatus.radio_version = (const char *)mdm_hl7800_get_fw_version();
	lteStatus.IMEI = (const char *)mdm_hl7800_get_imei();
	lteStatus.ICCID = (const char *)mdm_hl7800_get_iccid();
	lteStatus.serialNumber = (const char *)mdm_hl7800_get_sn();
	mdm_hl7800_generate_status_events();

exit:
	return rc;
}

bool lteIsReady(void)
{
#ifdef CONFIG_DNS_RESOLVER
	struct sockaddr_in *dnsAddr;

	if (iface != NULL && cfg != NULL && &dns->servers[0] != NULL) {
		dnsAddr = net_sin(&dns->servers[0].dns_server);
		return net_if_is_up(iface) && cfg->ip.ipv4 &&
		       !net_ipv4_is_addr_unspecified(&dnsAddr->sin_addr);
	}
#else
	if (iface != NULL && cfg != NULL) {
		return net_if_is_up(iface) && cfg->ip.ipv4;
	}
#endif /* CONFIG_DNS_RESOLVER */
	return false;
}

struct lte_status *lteGetStatus(void)
{
	mdm_hl7800_get_signal_quality(&lteStatus.rssi, &lteStatus.sinr);
	return &lteStatus;
}
```
