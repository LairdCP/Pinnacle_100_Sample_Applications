## CMakeLists.txt
```
# Copyright (c) 2020-2023 Laird Connectivity
# SPDX-License-Identifier: Apache-2.0

cmake_minimum_required(VERSION 3.20.0)

find_package(Zephyr REQUIRED HINTS $ENV{ZEPHYR_BASE})
project(pinnacle100_power_mgmt)

target_sources(app PRIVATE
    src/main.c
    ${CMAKE_SOURCE_DIR}/../../common/src/led.c)
include_directories(${CMAKE_SOURCE_DIR}/include)
include_directories(${CMAKE_SOURCE_DIR}/../../common/include)

if(CONFIG_NETWORKING)
    target_sources(app PRIVATE
        src/http_get.c)
endif()
```

## Kconfig
```
menuconfig USER_APPLICATION
	 bool "Config User Application"
	 default y

if USER_APPLICATION

config SHUTDOWN_CONSOLE_UART
	bool "shutdown UART console"
	default y
	help
	  Shutdown the console UART to save power

config POWER_OFF_MODEM
	bool "Power off the modem"
	help
	  Power off the modem completely when not sending data.

endif # USER_APPLICATION

source "Kconfig.zephyr"
```

## prj.conf
```kconfig
# Copyright (c) 2020-2023 Laird Connectivity
# SPDX-License-Identifier: Apache-2.0

CONFIG_MAIN_STACK_SIZE=4096

CONFIG_NEWLIB_LIBC=y

CONFIG_PM=y
CONFIG_PM_DEVICE=y
CONFIG_PM_DEVICE_RUNTIME=y

# Uncomment to test power off modem mode
# CONFIG_POWER_OFF_MODEM=y

# Networking
CONFIG_NETWORKING=y
CONFIG_NET_IPV4=y
CONFIG_NET_MGMT=y
CONFIG_NET_MGMT_EVENT=y
# Enable the DNS resolver
CONFIG_DNS_RESOLVER=y
# should be 10 seconds minimum, but allow more time for modem to wakeup
CONFIG_NET_SOCKETS_DNS_TIMEOUT=20000
# enable TCP
CONFIG_NET_TCP=y
CONFIG_NET_SOCKETS=y
CONFIG_NET_SOCKETS_POSIX_NAMES=y

CONFIG_FLASH=y
CONFIG_NORDIC_QSPI_NOR=y
CONFIG_NORDIC_QSPI_NOR_FLASH_LAYOUT_PAGE_SIZE=4096
CONFIG_NORDIC_QSPI_NOR_STACK_WRITE_BUFFER_SIZE=16

# modem settings
CONFIG_MODEM=y
CONFIG_MODEM_HL7800=y
CONFIG_MODEM_HL7800_RAT_M1=y
CONFIG_MODEM_LOG_LEVEL_INF=y
CONFIG_MODEM_HL7800_BOOT_DELAY=y
# Uncomment to set APN, otherwise previously configured APN will be used
# CONFIG_MODEM_HL7800_SET_APN_NAME_ON_STARTUP=y
# CONFIG_MODEM_HL7800_APN_NAME=""
CONFIG_MODEM_HL7800_CONFIGURE_BANDS=n
# CONFIG_MODEM_HL7800_BAND_1=n
# CONFIG_MODEM_HL7800_BAND_2=n
# CONFIG_MODEM_HL7800_BAND_3=n
# CONFIG_MODEM_HL7800_BAND_4=n
# CONFIG_MODEM_HL7800_BAND_5=n
# CONFIG_MODEM_HL7800_BAND_8=n
# CONFIG_MODEM_HL7800_BAND_9=n
# CONFIG_MODEM_HL7800_BAND_10=n
# CONFIG_MODEM_HL7800_BAND_12=n
# CONFIG_MODEM_HL7800_BAND_13=n
# CONFIG_MODEM_HL7800_BAND_14=n
# CONFIG_MODEM_HL7800_BAND_17=n
# CONFIG_MODEM_HL7800_BAND_18=n
# CONFIG_MODEM_HL7800_BAND_19=n
# CONFIG_MODEM_HL7800_BAND_20=y
# CONFIG_MODEM_HL7800_BAND_25=n
# CONFIG_MODEM_HL7800_BAND_26=n
# CONFIG_MODEM_HL7800_BAND_27=n
# CONFIG_MODEM_HL7800_BAND_28=n
# CONFIG_MODEM_HL7800_BAND_66=n
# modem low power
CONFIG_MODEM_HL7800_LOW_POWER_MODE=y
CONFIG_MODEM_HL7800_SLEEP_LEVEL_HIBERNATE=y
CONFIG_MODEM_HL7800_RSSI_RATE_SECONDS=0
CONFIG_MODEM_HL7800_ALLOW_SLEEP_DELAY_MS=5000
# CONFIG_MODEM_HL7800_EDRX=y
# Uncomment below to enable PSM mode (and comment CONFIG_MODEM_HL7800_EDRX above)
CONFIG_MODEM_HL7800_PSM=y
CONFIG_MODEM_HL7800_PSM_PERIODIC_TAU="10100101" # 5 minutes
CONFIG_MODEM_HL7800_PSM_ACTIVE_TIME="00001010" # 20 seconds

CONFIG_LCZ=y
CONFIG_LCZ_LED=y
CONFIG_LCZ_NETWORK_MONITOR=y

# Uncomment for debug output on UART console
CONFIG_LOG=y
CONFIG_LOG_BUFFER_SIZE=10240
# CONFIG_SHUTDOWN_CONSOLE_UART=n

# Debug
# CONFIG_NO_OPTIMIZATIONS=y
# CONFIG_DEBUG_OPTIMIZATIONS=y
```

## src/main.c
```c
/*
 * Copyright (c) 2020-2023 Laird Connectivity
 *
 * SPDX-License-Identifier: Apache-2.0
 */

#include <zephyr/device.h>
#include <zephyr/logging/log.h>
#include <zephyr/logging/log_ctrl.h>
#include <zephyr/pm/device.h>
#include <zephyr/pm/device_runtime.h>
#include <zephyr/kernel.h>
#include <stdio.h>
#include <soc.h>
#if defined(CONFIG_LCZ_NETWORK_MONITOR)
#include <lcz_network_monitor.h>
#endif
#if defined(CONFIG_MODEM_HL7800)
#include <zephyr/drivers/modem/hl7800.h>
#endif

#include "config.h"
#include "http_get.h"

#define RESETREAS_REG (volatile uint32_t *)0x40000400
static int loop_count = 0;
static const struct device *qspi_flash = DEVICE_DT_GET(DT_NODELABEL(mx25r64));

#ifdef CONFIG_MODEM_HL7800
static bool http_keep_alive = true;
static struct lcz_nm_event_agent nm_event_agent;
static K_SEM_DEFINE(lte_event_sem, 0, 1);

static int start_and_ready_modem(void)
{
	int ret;

	printf("Starting modem...\n");
	ret = mdm_hl7800_reset();
	if (ret != 0) {
		printf("Error starting modem [%d]\n", ret);
		return ret;
	} else {
		printf("Modem started!\n");
	}

	do {
		printf("Waiting for LTE to be ready...\n");
		ret = k_sem_take(&lte_event_sem, K_SECONDS(30));
	} while (ret != 0);

	return ret;
}

#else
#include <zephyr/drivers/gpio.h>
#include <zephyr/drivers/uart.h>
#define GPIO0_DEV     "GPIO_0"
#define MDM_RESET_DEV "GPIO_1"
#define MDM_RESET_PIN 15
#define MDM_TX_PIN    14
#define MDM_RTS_PIN   13

static void shutdown_uart1(void)
{
#ifdef CONFIG_UART_1_NRF_UARTE
	const struct device *uart_dev;
	enum pm_device_state state;
	int rc;

	uart_dev = device_get_binding("UART_1");
	if (uart_dev == NULL) {
		printf("No device UART_1\n");
		return;
	}

	(void)pm_device_state_get(uart_dev, &state);
	if (state != PM_DEVICE_STATE_SUSPENDED) {
		rc = pm_device_action_run(uart_dev, PM_DEVICE_ACTION_SUSPEND);
		if (rc) {
			printf("Error disabling UART1 peripheral (%d)\n", rc);
		}
	}

	const struct device *gpio = device_get_binding(GPIO0_DEV);
	/* RTS */
	rc = gpio_pin_configure(gpio, MDM_RTS_PIN, (GPIO_INPUT));
	if (rc) {
		printf("Error configuring GPIO\n");
	}
	/* TX */
	rc = gpio_pin_configure(gpio, MDM_TX_PIN, (GPIO_INPUT));
	if (rc) {
		printf("Error configuring GPIO\n");
	}
#endif
}
#endif /* CONFIG_MODEM_HL7800 */

#if defined(CONFIG_LOG)
#if defined(CONFIG_SHELL_BACKEND_SERIAL)
#define BACKEND_NAME "shell_uart_backend"
#elif defined(CONFIG_LOG_BACKEND_UART)
#define BACKEND_NAME "log_backend_uart"
#else
#error "Unhandled backend"
#endif

static const struct log_backend *uart_backend;

/** @brief Finds the logging subsystem backend pointer for UART.
 *
 *  @returns 0 for success, < 0 if not found.
 */
static int log_find_uart_backend(void)
{
	int ret = -ENOENT;
	const struct log_backend *backend;
	uint32_t backend_idx;


	uart_backend = NULL;
	for (backend_idx = 0; (uart_backend == NULL); backend_idx++) {
		/* Get the next backend */
		backend = log_backend_get(backend_idx);
		/* If it's NULL, stop here */
		if (backend != NULL) {
			/* Is it UART backend? */
			if (!strcmp(backend->name, BACKEND_NAME)) {
				/* Found it */
				uart_backend = backend;
				ret = 0;
				break;
			}
		} else {
			break;
		}
	}
	return ret;
}

#if defined(CONFIG_SHUTDOWN_CONSOLE_UART)
/** @brief Disables the logging subsystem backend UART.
 *
 */
static void uart_console_logging_disable(void)
{
	if (uart_backend != NULL) {
		log_backend_deactivate(uart_backend);
	}
}

/** @brief Enables the logging subsystem backend UART.
 *
 */
static void uart_console_logging_enable(void)
{
	if (uart_backend != NULL) {
		log_backend_activate(uart_backend, uart_backend->cb->ctx);
	}
}
#endif
#endif

static void shutdown_console_uart(void)
{
#ifdef CONFIG_SHUTDOWN_CONSOLE_UART
	const struct device *uart_dev;
	enum pm_device_state state;
	int rc;

	uart_dev = DEVICE_DT_GET(DT_CHOSEN(zephyr_console));
	if (uart_dev == NULL) {
		printf("No console UART device!\n");
		return;
	}
	(void)pm_device_state_get(uart_dev, &state);
	if (state != PM_DEVICE_STATE_SUSPENDED) {
		rc = pm_device_action_run(uart_dev, PM_DEVICE_ACTION_SUSPEND);
		if (rc) {
			printf("Error disabling console UART peripheral (%d)\n", rc);
		}
	}
#endif
}

static void startup_console_uart(void)
{
#ifdef CONFIG_SHUTDOWN_CONSOLE_UART
	const struct device *uart_dev;
	enum pm_device_state state;
	int rc;

	uart_dev = DEVICE_DT_GET(DT_CHOSEN(zephyr_console));
	if (uart_dev == NULL) {
		printf("No console UART device!\n");
		return;
	}
	(void)pm_device_state_get(uart_dev, &state);
	if (state != PM_DEVICE_STATE_ACTIVE) {
		rc = pm_device_action_run(uart_dev, PM_DEVICE_ACTION_RESUME);
		if (rc) {
			printf("Error enabling console UART peripheral (%d)\n", rc);
		}
	}
#endif
}

#if defined(CONFIG_NETWORKING)
static void nm_event_callback(enum lcz_nm_event event)
{
	printf("Network monitor event %d\n", event);
	switch (event) {
	case LCZ_NM_EVENT_IFACE_DNS_ADDED:
		k_sem_give(&lte_event_sem);
		break;
	case LCZ_NM_EVENT_IFACE_DOWN:
		k_sem_reset(&lte_event_sem);
	default:
		break;
	}
}
#endif

/* Application main Thread */
int main(void)
{
	int ret = 0;
	int sleep_seconds = SLEEP_TIME_SECONDS;

	printf("\n\n*** Power Management Demo on %s ***\n", CONFIG_BOARD);

	/* Read the reset reason register */
	uint32_t resetReas = *RESETREAS_REG;
	printf("Reset reason: 0x%08X\n", resetReas);

#if defined(CONFIG_LOG)
	ret = log_find_uart_backend();
	if (ret != 0) {
		printf("ERROR: Could not find log backend!\n");
	}
#endif

	ret = pm_device_runtime_enable(qspi_flash);
	if (ret != 0) {
		printf("ERROR: Could not enable QSPI flash runtime PM [%d]\n", ret);
	}

#ifdef CONFIG_MODEM_HL7800
	nm_event_agent.callback = nm_event_callback;
	lcz_nm_register_event_callback(&nm_event_agent);

	ret = start_and_ready_modem();
	if (ret != 0) {
		goto exit;
	}
#else
	shutdown_uart1();
	const struct device *reset_gpio = device_get_binding(MDM_RESET_DEV);
	ret = gpio_pin_configure(reset_gpio, MDM_RESET_PIN, GPIO_OUTPUT);
	if (ret) {
		printf("Error configuring GPIO\n");
	}
	/* hold modem in reset */
	ret = gpio_pin_set_raw(reset_gpio, MDM_RESET_PIN, 0);
	if (ret) {
		printf("Error setting GPIO state\n");
	}

#endif /* CONFIG_MODEM_HL7800 */

	while (1) {
		loop_count++;
		startup_console_uart();
#if defined(CONFIG_LOG) && defined(CONFIG_SHUTDOWN_CONSOLE_UART)
		uart_console_logging_enable();
#endif
#ifdef CONFIG_MODEM_HL7800
#if !defined(CONFIG_MODEM_HL7800_SLEEP_LEVEL_SLEEP) || defined(CONFIG_MODEM_HL7800_PSM) ||         \
	defined(CONFIG_POWER_OFF_MODEM)
		http_keep_alive = false;
#else
		if (loop_count % 3 == 0) {
			http_keep_alive = !http_keep_alive;
		}
#endif
#if defined(CONFIG_POWER_OFF_MODEM)
		if (loop_count != 1) {
			ret = start_and_ready_modem();
		}
#endif
		if (ret == 0) {
			http_get_execute(http_keep_alive);
		}
#endif /* CONFIG_MODEM_HL7800 */
#ifndef CONFIG_MODEM_HL7800
		printf("App busy waiting for %d seconds\n", BUSY_WAIT_TIME_SECONDS);
		k_busy_wait(BUSY_WAIT_TIME);
#endif
#if defined(CONFIG_POWER_OFF_MODEM)
		printf("Power off modem...\n");
		ret = mdm_hl7800_power_off();
		if (ret == 0) {
			printf("Modem off\n");
		} else {
			printf("Err turning modem off [%d]\n", ret);
		}
#endif
		if (http_keep_alive) {
			sleep_seconds = SLEEP_TIME_KEEP_ALIVE_SECONDS;
			printf("Reducing sleep time to keep the socket alive\n");
		} else {
			sleep_seconds = SLEEP_TIME_SECONDS;
		}
		printf("App sleeping for %d seconds\n", sleep_seconds);
#if defined(CONFIG_LOG) && defined(CONFIG_SHUTDOWN_CONSOLE_UART)
		uart_console_logging_disable();
#endif
		shutdown_console_uart();
		k_sleep(K_SECONDS(sleep_seconds));
	}
#ifdef CONFIG_MODEM_HL7800
exit:
#endif /* CONFIG_MODEM_HL7800 */
	printf("Exiting main()\n");
	shutdown_console_uart();
	return -1;
}
```

## include/config.h
```c
/*
 * Copyright (c) 2020 Laird Connectivity
 *
 * SPDX-License-Identifier: Apache-2.0
 */

#ifndef CONFIG_H
#define CONFIG_H

#define BUSY_WAIT_TIME_SECONDS 5
#define BUSY_WAIT_TIME (BUSY_WAIT_TIME_SECONDS * 1000000)
#define SLEEP_TIME_SECONDS (60 * 2)
#define SLEEP_TIME_KEEP_ALIVE_SECONDS (30)

#endif
```

## include/http_get.h
```c
/*
 * Copyright (c) 2020 Laird Connectivity
 *
 * SPDX-License-Identifier: Apache-2.0
 */

#ifndef HTTP_GET_H
#define HTTP_GET_H

#include <zephyr/kernel.h>

int http_get_execute(bool keep_alive);

#endif
```

## include/led.h
```c
/*
 * Copyright (c) 2020 Laird Connectivity
 *
 * SPDX-License-Identifier: Apache-2.0
 */

#ifndef LED_H
#define LED_H

//=============================================================================
// Global Constants, Macros and Type Definitions
//=============================================================================

enum led_index {
	BLUE_LED1 = 0,
	GREEN_LED2,
	RED_LED3,
	GREEN_LED4, /* not recommended for use - reserved for bootloader */

	NUMBER_OF_LEDS
};

/* The on and off times are in system ticks.
 * If the repeat count is 2 the pattern will be displayed 3 
 * times (repeated twice). 
 */
struct led_blink_pattern {
	s32_t on_time;
	s32_t off_time;
	u32_t repeat_count;
};

#define REPEAT_INDEFINITELY (0xFFFFFFFF)

//=============================================================================
// Board definitions
//=============================================================================

#define LED_OFF 0
#define LED_ON 1

#define LED1_DEV DT_GPIO_LEDS_LED0_GPIO_CONTROLLER
#define LED1 DT_GPIO_LEDS_LED0_GPIO_PIN
#define LED2_DEV DT_GPIO_LEDS_LED1_GPIO_CONTROLLER
#define LED2 DT_GPIO_LEDS_LED1_GPIO_PIN
#define LED3_DEV DT_GPIO_LEDS_LED2_GPIO_CONTROLLER
#define LED3 DT_GPIO_LEDS_LED2_GPIO_PIN
#define LED4_DEV DT_GPIO_LEDS_LED3_GPIO_CONTROLLER
#define LED4 DT_GPIO_LEDS_LED3_GPIO_PIN

//=============================================================================
// Global Data Definitions
//=============================================================================
// NA

//=============================================================================
// Global Function Prototypes
//=============================================================================

/**
 * @brief Init the LEDs for the board.  
 * 
 * LEDs should be off after completion.
 * Creates mutex used by on/off/blink functions.
 *
 */
void led_init(void);

/**
 * @param index is a Valid LED
 */
void led_turn_on(enum led_index index);

void led_turn_on_isr(enum led_index index);

/**
 * @param index is a Valid LED
 */
void led_turn_off(enum led_index index);

void led_turn_off_isr(enum led_index index);

/**
 * @param index is a Valid LED
 * @param led_blink_pattern @ref struct led_blink_pattern
 * 
 * @details
 *  The pattern in copied by the LED driver.
 */
void led_blink(enum led_index index, struct led_blink_pattern const *pPattern);

/**
 * @param param function Called in system work queue context 
 * when pattern is complete (use NULL to disable).
 */
void led_register_pattern_complete_function(enum led_index index,
					    void (*function)(void));

/**
 * @param retval true if a blink pattern is running, false if it is complete
 */
bool led_pattern_busy(enum led_index index);

#endif /* LED_H */
```

## src/http_get.c
```c
/*
 * Copyright (c) 2020-2023 Laird Connectivity
 *
 * SPDX-License-Identifier: Apache-2.0
 */

#include "http_get.h"

#include <stdio.h>

#include <errno.h>
#include <fcntl.h>
#include <zephyr/kernel.h>
#include <zephyr/net/socket.h>

/* HTTP server to connect to */
#define HTTP_HOST "postman-echo.com"
/* Port to connect to, as string */
#define HTTP_PORT "80"
/* HTTP path to request */
#define HTTP_PATH "/"

#define SOCKET_READ_TRIES	     3
#define SOCKET_READ_RETRY_DELAY_MSEC 1000

#define CHECK(r)                                                                                   \
	{                                                                                          \
		if (r < 0) {                                                                       \
			printf("Error: " #r "\n");                                                 \
			return -1;                                                                 \
		}                                                                                  \
	}

#define CHECK_AND_CLOSE(r)                                                                         \
	{                                                                                          \
		if (r < 0) {                                                                       \
			printf("Error: " #r "\n");                                                 \
			goto close;                                                                \
		}                                                                                  \
	}

#define REQUEST_AND_CLOSE                                                                          \
	"GET " HTTP_PATH " HTTP/1.1\r\nHost: " HTTP_HOST "\r\nConnection: Close\r\n\r\n"

#define REQUEST_KEEP_ALIVE                                                                         \
	"GET " HTTP_PATH " HTTP/1.1\r\nHost: " HTTP_HOST "\r\nConnection: Keep-Alive\r\n\r\n"

#define RESPONSE_SIZE 2048

static char response[RESPONSE_SIZE];
static int sock = -1;

static int set_socket_blocking(int fd, bool val)
{
	int fl, res;

	fl = fcntl(fd, F_GETFL, 0);
	if (fl == -1) {
		return errno;
	}

	if (val) {
		fl &= ~O_NONBLOCK;
	} else {
		fl |= O_NONBLOCK;
	}

	res = fcntl(fd, F_SETFL, fl);
	if (fl == -1) {
		return errno;
	}

	return 0;
}

int http_get_execute(bool keep_alive)
{
	static struct addrinfo hints;
	struct addrinfo *res;
	int st, len, rx_tries;
	char *request;

	if (sock == -1) {
		hints.ai_family = AF_INET;
		hints.ai_socktype = SOCK_STREAM;
		printf("Resolving host address %s ...\n", HTTP_HOST);
		st = getaddrinfo(HTTP_HOST, HTTP_PORT, &hints, &res);
		if (st != 0) {
			printf("Unable to resolve address [%d], quitting\n", st);
			return st;
		} else {
			printf("Got host address!\n");
		}

		sock = socket(res->ai_family, res->ai_socktype, res->ai_protocol);
		CHECK(sock);

		set_socket_blocking(sock, false);

		printf("Connecting to " HTTP_HOST "\n");

		CHECK_AND_CLOSE(connect(sock, res->ai_addr, res->ai_addrlen));
	}

	if (keep_alive) {
		request = REQUEST_KEEP_ALIVE;
		printf("Keep HTTP connection alive\n");
	} else {
		request = REQUEST_AND_CLOSE;
		printf("Close HTTP connection after request\n");
	}

	printf("\nSending GET request...\n");
	CHECK_AND_CLOSE(send(sock, request, strlen(request), 0));

	printf("Response:\n\n");
	rx_tries = 0;
	while (rx_tries < SOCKET_READ_TRIES) {
		rx_tries++;
		len = recv(sock, response, sizeof(response) - 1, 0);

		if (len < 0) {
			k_sleep(K_MSEC(SOCKET_READ_RETRY_DELAY_MSEC));
			continue;
		} else if (len == 0) {
			goto close;
		}
		rx_tries = 0;
		response[len] = 0;
		printf("%s", response);
	}
	printf("\nResponse received\n");
	if (keep_alive) {
		goto done;
	}

close:
	printf("\nClose connection.\n");
	(void)close(sock);
	sock = -1;
done:
	return 0;
}
```

## src/led.c
```c
/* led.c - LED control
 *
 * Copyright (c) 2020 Laird Connectivity
 *
 * SPDX-License-Identifier: Apache-2.0
 */

#include <logging/log.h>
#define LOG_LEVEL LOG_LEVEL_INF
LOG_MODULE_REGISTER(oob_led);

#define LED_LOG_ERR(...) LOG_ERR(__VA_ARGS__)

//=============================================================================
// Includes
//=============================================================================

#include <gpio.h>
#include <kernel.h>

#include "led.h"

//=============================================================================
// Local Constant, Macro and Type Definitions
//=============================================================================

#define CHECK_INDEX() __ASSERT(index < NUMBER_OF_LEDS, "Invalid LED index")

#define TAKE_MUTEX(m)                                                          \
	do {                                                                   \
		__ASSERT(!k_is_in_isr(), "Can't use mutex in ISR context");    \
		k_mutex_lock(&m, K_FOREVER);                                   \
	} while (0)

#define GIVE_MUTEX(m) k_mutex_unlock(&m)

#define MINIMUM_ON_TIME K_MSEC(1)
#define MINIMUM_OFF_TIME K_MSEC(1)

enum led_state {
	ON = true,
	OFF = false,
};

enum led_blink_state {
	BLINK = true,
	DONT_BLINK = false,
};

struct led {
	enum led_state state;
	struct device *device_handle;
	u32_t pin;
	bool pattern_busy;
	struct led_blink_pattern pattern;
	struct k_timer timer;
	struct k_work work;
	void (*pattern_complete_function)(void);
};

//=============================================================================
// Global Data Definitions
//=============================================================================

//=============================================================================
// Local Data Definitions
//=============================================================================

static struct k_mutex led_mutex;
static struct led led[NUMBER_OF_LEDS];
static bool init_done = false;

//=============================================================================
// Local Function Prototypes
//=============================================================================

static void bsp_led_init(void);
static void led_timer_callback(struct k_timer *timer_id);
static void system_workq_led_timer_handler(struct k_work *item);
static void turn_on(struct led *pLed);
static void turn_off(struct led *pLed);
static void change_state(struct led *pLed, bool state, bool blink);

//=============================================================================
// Global Function Definitions
//=============================================================================

void led_init(void)
{
	k_mutex_init(&led_mutex);
	TAKE_MUTEX(led_mutex);
	bsp_led_init();

	size_t i;
	for (i = 0; i < NUMBER_OF_LEDS; i++) {
		k_timer_init(&led[i].timer, led_timer_callback, NULL);
		k_timer_user_data_set(&led[i].timer, &led[i]);
		k_work_init(&led[i].work, system_workq_led_timer_handler);
		change_state(&led[i], OFF, DONT_BLINK);
	}
	init_done = true;
	GIVE_MUTEX(led_mutex);
}

void led_turn_on(enum led_index index)
{
	CHECK_INDEX();
	TAKE_MUTEX(led_mutex);
	change_state(&led[index], ON, DONT_BLINK);
	GIVE_MUTEX(led_mutex);
}

void led_turn_on_isr(enum led_index index)
{
	if (init_done) {
		CHECK_INDEX();
		change_state(&led[index], ON, DONT_BLINK);
	}
}

void led_turn_off(enum led_index index)
{
	CHECK_INDEX();
	TAKE_MUTEX(led_mutex);
	change_state(&led[index], OFF, DONT_BLINK);
	GIVE_MUTEX(led_mutex);
}

void led_turn_off_isr(enum led_index index)
{
	if (init_done) {
		CHECK_INDEX();
		change_state(&led[index], OFF, DONT_BLINK);
	}
}

void led_blink(enum led_index index, struct led_blink_pattern const *pPattern)
{
	CHECK_INDEX();
	__ASSERT_NO_MSG(pPattern != NULL);
	TAKE_MUTEX(led_mutex);
	led[index].pattern_busy = true;
	memcpy(&led[index].pattern, pPattern, sizeof(struct led_blink_pattern));
	led[index].pattern.on_time =
		MAX(led[index].pattern.on_time, MINIMUM_ON_TIME);
	led[index].pattern.off_time =
		MAX(led[index].pattern.off_time, MINIMUM_OFF_TIME);
	change_state(&led[index], ON, BLINK);
	GIVE_MUTEX(led_mutex);
}

void led_register_pattern_complete_function(enum led_index index,
					    void (*function)(void))
{
	CHECK_INDEX();
	TAKE_MUTEX(led_mutex);
	led[index].pattern_complete_function = function;
	GIVE_MUTEX(led_mutex);
}

bool led_pattern_busy(enum led_index index)
{
	bool result = false;
	CHECK_INDEX();
	TAKE_MUTEX(led_mutex);
	result = led[index].pattern_busy;
	GIVE_MUTEX(led_mutex);
	return result;
}

//=============================================================================
// Local Function Definitions
//=============================================================================

static void led_bind_device(enum led_index index, const char *name)
{
	CHECK_INDEX();
	led[index].device_handle = device_get_binding(name);
	if (!led[index].device_handle) {
		LED_LOG_ERR("Cannot find %s!", name);
	}
}

static void led_configure_pin(enum led_index index, u32_t pin)
{
	CHECK_INDEX();
	int ret;
	led[index].pin = pin;
	ret = gpio_pin_configure(led[index].device_handle, led[index].pin,
				 (GPIO_DIR_OUT));
	if (ret) {
		LED_LOG_ERR("Error configuring GPIO");
	}
	ret = gpio_pin_write(led[index].device_handle, led[index].pin, OFF);
	if (ret) {
		LED_LOG_ERR("Error setting GPIO state");
	}
}

static void bsp_led_init(void)
{
	led_bind_device(BLUE_LED1, LED1_DEV);
	led_bind_device(GREEN_LED2, LED2_DEV);
	led_bind_device(RED_LED3, LED3_DEV);
	led_bind_device(GREEN_LED4, LED4_DEV);

	led_configure_pin(BLUE_LED1, LED1);
	led_configure_pin(GREEN_LED2, LED2);
	led_configure_pin(RED_LED3, LED3);
	led_configure_pin(GREEN_LED4, LED4);
}

static void system_workq_led_timer_handler(struct k_work *item)
{
	TAKE_MUTEX(led_mutex);
	struct led *pLed = CONTAINER_OF(item, struct led, work);
	if (pLed->pattern.repeat_count == 0) {
		change_state(pLed, OFF, DONT_BLINK);
		if (pLed->pattern_complete_function != NULL) {
			pLed->pattern_busy = false;
			pLed->pattern_complete_function();
		}
	} else {
		// Blink patterns start with the LED on, so check the repeat count after the
		// first on->off cycle has completed (when the repeat count is non-zero).
		if (pLed->state == ON) {
			change_state(pLed, OFF, BLINK);
		} else {
			if (pLed->pattern.repeat_count != REPEAT_INDEFINITELY) {
				pLed->pattern.repeat_count -= 1;
			}
			change_state(pLed, ON, BLINK);
		}
	}
	GIVE_MUTEX(led_mutex);
}

static void change_state(struct led *pLed, bool state, bool blink)
{
	if (state == ON) {
		pLed->state = ON;
		turn_on(pLed);
	} else {
		pLed->state = OFF;
		turn_off(pLed);
	}

	if (!blink) {
		pLed->pattern.repeat_count = 0;
		k_timer_stop(&pLed->timer);
	} else {
		if (state == ON) {
			k_timer_start(&pLed->timer, pLed->pattern.on_time, 0);
		} else {
			k_timer_start(&pLed->timer, pLed->pattern.off_time, 0);
		}
	}

	LOG_DBG("%s %s", state ? "On" : "Off", blink ? "blink" : "Don't blink");
}

static void turn_on(struct led *pLed)
{
	gpio_pin_write(pLed->device_handle, pLed->pin, ON);
}

static void turn_off(struct led *pLed)
{
	gpio_pin_write(pLed->device_handle, pLed->pin, OFF);
}

//=============================================================================
// Interrupt Service Routines
//=============================================================================

static void led_timer_callback(struct k_timer *timer_id)
{
	// Add item to system work queue so that it can be handled in task
	// context because LEDs cannot be handed in interrupt context (mutex).
	struct led *pLed = (struct led *)k_timer_user_data_get(timer_id);
	k_work_submit(&pLed->work);
}
```

## src/lte.c
```c
/* lte.c - LTE management
 *
 * Copyright (c) 2020 Laird Connectivity
 *
 * SPDX-License-Identifier: Apache-2.0
 */

#ifdef CONFIG_MODEM_HL7800

#include <logging/log.h>
#define LOG_LEVEL LOG_LEVEL_DBG
LOG_MODULE_REGISTER(app_lte);

#include <zephyr.h>
#include <net/net_if.h>
#include <net/net_core.h>
#include <net/net_context.h>
#include <net/net_mgmt.h>
#include <net/socket.h>

#include <drivers/modem/modem_receiver.h>
#include <drivers/modem/hl7800.h>

#include "lte.h"
#include "led.h"
#include "config.h"

#ifdef CONFIG_LOG
#define LTE_LOG_ERR(...) LOG_ERR(__VA_ARGS__)
#define LTE_LOG_WRN(...) LOG_WRN(__VA_ARGS__)
#define LTE_LOG_INF(...) LOG_INF(__VA_ARGS__)
#define LTE_LOG_DBG(...) LOG_DBG(__VA_ARGS__)
#else
#define LTE_LOG_ERR(...)                                                       \
	{                                                                      \
		printk(__VA_ARGS__);                                           \
		printk("\n");                                                  \
	}
#define LTE_LOG_WRN(...)                                                       \
	{                                                                      \
		printk(__VA_ARGS__);                                           \
		printk("\n");                                                  \
	}
#define LTE_LOG_INF(...)                                                       \
	{                                                                      \
		printk(__VA_ARGS__);                                           \
		printk("\n");                                                  \
	}
#define LTE_LOG_DBG(...)                                                       \
	{                                                                      \
		printk(__VA_ARGS__);                                           \
		printk("\n");                                                  \
	}
#endif

struct mgmt_events {
	u32_t event;
	net_mgmt_event_handler_t handler;
	struct net_mgmt_event_callback cb;
};

static struct net_if *iface;
static struct net_if_config *cfg;
static struct mdm_receiver_context *mdm_rcvr;
#ifdef CONFIG_DNS_RESOLVER
static struct dns_resolve_context *dns;
#endif
static struct lte_status lteStatus;
static lte_event_function_t lteCallbackFunction = NULL;

static const struct led_blink_pattern NETWORK_SEARCH_LED_PATTERN = {
	.on_time = DEFAULT_LED_ON_TIME_FOR_1_SECOND_BLINK,
	.off_time = DEFAULT_LED_OFF_TIME_FOR_1_SECOND_BLINK,
	.repeat_count = REPEAT_INDEFINITELY
};

static void onLteEvent(enum lte_event event)
{
	if (lteCallbackFunction != NULL) {
		lteCallbackFunction(event);
	}
}

static void iface_ready_evt_handler(struct net_mgmt_event_callback *cb,
				    u32_t mgmt_event, struct net_if *iface)
{
#ifdef CONFIG_DNS_RESOLVER
	if (mgmt_event != NET_EVENT_DNS_SERVER_ADD) {
		return;
	}
	LTE_LOG_DBG("LTE DNS addr added!");
#else
	if (mgmt_event != NET_EVENT_IPV4_ADDR_ADD) {
		return;
	}
	LTE_LOG_DBG("LTE IP addr added!");
#endif
	led_turn_on(RED_LED3);
	onLteEvent(LTE_EVT_READY);
}

static void iface_down_evt_handler(struct net_mgmt_event_callback *cb,
				   u32_t mgmt_event, struct net_if *iface)
{
	if (mgmt_event != NET_EVENT_IF_DOWN) {
		return;
	}

	LTE_LOG_DBG("LTE is down");
	led_turn_off(RED_LED3);
	onLteEvent(LTE_EVT_DISCONNECTED);
}

static struct mgmt_events iface_events[] = {
	{
#ifdef CONFIG_DNS_RESOLVER
		.event = NET_EVENT_DNS_SERVER_ADD,
#else
		.event = NET_EVENT_IPV4_ADDR_ADD,
#endif
		.handler = iface_ready_evt_handler },
	{ .event = NET_EVENT_IF_DOWN, .handler = iface_down_evt_handler },
	{ 0 } // The for loop below requires this extra location.
};

static void setup_iface_events(void)
{
	int i;

	for (i = 0; iface_events[i].event; i++) {
		net_mgmt_init_event_callback(&iface_events[i].cb,
					     iface_events[i].handler,
					     iface_events[i].event);

		net_mgmt_add_event_callback(&iface_events[i].cb);
	}
}

static void modemEventCallback(enum mdm_hl7800_event event, void *event_data)
{
	u8_t code = ((struct mdm_hl7800_compound_event *)event_data)->code;

	switch (event) {
	case HL7800_EVENT_NETWORK_STATE_CHANGE:
		LTE_LOG_DBG("HL7800 network event: %d", code);
		switch (code) {
		case HL7800_HOME_NETWORK:
		case HL7800_ROAMING:
			led_turn_on(RED_LED3);
			break;

		case HL7800_NOT_REGISTERED:
		case HL7800_SEARCHING:
			led_blink(RED_LED3, &NETWORK_SEARCH_LED_PATTERN);
			break;

		case HL7800_REGISTRATION_DENIED:
		case HL7800_UNABLE_TO_CONFIGURE:
		case HL7800_OUT_OF_COVERAGE:
		case HL7800_EMERGENCY:
		default:
			led_turn_off(RED_LED3);
			onLteEvent(LTE_EVT_DISCONNECTED);
			break;
		}
		break;

	case HL7800_EVENT_STARTUP_STATE_CHANGE:
		switch (code) {
		case HL7800_STARTUP_STATE_READY:
		case HL7800_STARTUP_STATE_WAITING_FOR_ACCESS_CODE:
			break;
		case HL7800_STARTUP_STATE_SIM_NOT_PRESENT:
		case HL7800_STARTUP_STATE_SIMLOCK:
		case HL7800_STARTUP_STATE_UNRECOVERABLE_ERROR:
		case HL7800_STARTUP_STATE_UNKNOWN:
		case HL7800_STARTUP_STATE_INACTIVE_SIM:
		default:
			led_turn_off(RED_LED3);
			break;
		}
		break;

	case HL7800_EVENT_SLEEP_STATE_CHANGE:
		switch (code) {
		case HL7800_SLEEP_STATE_ASLEEP:
			LTE_LOG_DBG("HL7800 asleep");
			break;
		case HL7800_SLEEP_STATE_AWAKE:
			LTE_LOG_DBG("HL7800 awake!");
			break;
		default:
			break;
		}
		break;

	case HL7800_EVENT_APN_UPDATE:
	case HL7800_EVENT_RSSI:
	case HL7800_EVENT_SINR:
	case HL7800_EVENT_RAT:
	case HL7800_EVENT_BANDS:
	case HL7800_EVENT_ACTIVE_BANDS:
		break;
	default:
		LOG_ERR("Unknown modem event");
		break;
	}
}

void lteRegisterEventCallback(lte_event_function_t callback)
{
	lteCallbackFunction = callback;
}

int lteInit(void)
{
	int rc = LTE_ERR_NONE;
	mdm_hl7800_register_event_callback(modemEventCallback);
	setup_iface_events();

	/* wait for network interface to be ready */
	iface = net_if_get_default();
	if (!iface) {
		LTE_LOG_ERR("Could not get iface");
		rc = LTE_ERR_NO_IFACE;
		goto exit;
	}

	cfg = net_if_get_config(iface);
	if (!cfg) {
		LTE_LOG_ERR("Could not get iface config");
		rc = LTE_ERR_IFACE_CFG;
		goto exit;
	}

#ifdef CONFIG_DNS_RESOLVER
	dns = dns_resolve_get_default();
	if (!dns) {
		LTE_LOG_ERR("Could not get DNS context");
		rc = LTE_ERR_DNS_CFG;
		goto exit;
	}
#endif

	/* Get the modem receive context */
	mdm_rcvr = mdm_receiver_context_from_id(0);
	if (mdm_rcvr == NULL) {
		LTE_LOG_ERR("Invalid modem receiver");
		rc = LTE_ERR_MDM_CTX;
		goto exit;
	}

	lteStatus.radio_version = mdm_rcvr->data_revision;
	lteStatus.IMEI = mdm_rcvr->data_imei;
	lteStatus.ICCID = (const char *)mdm_hl7800_get_iccid();
	lteStatus.serialNumber = (const char *)mdm_hl7800_get_sn();
	mdm_hl7800_generate_status_events();

exit:
	return rc;
}

bool lteIsReady(void)
{
#ifdef CONFIG_DNS_RESOLVER
	struct sockaddr_in *dnsAddr;

	if (iface != NULL && cfg != NULL && &dns->servers[0] != NULL) {
		dnsAddr = net_sin(&dns->servers[0].dns_server);
		return net_if_is_up(iface) && cfg->ip.ipv4 &&
		       !net_ipv4_is_addr_unspecified(&dnsAddr->sin_addr);
	}
#else
	if (iface != NULL && cfg != NULL) {
		return net_if_is_up(iface) && cfg->ip.ipv4;
	}
#endif /* CONFIG_DNS_RESOLVER */
	return false;
}

struct lte_status *lteGetStatus(void)
{
	mdm_hl7800_get_signal_quality(&lteStatus.rssi, &lteStatus.sinr);
	return &lteStatus;
}

#endif /* CONFIG_MODEM_HL7800 */
```

## src/power.c
```c
/*
 * Copyright (c) 2020 Laird Connectivity
 *
 * SPDX-License-Identifier: Apache-2.0
 */

#include <zephyr.h>
#include <sys/printk.h>
#include <power/power.h>
#include <device.h>

#include "led.h"

#ifdef CONFIG_SYS_POWER_SLEEP_STATES
static void shutdown_console_uart(void)
{
	struct device *uart_dev;
	uart_dev = device_get_binding(CONFIG_UART_CONSOLE_ON_DEV_NAME);
	int rc = device_set_power_state(uart_dev, DEVICE_PM_OFF_STATE, NULL,
					NULL);
	if (rc) {
		printk("Error disabling console UART peripheral (%d)\n", rc);
	}
}

static void startup_console_uart(void)
{
	struct device *uart_dev;
	uart_dev = device_get_binding(CONFIG_UART_CONSOLE_ON_DEV_NAME);
	int rc = device_set_power_state(uart_dev, DEVICE_PM_ACTIVE_STATE, NULL,
					NULL);
	if (rc) {
		printk("Error enabling console UART peripheral (%d)\n", rc);
	}
}
#endif

/*
 * Application defined function for doing any target specific operations
 * for low power entry.
 */
void sys_pm_notify_power_state_entry(enum power_states state)
{
	switch (state) {
#ifdef CONFIG_SYS_POWER_SLEEP_STATES
	case SYS_POWER_STATE_SLEEP_1:
		shutdown_console_uart();
		led_turn_on_isr(GREEN_LED2);
		k_cpu_idle();
		break;
#endif
	default:
		printk("Unsupported power state %u", state);
		break;
	}
}

/*
 * Application defined function for doing any target specific operations
 * for low power exit.
 */
void sys_pm_notify_power_state_exit(enum power_states state)
{
	switch (state) {
#ifdef CONFIG_SYS_POWER_SLEEP_STATES
	case SYS_POWER_STATE_SLEEP_1:
		startup_console_uart();
		led_turn_off_isr(GREEN_LED2);
		break;
#endif
	default:
		printk("Unsupported power state %u", state);
		break;
	}
}
```
