## CMakeLists.txt
```
cmake_minimum_required(VERSION 3.13.1)
set(BOARD_ROOT $ENV{ZEPHYR_BASE}/..)
include($ENV{ZEPHYR_BASE}/cmake/app/boilerplate.cmake NO_POLICY_SCOPE)
project(oob_demo)

FILE(GLOB app_sources src/*.c)
target_sources(app PRIVATE ${app_sources})
include_directories(${CMAKE_SOURCE_DIR}/include)
zephyr_include_directories(${ZEPHYR_BASE}/drivers/modem)

zephyr_library_include_directories($ENV{ZEPHYR_BASE}/samples/bluetooth)
```

## sample.yaml
```
sample:
  name: Out of Box Demo
tests:
  test:
    harness: TBD
    platform_whitelist: qemu_cortex_m3 qemu_x86
    tags: bluetooth
```

## prj.conf
```kconfig
# General
CONFIG_MAIN_STACK_SIZE=4096
CONFIG_NEWLIB_LIBC=y
CONFIG_NEWLIB_LIBC_FLOAT_PRINTF=y

# Bluetooth
CONFIG_BT=y
CONFIG_BT_CTLR_TX_PWR_PLUS_8=y
CONFIG_BT_CTLR_COMPANY_ID=0x0077
CONFIG_BT_MAX_CONN=2
CONFIG_BT_CTLR_DATA_LENGTH_MAX=251
CONFIG_BT_L2CAP_TX_MTU=260
CONFIG_BT_RX_BUF_LEN=260
# BLE Central settings
CONFIG_BT_CENTRAL=y
CONFIG_BT_GATT_CLIENT=y
# BLE Peripheral settings
CONFIG_BT_PERIPHERAL=y
CONFIG_BT_DEVICE_NAME="Pinnacle 100 OOB"
CONFIG_BT_DEVICE_NAME_DYNAMIC=y
CONFIG_BT_GATT_DIS=y
CONFIG_BT_GATT_DIS_PNP=n
CONFIG_BT_GATT_DIS_MODEL="Pinnacle 100"
CONFIG_BT_GATT_DIS_MANUF="Laird Connectivity"
CONFIG_BT_GATT_DIS_FW_REV=y
CONFIG_BT_GATT_DIS_SW_REV=y
# Below is setup to let DIS use settings framework
CONFIG_SETTINGS_RUNTIME=y
CONFIG_SETTINGS=y
CONFIG_BT_SETTINGS=y
CONFIG_BT_GATT_DIS_SETTINGS=y
# BLE security
# CONFIG_BT_SMP=y
# CONFIG_BT_BONDABLE=n
# CONFIG_BT_SMP_ENFORCE_MITM=n
# CONFIG_BT_MAX_PAIRED=1
# CONFIG_BT_TINYCRYPT_ECC=n
# BLE debug
# CONFIG_BT_DEBUG_LOG=y

# modem settings
# CONFIG_MODEM_LOG_LEVEL_DBG=y
CONFIG_MODEM_HL7800_APN_NAME=""
# CONFIG_MODEM_HL7800_CAT_NB1=y

# NETWORKING
CONFIG_NET_MGMT=y
CONFIG_NET_MGMT_EVENT=y
CONFIG_NET_SOCKETS=y
CONFIG_NET_SOCKETS_POSIX_NAMES=y
# Enable the DNS resolver
CONFIG_DNS_RESOLVER=y

# MQTT
CONFIG_MQTT_LIB=y
# Security
CONFIG_MQTT_LIB_TLS=y
CONFIG_NET_SOCKETS_SOCKOPT_TLS=y
# TLS configuration
CONFIG_MBEDTLS=y
CONFIG_MBEDTLS_BUILTIN=y
CONFIG_MBEDTLS_ENABLE_HEAP=y
CONFIG_MBEDTLS_HEAP_SIZE=50000
CONFIG_MBEDTLS_SSL_MAX_CONTENT_LEN=8192
CONFIG_MBEDTLS_PEM_CERTIFICATE_FORMAT=y

# JSON
CONFIG_JSON_LIBRARY=y

# Storage
CONFIG_NVS=y
CONFIG_NVS_PROTECT_FLASH=y
CONFIG_MPU_ALLOW_FLASH_WRITE=y

# command line shell
CONFIG_SHELL=y
CONFIG_SHELL_CMD_BUFF_SIZE=2100
CONFIG_SHELL_BACKEND_SERIAL_RX_RING_BUFFER_SIZE=2100

# DEBUGGING
# CONFIG_NO_OPTIMIZATIONS=y
# CONFIG_DEBUG_OPTIMIZATIONS=y
# turn on log system
CONFIG_LOG=y
CONFIG_LOG_DETECT_MISSED_STRDUP=n
# extra logging buffer for better debug
CONFIG_LOG_STRDUP_MAX_STRING=128
CONFIG_LOG_STRDUP_BUF_COUNT=20
# networking debug
# CONFIG_NET_LOG=y
# CONFIG_NET_SOCKETS_LOG_LEVEL_DBG=y
# CONFIG_MBEDTLS_DEBUG=y
# CONFIG_MBEDTLS_DEBUG_LEVEL=2
# CONFIG_NET_MGMT_EVENT_LOG_LEVEL_DBG=y
CONFIG_THREAD_NAME=y
```

## src/main.c
```c
/* main.c - Application main entry point */

/*
 * Copyright (c) 2019 Laird Connectivity
 *
 * SPDX-License-Identifier: Apache-2.0
 */

#include <logging/log.h>
#define LOG_LEVEL LOG_LEVEL_DBG
LOG_MODULE_REGISTER(oob_main);

#include <stdio.h>
#include <zephyr/types.h>
#include <stddef.h>
#include <errno.h>
#include <zephyr.h>
#include <version.h>
#include <shell/shell.h>
#include <shell/shell_uart.h>

#include "oob_common.h"
#include "led.h"
#include "oob_ble.h"
#include "lte.h"
#include "aws.h"
#include "nv.h"
#include "ble_cellular_service.h"
#include "ble_aws_service.h"

#define MAIN_LOG_ERR(...) LOG_ERR(__VA_ARGS__)
#define MAIN_LOG_WRN(...) LOG_WRN(__VA_ARGS__)
#define MAIN_LOG_INF(...) LOG_INF(__VA_ARGS__)
#define MAIN_LOG_DBG(...) LOG_DBG(__VA_ARGS__)

/* This is a callback function which is called when the send data timer has expired */
static void SendDataTimerExpired(struct k_timer *dummy);

static void appStateAwsSendSenorData(void);
static void appStateAwsInitShadow(void);
static void appStateAwsConnect(void);
static void appStateAwsDisconnect(void);
static void appStateAwsResolveServer(void);
static void appStateWaitForLte(void);
static void appStateCommissionDevice(void);

K_TIMER_DEFINE(SendDataTimer, SendDataTimerExpired, NULL);
K_SEM_DEFINE(send_data_sem, 0, 1);
K_MUTEX_DEFINE(sensor_data_lock);
K_SEM_DEFINE(lte_ready_sem, 0, 1);
K_SEM_DEFINE(rx_cert_sem, 0, 1);

static float temperatureReading = 0;
static float humidityReading = 0;
static u32_t pressureReading = 0;
static bool initShadow = true;
static bool sendSensorDataAsap = true;
static bool resolveAwsServer = true;

static bool bUpdatedTemperature = false;
static bool bUpdatedHumidity = false;
static bool bUpdatedPressure = false;

static bool commissioned;
static bool allowCommissioning = false;
static bool appReady = false;
static bool devCertSet;
static bool devKeySet;

static app_state_function_t appState;
struct lte_status *lteInfo;

static void startSendDataTimer(void)
{
	/* Start the recurring data sending timer */
	k_timer_start(&SendDataTimer, K_SECONDS(DATA_SEND_TIME_SECONDS),
		      K_SECONDS(DATA_SEND_TIME_SECONDS));
}

static void stopSendDataTimer(void)
{
	k_timer_stop(&SendDataTimer);
}

/* This is a callback function which is called when the send data timer has expired */
static void SendDataTimerExpired(struct k_timer *dummy)
{
	if (bUpdatedTemperature == true && bUpdatedHumidity == true &&
	    bUpdatedPressure == true) {
		bUpdatedTemperature = false;
		bUpdatedHumidity = false;
		bUpdatedPressure = false;
		// All sensor readings have been received
		k_sem_give(&send_data_sem);
	}
}

/* This is a callback function which receives sensor readings */
static void SensorUpdated(u8_t sensor, s32_t reading)
{
	k_mutex_lock(&sensor_data_lock, K_FOREVER);
	if (sensor == SENSOR_TYPE_TEMPERATURE) {
		// Divide by 100 to get xx.xxC format
		temperatureReading = reading / 100.0;
		bUpdatedTemperature = true;
	} else if (sensor == SENSOR_TYPE_HUMIDITY) {
		// Divide by 100 to get xx.xx% format
		humidityReading = reading / 100.0;
		bUpdatedHumidity = true;
	} else if (sensor == SENSOR_TYPE_PRESSURE) {
		// Divide by 10 to get x.xPa format
		pressureReading = reading / 10;
		bUpdatedPressure = true;
	}
	k_mutex_unlock(&sensor_data_lock);
	if (sendSensorDataAsap && bUpdatedTemperature && bUpdatedHumidity &&
	    bUpdatedPressure) {
		sendSensorDataAsap = false;
		k_sem_give(&send_data_sem);
		startSendDataTimer();
	}
}

static void lteEvent(enum lte_event event)
{
	switch (event) {
	case LTE_EVT_READY:
		k_sem_give(&lte_ready_sem);
		cell_svc_set_status(oob_ble_get_central_connection(),
				    CELL_STATUS_CONNECTED);
		break;
	case LTE_EVT_DISCONNECTED:
		/* No need to trigger a reconnect.
		*  If next sensor data TX fails we will reconnect. 
		*/
		cell_svc_set_status(oob_ble_get_central_connection(),
				    CELL_STATUS_DISCONNECTED);

		break;
	}
}

static void appStateAwsSendSenorData(void)
{
	int rc = 0;

	MAIN_LOG_DBG("AWS send sensor data state");

	k_sem_take(&send_data_sem, K_FOREVER);

	if (!commissioned) {
		/* we were decommissioned, disconnect */
		appState = appStateAwsDisconnect;
	}

	lteInfo = lteGetStatus();

	k_mutex_lock(&sensor_data_lock, K_FOREVER);
	MAIN_LOG_INF("Sending Sensor data t:%d, h:%d, p:%d...",
		     (int)(temperatureReading * 100),
		     (int)(humidityReading * 100), pressureReading);
	rc = awsPublishSensorData(temperatureReading, humidityReading,
				  pressureReading, lteInfo->rssi,
				  lteInfo->sinr);
	if (rc != 0) {
		MAIN_LOG_ERR("Could not send sensor data (%d)", rc);
		led_flash_red();
		appState = appStateAwsDisconnect;
	} else {
		MAIN_LOG_INF("Data sent");
		led_flash_green();
	}

	k_mutex_unlock(&sensor_data_lock);
}

static void appStateAwsInitShadow(void)
{
	int rc;

	MAIN_LOG_DBG("AWS init shadow state");

	/* Fill in base shadow info and publish */
	awsSetShadowAppFirmwareVersion(APP_VERSION_STRING);
	awsSetShadowKernelVersion(KERNEL_VERSION_STRING);
	awsSetShadowIMEI(lteInfo->IMEI);
	awsSetShadowICCID(lteInfo->ICCID);
	awsSetShadowRadioFirmwareVersion(lteInfo->radio_version);
	awsSetShadowRadioSerialNumber(lteInfo->serialNumber);

	MAIN_LOG_INF("Send persistent shadow data");
	rc = awsPublishShadowPersistentData();
	if (rc != 0) {
		appState = appStateAwsDisconnect;
		goto exit;
	}
	initShadow = false;
	/* The shadow init is only sent once after the very first connect.
	*  we want to send the first sensor data ASAP after the shadow is inited
	*/
	sendSensorDataAsap = true;
	appState = appStateAwsSendSenorData;
exit:
	return;
}

static void appStateAwsConnect(void)
{
	MAIN_LOG_DBG("AWS connect state");

	if (!lteIsReady()) {
		appState = appStateWaitForLte;
		return;
	}

	if (awsConnect() != 0) {
		MAIN_LOG_ERR("Could not connect to aws, retrying in %d seconds",
			     RETRY_AWS_ACTION_TIMEOUT_SECONDS);
		aws_svc_set_status(oob_ble_get_central_connection(),
				   AWS_STATUS_CONNECTION_ERR);
		/* wait some time before trying again */
		k_sleep(K_SECONDS(RETRY_AWS_ACTION_TIMEOUT_SECONDS));
		return;
	}

	nvStoreCommissioned(true);
	commissioned = true;
	allowCommissioning = false;

	aws_svc_set_status(oob_ble_get_central_connection(),
			   AWS_STATUS_CONNECTED);

	if (initShadow) {
		/* Init the shadow once, the first time we connect */
		appState = appStateAwsInitShadow;
	} else {
		/* after a connection we want to send the first sensor data ASAP */
		sendSensorDataAsap = true;
		appState = appStateAwsSendSenorData;
	}
}

static bool areCertsSet(void)
{
    return (devCertSet && devKeySet);
}

static void appStateAwsDisconnect(void)
{
	MAIN_LOG_DBG("AWS disconnect state");
	aws_svc_set_status(oob_ble_get_central_connection(),
			   AWS_STATUS_DISCONNECTED);
	stopSendDataTimer();
	awsDisconnect();
	if (areCertsSet()) {
		appState = appStateAwsConnect;
	} else {
		appState = appStateCommissionDevice;
	}
}

static void appStateAwsResolveServer(void)
{
	MAIN_LOG_DBG("AWS resolve server state");

	if (!lteIsReady()) {
		appState = appStateWaitForLte;
		return;
	}

	if (awsGetServerAddr() != 0) {
		MAIN_LOG_ERR(
			"Could not get server address, retrying in %d seconds",
			RETRY_AWS_ACTION_TIMEOUT_SECONDS);
		/* wait some time before trying again */
		k_sleep(K_SECONDS(RETRY_AWS_ACTION_TIMEOUT_SECONDS));
		return;
	}
	resolveAwsServer = false;
	appState = appStateAwsConnect;
}

static void appStateWaitForLte(void)
{
	MAIN_LOG_DBG("Wait for LTE state");

	aws_svc_set_status(oob_ble_get_central_connection(),
			   AWS_STATUS_DISCONNECTED);

	if (!lteIsReady()) {
		/* Wait for LTE read evt */
		k_sem_reset(&lte_ready_sem);
		k_sem_take(&lte_ready_sem, K_FOREVER);
	} else {
		cell_svc_set_status(oob_ble_get_central_connection(),
				    CELL_STATUS_CONNECTED);
	}

	if (resolveAwsServer && areCertsSet()) {
		appState = appStateAwsResolveServer;
	} else if (areCertsSet()) {
		appState = appStateAwsConnect;
	} else {
		appState = appStateCommissionDevice;
	}
}

static int setAwsCredentials(void)
{
	int rc;

	if (!aws_svc_client_cert_is_stored()) {
		return APP_ERR_READ_CERT;
	}

	if (!aws_svc_client_key_is_stored()) {
		return APP_ERR_READ_KEY;
	}
	devCertSet = true;
	devKeySet = true;
	rc = awsSetCredentials(aws_svc_get_client_cert(),
			       aws_svc_get_client_key());
	return rc;
}

static void appStateCommissionDevice(void)
{
	MAIN_LOG_DBG("Commission device state");
	printk("\n\nWaiting to commission device\n\n");
	aws_svc_set_status(oob_ble_get_central_connection(),
			   AWS_STATUS_NOT_PROVISIONED);
	allowCommissioning = true;

	k_sem_take(&rx_cert_sem, K_FOREVER);
	if (setAwsCredentials() == 0) {
		appState = appStateWaitForLte;
	}
}

char *replaceWord(const char *s, const char *oldW, const char *newW, char *dest,
		  int destSize)
{
	int i, cnt = 0;
	int newWlen = strlen(newW);
	int oldWlen = strlen(oldW);

	/* Counting the number of times old word
	*  occur in the string 
	*/
	for (i = 0; s[i] != '\0'; i++) {
		if (strstr(&s[i], oldW) == &s[i]) {
			cnt++;

			/* Jumping to index after the old word. */
			i += oldWlen - 1;
		}
	}

	/* Make sure new string isnt too big */
	if ((i + cnt * (newWlen - oldWlen) + 1) > destSize) {
		return NULL;
	}

	i = 0;
	while (*s) {
		/* compare the substring with the result */
		if (strstr(s, oldW) == s) {
			strcpy(&dest[i], newW);
			i += newWlen;
			s += oldWlen;
		} else {
			dest[i++] = *s++;
		}
	}

	dest[i] = '\0';
	return dest;
}

static void decommission(void)
{
	nvStoreCommissioned(false);
	devCertSet = false;
	devKeySet = false;
	commissioned = false;
	allowCommissioning = true;
	appState = appStateAwsDisconnect;
	printk("Device is decommissioned\n");
	/* trigger send data in case we are waiting in that state */
	k_sem_give(&send_data_sem);
}

static void awsSvcEvent(enum aws_svc_event event)
{
	switch (event) {
	case AWS_SVC_EVENT_SETTINGS_SAVED:
		devCertSet = true;
		devKeySet = true;
		k_sem_give(&rx_cert_sem);
		break;
	case AWS_SVC_EVENT_SETTINGS_CLEARED:
		decommission();
		break;
	}
}

#ifdef CONFIG_SHELL
static int shellSetCert(enum CREDENTIAL_TYPE type, u8_t *cred)
{
	int rc;
	int certSize;
	int expSize = 0;
	char *newCred = NULL;

	if (!appReady) {
		printk("App is not ready\n");
		return APP_ERR_NOT_READY;
	}

	if (!allowCommissioning) {
		printk("Not ready for commissioning, decommission device first\n");
		return APP_ERR_COMMISSION_DISALLOWED;
	}

	certSize = strlen(cred);

	if (type == CREDENTIAL_CERT) {
		expSize = AWS_CLIENT_CERT_MAX_LENGTH;
		newCred = (char *)aws_svc_get_client_cert();
	} else if (type == CREDENTIAL_KEY) {
		expSize = AWS_CLIENT_KEY_MAX_LENGTH;
		newCred = (char *)aws_svc_get_client_key();
	} else {
		return APP_ERR_UNKNOWN_CRED;
	}

	if (certSize > expSize) {
		printk("Cert is too large (%d)\n", certSize);
		return APP_ERR_CRED_TOO_LARGE;
	}

	replaceWord(cred, "\\n", "\n", newCred, expSize);
	replaceWord(newCred, "\\s", " ", newCred, expSize);

	rc = aws_svc_save_clear_settings(true);
	if (rc < 0) {
		MAIN_LOG_ERR("Error storing credential (%d)", rc);
	} else if (type == CREDENTIAL_CERT) {
		printk("Stored cert:\n%s\n", newCred);
		devCertSet = true;

	} else if (type == CREDENTIAL_KEY) {
		printk("Stored key:\n%s\n", newCred);
		devKeySet = true;
	}

	if (rc >= 0 && areCertsSet()) {
		k_sem_give(&rx_cert_sem);
	}

	return rc;
}

static int shell_set_aws_device_cert(const struct shell *shell, size_t argc,
				     char **argv)
{
	ARG_UNUSED(argc);

	return shellSetCert(CREDENTIAL_CERT, argv[1]);
}

static int shell_set_aws_device_key(const struct shell *shell, size_t argc,
				    char **argv)
{
	ARG_UNUSED(argc);

	return shellSetCert(CREDENTIAL_KEY, argv[1]);
}

static int shell_decommission(const struct shell *shell, size_t argc,
			      char **argv)
{
	ARG_UNUSED(argc);
	ARG_UNUSED(argv);

	if (!appReady) {
		printk("App is not ready\n");
		return APP_ERR_NOT_READY;
	}

	aws_svc_save_clear_settings(false);
	decommission();

	return 0;
}
#endif /* CONFIG_SHELL */

void main(void)
{
	int rc;

	/* init LEDS */
	led_init();

	/* Init NV storage */
	rc = nvInit();
	if (rc < 0) {
		MAIN_LOG_ERR("NV init (%d)", rc);
		goto exit;
	}

	nvReadCommissioned(&commissioned);

	/* init LTE */
	lteRegisterEventCallback(lteEvent);
	rc = lteInit();
	if (rc < 0) {
		MAIN_LOG_ERR("LTE init (%d)", rc);
		goto exit;
	}
	lteInfo = lteGetStatus();

	/* init AWS */
	rc = awsInit();
	if (rc != 0) {
		goto exit;
	}

	/* Start up BLE portion of the demo */
	cell_svc_set_imei(lteInfo->IMEI);
	cell_svc_set_fw_ver(lteInfo->radio_version);
	rc = aws_svc_init(lteInfo->IMEI);
	if (rc != 0) {
		goto exit;
	}
	aws_svc_set_event_callback(awsSvcEvent);
	if (commissioned) {
		aws_svc_set_status(NULL, AWS_STATUS_DISCONNECTED);

	} else {
		aws_svc_set_status(NULL, AWS_STATUS_NOT_PROVISIONED);
	}
	oob_ble_initialise(lteInfo->IMEI);
	oob_ble_set_callback(SensorUpdated);

	appReady = true;
	printk("\n!!!!!!!! App is ready! !!!!!!!!\n");

	if (commissioned && setAwsCredentials() == 0) {
		appState = appStateWaitForLte;
	} else {
		appState = appStateCommissionDevice;
	}

	while (true) {
		appState();
	}
exit:
	MAIN_LOG_ERR("Exiting main thread");
	return;
}

#ifdef CONFIG_SHELL
SHELL_STATIC_SUBCMD_SET_CREATE(oob_cmds,
			       SHELL_CMD_ARG(set_cert, NULL, "Set device cert",
					     shell_set_aws_device_cert, 2, 0),
			       SHELL_CMD_ARG(set_key, NULL, "Set device key",
					     shell_set_aws_device_key, 2, 0),
			       SHELL_CMD(reset, NULL,
					 "Factory reset (decommission) device",
					 shell_decommission),
			       SHELL_SUBCMD_SET_END /* Array terminated. */
);
SHELL_CMD_REGISTER(oob, &oob_cmds, "OOB Demo commands", NULL);
#endif /* CONFIG_SHELL */
```

## include/aws.h
```c
/*
 * Copyright (c) 2019 Laird Connectivity
 *
 * SPDX-License-Identifier: Apache-2.0
 */

#ifndef __AWS_H__
#define __AWS_H__

#include <json.h>

#define CA_TAG 1
#define DEVICE_CERT_TAG 2

/* AWS Root CA obtained from 
*  https://docs.aws.amazon.com/iot/latest/developerguide/managing-device-certs.html 
*/
static const unsigned char aws_root_ca[] =
	"-----BEGIN CERTIFICATE-----\n"
	"MIIDQTCCAimgAwIBAgITBmyfz5m/jAo54vB4ikPmljZbyjANBgkqhkiG9w0BAQsF\n"
	"ADA5MQswCQYDVQQGEwJVUzEPMA0GA1UEChMGQW1hem9uMRkwFwYDVQQDExBBbWF6\n"
	"b24gUm9vdCBDQSAxMB4XDTE1MDUyNjAwMDAwMFoXDTM4MDExNzAwMDAwMFowOTEL\n"
	"MAkGA1UEBhMCVVMxDzANBgNVBAoTBkFtYXpvbjEZMBcGA1UEAxMQQW1hem9uIFJv\n"
	"b3QgQ0EgMTCCASIwDQYJKoZIhvcNAQEBBQADggEPADCCAQoCggEBALJ4gHHKeNXj\n"
	"ca9HgFB0fW7Y14h29Jlo91ghYPl0hAEvrAIthtOgQ3pOsqTQNroBvo3bSMgHFzZM\n"
	"9O6II8c+6zf1tRn4SWiw3te5djgdYZ6k/oI2peVKVuRF4fn9tBb6dNqcmzU5L/qw\n"
	"IFAGbHrQgLKm+a/sRxmPUDgH3KKHOVj4utWp+UhnMJbulHheb4mjUcAwhmahRWa6\n"
	"VOujw5H5SNz/0egwLX0tdHA114gk957EWW67c4cX8jJGKLhD+rcdqsq08p8kDi1L\n"
	"93FcXmn/6pUCyziKrlA4b9v7LWIbxcceVOF34GfID5yHI9Y/QCB/IIDEgEw+OyQm\n"
	"jgSubJrIqg0CAwEAAaNCMEAwDwYDVR0TAQH/BAUwAwEB/zAOBgNVHQ8BAf8EBAMC\n"
	"AYYwHQYDVR0OBBYEFIQYzIU07LwMlJQuCFmcx7IQTgoIMA0GCSqGSIb3DQEBCwUA\n"
	"A4IBAQCY8jdaQZChGsV2USggNiMOruYou6r4lK5IpDB/G/wkjUu0yKGX9rbxenDI\n"
	"U5PMCCjjmCXPI6T53iHTfIUJrU6adTrCC2qJeHZERxhlbI1Bjjt/msv0tadQ1wUs\n"
	"N+gDS63pYaACbvXy8MWy7Vu33PqUXHeeE6V/Uq2V8viTO96LXFvKWlJbYK8U90vv\n"
	"o/ufQJVtMVT8QtPHRh8jrdkPSHCa2XV4cdFyQzR1bldZwgJcJmApzyMZFo6IQ6XU\n"
	"5MsI+yMRQ+hDKXJioaldXgjUkK642M4UwtBV8ob2xJNDd2ZhwLnoQdeXeGADbkpy\n"
	"rqXRfboQnoZsG4q5WTP468SQvvG5\n"
	"-----END CERTIFICATE-----\n";

#define SERVER_HOST "a3273rvo818l4w-ats.iot.us-east-1.amazonaws.com"

#define SERVER_PORT_STR "8883"

#define APP_SLEEP_MSECS 500

#define DNS_RETRIES 1
#define APP_CONNECT_TRIES 1

#define APP_MQTT_BUFFER_SIZE 128

#define MQTT_CLIENTID_PREFIX "pinnacle100_oob_"

#define SHADOW_STATE_NULL "{\"state\":null}"

#define SHADOW_REPORTED_START "{\"state\":{\"reported\":{"
#define SHADOW_REPORTED_END "}}}"

#define SHADOW_TEMPERATURE "\"temperature\":"
#define SHADOW_HUMIDITY "\"humidity\":"
#define SHADOW_PRESSURE "\"pressure\":"
#define SHADOW_RADIO_RSSI "\"radio_rssi\":"
#define SHADOW_RADIO_SINR "\"radio_sinr\":"

#define AWS_RX_THREAD_STACK_SIZE 1024
#define AWS_RX_THREAD_PRIORITY K_PRIO_COOP(1)

struct shadow_persistent_values {
	const char *firmware_version;
	const char *os_version;
	const char *radio_version;
	const char *IMEI;
	const char *ICCID;
	const char *radio_sn;
};

struct shadow_state_reported {
	struct shadow_persistent_values reported;
};

struct shadow_reported_struct {
	struct shadow_state_reported state;
};

static const struct json_obj_descr shadow_persistent_values_descr[] = {
	JSON_OBJ_DESCR_PRIM(struct shadow_persistent_values, firmware_version,
			    JSON_TOK_STRING),
	JSON_OBJ_DESCR_PRIM(struct shadow_persistent_values, os_version,
			    JSON_TOK_STRING),
	JSON_OBJ_DESCR_PRIM(struct shadow_persistent_values, radio_version,
			    JSON_TOK_STRING),
	JSON_OBJ_DESCR_PRIM(struct shadow_persistent_values, IMEI,
			    JSON_TOK_STRING),
	JSON_OBJ_DESCR_PRIM(struct shadow_persistent_values, ICCID,
			    JSON_TOK_STRING),
	JSON_OBJ_DESCR_PRIM(struct shadow_persistent_values, radio_sn,
			    JSON_TOK_STRING),
};

static const struct json_obj_descr shadow_state_reported_descr[] = {
	JSON_OBJ_DESCR_OBJECT(struct shadow_state_reported, reported,
			      shadow_persistent_values_descr),
};

static const struct json_obj_descr shadow_descr[] = {
	JSON_OBJ_DESCR_OBJECT(struct shadow_reported_struct, state,
			      shadow_state_reported_descr),
};

int awsInit(void);
int awsSetCredentials(u8_t *cert, u8_t *key);
int awsGetServerAddr(void);
int awsConnect(const char *clientId);
void awsDisconnect(void);
int awsKeepAlive(void);
int awsSendData(char *data);
int awsPublishShadowPersistentData();
int awsSetShadowKernelVersion(const char *version);
int awsSetShadowIMEI(const char *imei);
int awsSetShadowICCID(const char *iccid);
int awsSetShadowRadioSerialNumber(const char *sn);
int awsSetShadowRadioFirmwareVersion(const char *version);
int awsSetShadowAppFirmwareVersion(const char *version);
int awsPublishSensorData(float temperature, float humidity, int pressure,
			 int radioRssi, int radioSinr);

#endif /* __AWS_H__ */
```

## include/ble_aws_service.h
```c
/*
 * Copyright (c) 2019 Laird Connectivity
 *
 * SPDX-License-Identifier: Apache-2.0
 */
#ifndef __BLE_AWS_SERVICE_H__
#define __BLE_AWS_SERVICE_H__

#define AWS_CLIENT_ID_MAX_LENGTH 32
#define AWS_ENDPOINT_MAX_LENGTH 256
#define AWS_ROOT_CA_MAX_LENGTH 2048
#define AWS_CLIENT_CERT_MAX_LENGTH 2048
#define AWS_CLIENT_KEY_MAX_LENGTH 2048

enum aws_status {
	AWS_STATUS_NOT_PROVISIONED,
	AWS_STATUS_DISCONNECTED,
	AWS_STATUS_CONNECTED,
	AWS_STATUS_CONNECTION_ERR
};

enum aws_svc_err {
	AWS_SVC_ERR_NONE = 0,
	AWS_SVC_ERR_INIT_ENDPOINT = -1,
	AWS_SVC_ERR_INIT_CLIENT_ID = -2,
	AWS_SVC_ERR_INIT_ROOT_CA = -3,
};

enum aws_svc_event {
    AWS_SVC_EVENT_SETTINGS_SAVED,
    AWS_SVC_EVENT_SETTINGS_CLEARED,
};

/**
 * @brief Callback function prototype for AWS service events
 * 
 */
typedef void (*aws_svc_event_function_t)(enum aws_svc_event event);

int aws_svc_init(const char *clientId);
void aws_svc_set_client_id(const char *id);
void aws_svc_set_endpoint(const char *ep);
void aws_svc_set_status(struct bt_conn *conn, enum aws_status status);
void aws_svc_set_root_ca(const char *cred);
void aws_svc_set_client_cert(const char *cred);
void aws_svc_set_client_key(const char *cred);
bool aws_svc_client_cert_is_stored(void);
bool aws_svc_client_key_is_stored(void);
const char *aws_svc_get_client_cert(void);
const char *aws_svc_get_client_key(void);
int aws_svc_save_clear_settings(bool save);

/**
 * @brief Set the AWS service callback
 * 
 * @param func Callback function
 */
void aws_svc_set_event_callback(aws_svc_event_function_t func);


#endif
```

## include/ble_cellular_service.h
```c
/*
 * Copyright (c) 2019 Laird Connectivity
 *
 * SPDX-License-Identifier: Apache-2.0
 */
#ifndef __BLE_CELLULAR_SERVICE_H__
#define __BLE_CELLULAR_SERVICE_H__

#define CELL_SVC_IMEI_LENGTH 15
#define CELL_SVC_LTE_FW_VER_LENGTH_MAX 28
#define CELL_SVC_APN_MAX_LENGTH 63
#define CELL_SVC_APN_USERNAME_MAX_LENGTH 24
#define CELL_SVC_APN_PASSWORD_MAX_LENGTH 24

enum cell_status { CELL_STATUS_DISCONNECTED, CELL_STATUS_CONNECTED };

void cell_svc_set_imei(const char *imei);
void cell_svc_set_status(struct bt_conn *conn, enum cell_status status);
void cell_svc_set_fw_ver(const char *ver);

#endif
```

## include/certificate.h
```c
/*
 * Copyright (c) 2019 Laird Connectivity
 *
 * SPDX-License-Identifier: Apache-2.0
 */

#ifndef __CERTIFICATE_H__
#define __CERTIFICATE_H__

#define CA_TAG 1
#define DEVICE_CERT_TAG 2

static const unsigned char ca_certificate[] = {
#include "RootCA.der.inc"
};

static const unsigned char dev_certificate[] = {
#include "device_cert.der.inc"
};

static const unsigned char dev_key[] = {
#include "device_private_key.der.inc"
};

#endif /* __CERTIFICATE_H__ */
```

## include/led.h
```c
#ifndef LED_H
#define LED_H

#define LED_OFF 0
#define LED_ON 1

#define LED1_DEV DT_GPIO_LEDS_LED_1_GPIOS_CONTROLLER
#define LED1 DT_GPIO_LEDS_LED_1_GPIOS_PIN
#define LED2_DEV DT_GPIO_LEDS_LED_2_GPIOS_CONTROLLER
#define LED2 DT_GPIO_LEDS_LED_2_GPIOS_PIN
#define LED3_DEV DT_GPIO_LEDS_LED_3_GPIOS_CONTROLLER
#define LED3 DT_GPIO_LEDS_LED_3_GPIOS_PIN
#define LED4_DEV DT_GPIO_LEDS_LED_4_GPIOS_CONTROLLER
#define LED4 DT_GPIO_LEDS_LED_4_GPIOS_PIN

#define GREEN_LED LED4
#define RED_LED LED3

#define LED_ON_TIME 25 // mseconds

/**
 *  Init the LEDs for the board
 */
void led_init(void);

void led_flash_green(void);
void led_flash_red(void);

#endif /* LED_H */
```

## include/lte.h
```c
/*
 * Copyright (c) 2019 Laird Connectivity
 *
 * SPDX-License-Identifier: Apache-2.0
 */

#ifndef __LTE_H__
#define __LTE_H__

enum lte_errors {
	LTE_ERR_NONE = 0,
	LTE_ERR_NO_IFACE = -1,
	LTE_ERR_IFACE_CFG = -2,
	LTE_ERR_DNS_CFG = -3,
	LTE_ERR_MDM_CTX = -4,
};

enum lte_event { LTE_EVT_READY, LTE_EVT_DISCONNECTED };

struct lte_status {
	const char *radio_version;
	const char *IMEI;
	const char *ICCID;
	/* This is actually RSRP (Reference Signals Received Power in dBm)*/
	int rssi;
	/* Signal to Interference plus Noise Ratio (dBm) */
	int sinr;
};

/* Callback function for LTE events */
typedef void (*lte_event_function_t)(enum lte_event event);

void lteRegisterEventCallback(lte_event_function_t callback);
int lteInit(void);
bool lteIsReady(void);
struct lte_status *lteGetStatus(void);

#endif
```

## include/nv.h
```c
/*
 * Copyright (c) 2019 Laird Connectivity
 *
 * SPDX-License-Identifier: Apache-2.0
 */

#ifndef NV_H
#define NV_H

#define NV_FLASH_DEVICE DT_FLASH_DEV_NAME
#define NV_FLASH_OFFSET DT_FLASH_AREA_STORAGE_OFFSET

#define NUM_FLASH_SECTORS 3

int nvInit(void);
int nvReadCommissioned(bool *commissioned);
int nvStoreCommissioned(bool commissioned);
int nvStoreDevCert(u8_t *cert, u16_t size);
int nvStoreDevKey(u8_t *key, u16_t size);
int nvReadDevCert(u8_t *cert, u16_t size);
int nvReadDevKey(u8_t *key, u16_t size);
int nvDeleteDevCert(void);
int nvDeleteDevKey(void);

enum SETTING_ID {
	SETTING_ID_COMMISSIONED,
	SETTING_ID_DEV_CERT,
	SETTING_ID_DEV_KEY
};

#endif
```

## include/oob_ble.h
```c
/* oob_ble.h - Header file for the BLE portion for out of box demo */

/*
 * Copyright (c) 2019 Laird Connectivity
 *
 * SPDX-License-Identifier: Apache-2.0
 */

#ifndef __OOB_BLE_H__
#define __OOB_BLE_H__

#include <bluetooth/bluetooth.h>
#include <bluetooth/hci.h>
#include <bluetooth/conn.h>
#include <bluetooth/uuid.h>
#include <bluetooth/gatt.h>
#include <misc/byteorder.h>

/* Callback function for passing sensor data */
typedef void (*sensor_updated_function_t)(u8_t sensor, s32_t reading);

/* Function for initialising the BLE portion of the OOB demo */
void oob_ble_initialise(const char *imei);

/* Function for setting the sensor read callback function */
void oob_ble_set_callback(sensor_updated_function_t func);

struct bt_conn *oob_ble_get_central_connection(void);

#endif /* __OOB_BLE_H__ */
```

## include/oob_common.h
```c
/* oob_common.h - Header file for the common portions of demo code */

/*
 * Copyright (c) 2019 Laird Connectivity
 *
 * SPDX-License-Identifier: Apache-2.0
 */

#include <stdint.h>

#define APP_VERSION_MAJOR 0
#define APP_VERSION_MINOR 7
#define APP_VERSION_PATCH 0
#define APP_VERSION_STRING                                                     \
	STRINGIFY(APP_VERSION_MAJOR)                                           \
	"." STRINGIFY(APP_VERSION_MINOR) "." STRINGIFY(APP_VERSION_PATCH)

#define DATA_SEND_TIME_SECONDS 30

#define RETRY_AWS_ACTION_TIMEOUT_SECONDS 30

enum SENSOR_TYPES {
	SENSOR_TYPE_TEMPERATURE = 0,
	SENSOR_TYPE_HUMIDITY,
	SENSOR_TYPE_PRESSURE,
	SENSOR_TYPE_DEW_POINT,

	SENSOR_TYPE_MAX
};

enum CREDENTIAL_TYPE { CREDENTIAL_CERT, CREDENTIAL_KEY };

enum APP_ERROR {
	APP_ERR_NOT_READY = -1,
	APP_ERR_COMMISSION_DISALLOWED = -2,
	APP_ERR_CRED_TOO_LARGE = -3,
	APP_ERR_UNKNOWN_CRED = -4,
	APP_ERR_READ_CERT = -5,
	APP_ERR_READ_KEY = -6,
};

typedef void (*app_state_function_t)(void);
```

## include/oob_config.h
```c
#ifndef __OOB_CONFIG_H__
#define __OOB_CONFIG_H__

#endif /* __OOB_CONFIG_H__ */
```

## src/aws.c
```c
/*
 * Copyright (c) 2019 Laird Connectivity
 *
 * SPDX-License-Identifier: Apache-2.0
 */
#include <logging/log.h>
#define LOG_LEVEL LOG_LEVEL_DBG
LOG_MODULE_REGISTER(oob_aws);

#include <net/socket.h>
#include <net/mqtt.h>
#include <stdio.h>

#include "oob_common.h"
#include "aws.h"

#ifndef CONFIG_MQTT_LIB_TLS
#error "AWS must use MQTT with TLS"
#endif

#define APP_CA_CERT_TAG CA_TAG
#define APP_DEVICE_CERT_TAG DEVICE_CERT_TAG

#define AWS_LOG_ERR(...) LOG_ERR(__VA_ARGS__)
#define AWS_LOG_WRN(...) LOG_WRN(__VA_ARGS__)
#define AWS_LOG_INF(...) LOG_INF(__VA_ARGS__)
#define AWS_LOG_DBG(...) LOG_DBG(__VA_ARGS__)

K_THREAD_STACK_DEFINE(rxThreadStack, AWS_RX_THREAD_STACK_SIZE);
static struct k_thread rxThread;

K_SEM_DEFINE(connected_sem, 0, 1);

/* Buffers for MQTT client. */
static u8_t rx_buffer[APP_MQTT_BUFFER_SIZE];
static u8_t tx_buffer[APP_MQTT_BUFFER_SIZE];

/* mqtt client id */
static char *mqtt_client_id;

/* The mqtt client struct */
static struct mqtt_client client_ctx;

/* MQTT Broker details. */
static struct sockaddr_storage broker;

static struct pollfd fds[1];
static int nfds;

static bool connected = false;

static struct addrinfo server_addr;
struct addrinfo *saddr;

static sec_tag_t m_sec_tags[] = { APP_CA_CERT_TAG, APP_DEVICE_CERT_TAG };

static struct shadow_reported_struct shadow_persistent_data;

static char *server_endpoint;
static char *root_ca;

static int tls_init(const u8_t *cert, const u8_t *key)
{
	int err = -EINVAL;

	tls_credential_delete(APP_CA_CERT_TAG, TLS_CREDENTIAL_CA_CERTIFICATE);
	err = tls_credential_add(APP_CA_CERT_TAG, TLS_CREDENTIAL_CA_CERTIFICATE,
				 root_ca, strlen(root_ca) + 1);
	if (err < 0) {
		AWS_LOG_ERR("Failed to register public certificate: %d", err);
		return err;
	}

	tls_credential_delete(APP_DEVICE_CERT_TAG,
			      TLS_CREDENTIAL_SERVER_CERTIFICATE);
	err = tls_credential_add(APP_DEVICE_CERT_TAG,
				 TLS_CREDENTIAL_SERVER_CERTIFICATE, cert,
				 strlen(cert) + 1);
	if (err < 0) {
		AWS_LOG_ERR("Failed to register device certificate: %d", err);
		return err;
	}

	tls_credential_delete(APP_DEVICE_CERT_TAG, TLS_CREDENTIAL_PRIVATE_KEY);
	err = tls_credential_add(APP_DEVICE_CERT_TAG,
				 TLS_CREDENTIAL_PRIVATE_KEY, key,
				 strlen(key) + 1);
	if (err < 0) {
		AWS_LOG_ERR("Failed to register device key: %d", err);
		return err;
	}

	return err;
}

static void prepare_fds(struct mqtt_client *client)
{
	fds[0].fd = client->transport.tls.sock;
	fds[0].events = ZSOCK_POLLIN;
	nfds = 1;
}

static void clear_fds(void)
{
	fds[0].fd = 0;
	nfds = 0;
}

static void wait(int timeout)
{
	if (nfds > 0) {
		if (poll(fds, nfds, timeout) < 0) {
			AWS_LOG_ERR("poll error: %d", errno);
		}
	}
}

void mqtt_evt_handler(struct mqtt_client *const client,
		      const struct mqtt_evt *evt)
{
	switch (evt->type) {
	case MQTT_EVT_CONNACK:
		if (evt->result != 0) {
			AWS_LOG_ERR("MQTT connect failed %d", evt->result);
			break;
		}

		connected = true;
		k_sem_give(&connected_sem);
		AWS_LOG_INF("MQTT client connected!");

		break;

	case MQTT_EVT_DISCONNECT:
		AWS_LOG_INF("MQTT client disconnected %d", evt->result);

		connected = false;
		clear_fds();

		break;

	case MQTT_EVT_PUBACK:
		if (evt->result != 0) {
			AWS_LOG_ERR("MQTT PUBACK error %d", evt->result);
			break;
		}

		AWS_LOG_INF("PUBACK packet id: %u",
			    evt->param.puback.message_id);

		break;

	case MQTT_EVT_PUBLISH:
		if (evt->result != 0) {
			AWS_LOG_ERR("MQTT PUBLISH error %d", evt->result);
			break;
		}

		AWS_LOG_INF("MQTT RXd ID: %d Topic: %s len: %d",
			    evt->param.publish.message_id,
			    evt->param.publish.message.topic.topic.utf8,
			    evt->param.publish.message.payload.len);

		break;
	default:
		break;
	}
}

static char *get_mqtt_topic(void)
{
	static char topic[sizeof(
		"$aws/things/deviceId-###############/shadow/update")];

	snprintk(topic, sizeof(topic), "$aws/things/deviceId-%s/shadow/update",
		 shadow_persistent_data.state.reported.IMEI);

	return topic;
}

static int publish_string(struct mqtt_client *client, enum mqtt_qos qos,
			  char *data)
{
	struct mqtt_publish_param param;

	param.message.topic.qos = qos;
	param.message.topic.topic.utf8 = (u8_t *)get_mqtt_topic();
	param.message.topic.topic.size = strlen(param.message.topic.topic.utf8);
	param.message.payload.data = data;
	param.message.payload.len = strlen(param.message.payload.data);
	param.message_id = sys_rand32_get();
	param.dup_flag = 0U;
	param.retain_flag = 0U;

	return mqtt_publish(client, &param);
}

static void broker_init(void)
{
	struct sockaddr_in *broker4 = (struct sockaddr_in *)&broker;

	broker4->sin_family = saddr->ai_family;
	broker4->sin_port = htons(strtol(SERVER_PORT_STR, NULL, 0));
	net_ipaddr_copy(&broker4->sin_addr, &net_sin(saddr->ai_addr)->sin_addr);
}

static void client_init(struct mqtt_client *client)
{
	mqtt_client_init(client);

	broker_init();

	/* MQTT client configuration */
	client->broker = &broker;
	client->evt_cb = mqtt_evt_handler;
	client->client_id.utf8 = mqtt_client_id;
	client->client_id.size = strlen(mqtt_client_id);
	client->password = NULL;
	client->user_name = NULL;

	/* MQTT buffers configuration */
	client->rx_buf = rx_buffer;
	client->rx_buf_size = sizeof(rx_buffer);
	client->tx_buf = tx_buffer;
	client->tx_buf_size = sizeof(tx_buffer);

	/* MQTT transport configuration */
	client->transport.type = MQTT_TRANSPORT_SECURE;
	struct mqtt_sec_config *tls_config = &client->transport.tls.config;
	tls_config->peer_verify = 2;
	tls_config->cipher_list = NULL;
	tls_config->sec_tag_list = m_sec_tags;
	tls_config->sec_tag_count = ARRAY_SIZE(m_sec_tags);
	tls_config->hostname = server_endpoint;
}

/* In this routine we block until the connected variable is 1 */
static int try_to_connect(struct mqtt_client *client)
{
	int rc, i = 0;

	while (i++ < APP_CONNECT_TRIES && !connected) {
		client_init(client);

		rc = mqtt_connect(client);
		if (rc != 0) {
			AWS_LOG_ERR("mqtt_connect (%d)", rc);
			k_sleep(APP_SLEEP_MSECS);
			continue;
		}

		prepare_fds(client);

		wait(APP_SLEEP_MSECS);
		mqtt_input(client);

		if (!connected) {
			mqtt_abort(client);
		}
	}

	if (connected) {
		return 0;
	}

	return -EINVAL;
}

static void awsRxThread(void *arg1, void *arg2, void *arg3)
{
	while (true) {
		if (connected) {
			AWS_LOG_DBG("Waiting for MQTT RX data...");
			/* Wait for socket RX data */
			wait(K_FOREVER);

			AWS_LOG_DBG("MQTT data RXd");

			/* process MQTT RX data */
			mqtt_input(&client_ctx);
		} else {
			AWS_LOG_DBG("Waiting for MQTT connection...");
			/* Wait for connection */
			k_sem_reset(&connected_sem);
			k_sem_take(&connected_sem, K_FOREVER);
		}
	}
}

int awsInit(void)
{
	/* init shadow data */
	shadow_persistent_data.state.reported.firmware_version = "";
	shadow_persistent_data.state.reported.os_version = "";
	shadow_persistent_data.state.reported.radio_version = "";
	shadow_persistent_data.state.reported.IMEI = "";
	shadow_persistent_data.state.reported.ICCID = "";
	server_endpoint = AWS_DEFAULT_ENDPOINT;
	mqtt_client_id = DEFAULT_MQTT_CLIENTID;

	k_thread_create(&rxThread, rxThreadStack,
			K_THREAD_STACK_SIZEOF(rxThreadStack), awsRxThread, NULL,
			NULL, NULL, AWS_RX_THREAD_PRIORITY, 0, K_NO_WAIT);

	return 0;
}

int awsSetCredentials(const u8_t *cert, const u8_t *key)
{
	return tls_init(cert, key);
}

void awsSetEndpoint(const char *ep)
{
	server_endpoint = (char *)ep;
}

void awsSetClientId(const char *id)
{
	mqtt_client_id = (char *)id;
}

void awsSetRootCa(const char *cred)
{
	root_ca = (char *)cred;
}

int awsGetServerAddr(void)
{
	int rc, dns_retries;

	server_addr.ai_family = AF_INET;
	server_addr.ai_socktype = SOCK_STREAM;
	dns_retries = DNS_RETRIES;
	do {
		AWS_LOG_DBG("Get AWS server address");
		rc = getaddrinfo(server_endpoint, SERVER_PORT_STR, &server_addr,
				 &saddr);
		if (rc != 0) {
			AWS_LOG_ERR("Get AWS server addr (%d)", rc);
			k_sleep(K_SECONDS(5));
		}
		dns_retries--;
	} while (rc != 0 && dns_retries != 0);
	if (rc != 0) {
		AWS_LOG_ERR("Unable to resolve '%s'", server_endpoint);
	}

	return rc;
}

int awsConnect()
{
	AWS_LOG_INF("Attempting to connect %s to AWS...", mqtt_client_id);
	int rc = try_to_connect(&client_ctx);
	if (rc != 0) {
		AWS_LOG_ERR("AWS connect err (%d)", rc);
	}
	return rc;
}

void awsDisconnect(void)
{
	mqtt_disconnect(&client_ctx);
}

int awsKeepAlive(void)
{
	int rc;

	rc = mqtt_live(&client_ctx);
	if (rc != 0) {
		AWS_LOG_ERR("mqtt_live (%d)", rc);
		goto done;
	}

done:
	return rc;
}

int awsSetShadowKernelVersion(const char *version)
{
	shadow_persistent_data.state.reported.os_version = version;

	return 0;
}

int awsSetShadowIMEI(const char *imei)
{
	shadow_persistent_data.state.reported.IMEI = imei;

	return 0;
}

int awsSetShadowRadioFirmwareVersion(const char *version)
{
	shadow_persistent_data.state.reported.radio_version = version;

	return 0;
}

int awsSetShadowAppFirmwareVersion(const char *version)
{
	shadow_persistent_data.state.reported.firmware_version = version;

	return 0;
}

int awsSetShadowICCID(const char *iccid)
{
	shadow_persistent_data.state.reported.ICCID = iccid;

	return 0;
}

int awsSetShadowRadioSerialNumber(const char *sn)
{
	shadow_persistent_data.state.reported.radio_sn = sn;

	return 0;
}

static int sendData(char *data)
{
	int rc;

	rc = publish_string(&client_ctx, MQTT_QOS_0_AT_MOST_ONCE, data);
	if (rc != 0) {
		AWS_LOG_ERR("MQTT publish err (%d)", rc);
		goto done;
	}

done:
	return rc;
}

int awsSendData(char *data)
{
	return sendData(data);
}

int awsPublishShadowPersistentData()
{
	int rc;
	size_t buf_len;

	buf_len = json_calc_encoded_len(shadow_descr, ARRAY_SIZE(shadow_descr),
					&shadow_persistent_data);
	char msg[buf_len];

	rc = json_obj_encode_buf(shadow_descr, ARRAY_SIZE(shadow_descr),
				 &shadow_persistent_data, msg, sizeof(msg));
	if (rc < 0) {
		goto done;
	}

	/* Clear the shadow and start fresh */
	rc = sendData(SHADOW_STATE_NULL);
	if (rc < 0) {
		goto done;
	}

	rc = sendData(msg);
	if (rc < 0) {
		goto done;
	}

done:
	return rc;
}

int awsPublishSensorData(float temperature, float humidity, int pressure,
			 int radioRssi, int radioSinr)
{
	char msg[strlen(SHADOW_REPORTED_START) + strlen(SHADOW_TEMPERATURE) +
		 10 + strlen(SHADOW_HUMIDITY) + 10 + strlen(SHADOW_PRESSURE) +
		 10 + strlen(SHADOW_RADIO_RSSI) + 10 +
		 strlen(SHADOW_RADIO_SINR) + 10 + strlen(SHADOW_REPORTED_END)];

	snprintf(msg, sizeof(msg), "%s%s%.2f,%s%.2f,%s%d,%s%d,%s%d%s",
		 SHADOW_REPORTED_START, SHADOW_TEMPERATURE, temperature,
		 SHADOW_HUMIDITY, humidity, SHADOW_PRESSURE, pressure,
		 SHADOW_RADIO_RSSI, radioRssi, SHADOW_RADIO_SINR, radioSinr,
		 SHADOW_REPORTED_END);
	return awsSendData(msg);
}
```

## src/ble_aws_service.c
```c
/* ble_aws_service.c - BLE AWS Service
 *
 * Copyright (c) 2019 Laird Connectivity
 *
 * SPDX-License-Identifier: Apache-2.0
 */

#include <logging/log.h>
#define LOG_LEVEL LOG_LEVEL_DBG
LOG_MODULE_REGISTER(oob_aws_svc);

#include <errno.h>
#include <bluetooth/uuid.h>
#include <bluetooth/gatt.h>
#include <mbedtls/sha256.h>

#include "ble_aws_service.h"
#include "nv.h"
#include "aws.h"

#define AWS_SVC_LOG_ERR(...) LOG_ERR(__VA_ARGS__)
#define AWS_SVC_LOG_WRN(...) LOG_WRN(__VA_ARGS__)
#define AWS_SVC_LOG_INF(...) LOG_INF(__VA_ARGS__)
#define AWS_SVC_LOG_DBG(...) LOG_DBG(__VA_ARGS__)

#define SHA256_SIZE 32

static struct bt_uuid_128 aws_svc_uuid =
	BT_UUID_INIT_128(0xb5, 0xa9, 0x34, 0xf2, 0x59, 0x7c, 0xd7, 0xbc, 0x14,
			 0x4a, 0xa9, 0x55, 0xf0, 0x03, 0x72, 0xae);

static struct bt_uuid_128 aws_cliend_id_uuid =
	BT_UUID_INIT_128(0xb5, 0xa9, 0x34, 0xf2, 0x59, 0x7c, 0xd7, 0xbc, 0x14,
			 0x4a, 0xa9, 0x55, 0xf1, 0x03, 0x72, 0xae);

static struct bt_uuid_128 aws_endpoint_uuid =
	BT_UUID_INIT_128(0xb5, 0xa9, 0x34, 0xf2, 0x59, 0x7c, 0xd7, 0xbc, 0x14,
			 0x4a, 0xa9, 0x55, 0xf2, 0x03, 0x72, 0xae);

static struct bt_uuid_128 aws_root_ca_uuid =
	BT_UUID_INIT_128(0xb5, 0xa9, 0x34, 0xf2, 0x59, 0x7c, 0xd7, 0xbc, 0x14,
			 0x4a, 0xa9, 0x55, 0xf3, 0x03, 0x72, 0xae);

static struct bt_uuid_128 aws_client_cert_uuid =
	BT_UUID_INIT_128(0xb5, 0xa9, 0x34, 0xf2, 0x59, 0x7c, 0xd7, 0xbc, 0x14,
			 0x4a, 0xa9, 0x55, 0xf4, 0x03, 0x72, 0xae);

static struct bt_uuid_128 aws_client_key_uuid =
	BT_UUID_INIT_128(0xb5, 0xa9, 0x34, 0xf2, 0x59, 0x7c, 0xd7, 0xbc, 0x14,
			 0x4a, 0xa9, 0x55, 0xf5, 0x03, 0x72, 0xae);

static struct bt_uuid_128 aws_save_clear_uuid =
	BT_UUID_INIT_128(0xb5, 0xa9, 0x34, 0xf2, 0x59, 0x7c, 0xd7, 0xbc, 0x14,
			 0x4a, 0xa9, 0x55, 0xf6, 0x03, 0x72, 0xae);

static struct bt_uuid_128 aws_status_uuid =
	BT_UUID_INIT_128(0xb5, 0xa9, 0x34, 0xf2, 0x59, 0x7c, 0xd7, 0xbc, 0x14,
			 0x4a, 0xa9, 0x55, 0xf7, 0x03, 0x72, 0xae);

static char client_id_value[AWS_CLIENT_ID_MAX_LENGTH + 1];
static char endpoint_value[AWS_ENDPOINT_MAX_LENGTH + 1];
static char root_ca_value[AWS_ROOT_CA_MAX_LENGTH + 1];
static u8_t root_ca_sha256[SHA256_SIZE];
static char client_cert_value[AWS_CLIENT_CERT_MAX_LENGTH + 1];
static u8_t client_cert_sha256[SHA256_SIZE];
static char client_key_value[AWS_CLIENT_KEY_MAX_LENGTH + 1];
static u8_t client_key_sha256[SHA256_SIZE];

static u8_t save_clear_value;

static struct bt_gatt_ccc_cfg status_ccc_cfg[BT_GATT_CCC_MAX] = {};
static u8_t status_notify;
static enum aws_status status_value;

static bool isClientCertStored = false;
static bool isClientKeyStored = false;

static ssize_t read_client_id(struct bt_conn *conn,
			      const struct bt_gatt_attr *attr, void *buf,
			      u16_t len, u16_t offset)
{
	u16_t valueLen;

	const char *value = attr->user_data;
	valueLen = strlen(value);
	if (valueLen > AWS_CLIENT_ID_MAX_LENGTH) {
		valueLen = AWS_CLIENT_ID_MAX_LENGTH;
	}

	return bt_gatt_attr_read(conn, attr, buf, len, offset, value, valueLen);
}

static ssize_t read_endpoint(struct bt_conn *conn,
			     const struct bt_gatt_attr *attr, void *buf,
			     u16_t len, u16_t offset)
{
	u16_t valueLen;

	const char *value = attr->user_data;
	valueLen = strlen(value);
	if (valueLen > AWS_ENDPOINT_MAX_LENGTH) {
		valueLen = AWS_ENDPOINT_MAX_LENGTH;
	}

	return bt_gatt_attr_read(conn, attr, buf, len, offset, value, valueLen);
}

static ssize_t read_root_ca(struct bt_conn *conn,
			    const struct bt_gatt_attr *attr, void *buf,
			    u16_t len, u16_t offset)
{
	mbedtls_sha256(root_ca_value, strlen(root_ca_value), root_ca_sha256,
		       false);

	return bt_gatt_attr_read(conn, attr, buf, len, offset, &root_ca_sha256,
				 sizeof(root_ca_sha256));
}

static ssize_t read_client_cert(struct bt_conn *conn,
				const struct bt_gatt_attr *attr, void *buf,
				u16_t len, u16_t offset)
{
	mbedtls_sha256(client_cert_value, strlen(client_cert_value),
		       client_cert_sha256, false);
	return bt_gatt_attr_read(conn, attr, buf, len, offset,
				 &client_cert_sha256,
				 sizeof(client_cert_sha256));
}

static ssize_t read_client_key(struct bt_conn *conn,
			       const struct bt_gatt_attr *attr, void *buf,
			       u16_t len, u16_t offset)
{
	mbedtls_sha256(client_key_value, strlen(client_key_value),
		       client_key_sha256, false);
	return bt_gatt_attr_read(conn, attr, buf, len, offset,
				 &client_key_sha256, sizeof(client_key_sha256));
}

static ssize_t write_save_clear(struct bt_conn *conn,
				const struct bt_gatt_attr *attr,
				const void *buf, u16_t len, u16_t offset,
				u8_t flags)
{
	u8_t *value = attr->user_data;

	if (offset + len > sizeof(save_clear_value)) {
		return BT_GATT_ERR(BT_ATT_ERR_INVALID_OFFSET);
	}

	memcpy(value + offset, buf, len);

	return len;
}

static ssize_t read_status(struct bt_conn *conn,
			   const struct bt_gatt_attr *attr, void *buf,
			   u16_t len, u16_t offset)
{
	const char *value = attr->user_data;

	return bt_gatt_attr_read(conn, attr, buf, len, offset, value,
				 sizeof(status_value));
}

static void status_cfg_changed(const struct bt_gatt_attr *attr, u16_t value)
{
	status_notify = (value == BT_GATT_CCC_NOTIFY) ? 1 : 0;
}

/* AWS Service Declaration */
BT_GATT_SERVICE_DEFINE(
	aws_svc, BT_GATT_PRIMARY_SERVICE(&aws_svc_uuid),
	BT_GATT_CHARACTERISTIC(&aws_cliend_id_uuid.uuid, BT_GATT_CHRC_READ,
			       BT_GATT_PERM_READ, read_client_id, NULL,
			       client_id_value),
	BT_GATT_CHARACTERISTIC(&aws_endpoint_uuid.uuid, BT_GATT_CHRC_READ,
			       BT_GATT_PERM_READ, read_endpoint, NULL,
			       endpoint_value),
	BT_GATT_CHARACTERISTIC(&aws_root_ca_uuid.uuid, BT_GATT_CHRC_READ,
			       BT_GATT_PERM_READ, read_root_ca, NULL,
			       root_ca_value),
	BT_GATT_CHARACTERISTIC(&aws_client_cert_uuid.uuid, BT_GATT_CHRC_READ,
			       BT_GATT_PERM_READ, read_client_cert, NULL,
			       client_cert_value),
	BT_GATT_CHARACTERISTIC(&aws_client_key_uuid.uuid, BT_GATT_CHRC_READ,
			       BT_GATT_PERM_READ, read_client_key, NULL,
			       client_key_value),
	BT_GATT_CHARACTERISTIC(&aws_save_clear_uuid.uuid, BT_GATT_CHRC_WRITE,
			       BT_GATT_PERM_WRITE, NULL, write_save_clear,
			       &save_clear_value),
	BT_GATT_CHARACTERISTIC(&aws_status_uuid.uuid,
			       BT_GATT_CHRC_READ | BT_GATT_CHRC_NOTIFY,
			       BT_GATT_PERM_READ, read_status, NULL,
			       &status_value),
	BT_GATT_CCC(status_ccc_cfg, status_cfg_changed), );

void aws_svc_set_client_id(const char *id)
{
	if (id) {
		strncpy(client_id_value, id, sizeof(client_id_value));
	}
}

void aws_svc_set_endpoint(const char *ep)
{
	if (ep) {
		strncpy(endpoint_value, ep, sizeof(endpoint_value));
	}
}

void aws_svc_set_root_ca(const char *cred)
{
	if (cred) {
		strncpy(root_ca_value, cred, sizeof(root_ca_value));
	}
}

void aws_svc_set_client_cert(const char *cred)
{
	if (cred) {
		strncpy(client_cert_value, cred, sizeof(client_cert_value));
	}
}

void aws_svc_set_client_key(const char *cred)
{
	if (cred) {
		strncpy(client_key_value, cred, sizeof(client_key_value));
	}
}

void aws_svc_set_status(struct bt_conn *conn, enum aws_status status)
{
	bool notify = false;

	if (status != status_value) {
		notify = true;
		status_value = status;
	}
	if ((conn != NULL) && status_notify && notify) {
		bt_gatt_notify(conn, &aws_svc.attrs[14], &status,
			       sizeof(status));
	}
}

int aws_svc_init(const char *clientId)
{
	int rc;

	rc = nvReadAwsEndpoint(endpoint_value, sizeof(endpoint_value));
	if (rc <= 0) {
		/* Setting does not exist, init it */
		rc = nvStoreAwsEndpoint(AWS_DEFAULT_ENDPOINT,
					strlen(AWS_DEFAULT_ENDPOINT) + 1);
		if (rc <= 0) {
			AWS_SVC_LOG_ERR("Could not write AWS endpoint (%d)",
					rc);
			return AWS_SVC_ERR_INIT_ENDPOINT;
		}
		aws_svc_set_endpoint(AWS_DEFAULT_ENDPOINT);
	}
	awsSetEndpoint(endpoint_value);

	rc = nvReadAwsClientId(client_id_value, sizeof(client_id_value));
	if (rc <= 0) {
		/* Setting does not exist, init it */
		snprintk(client_id_value, sizeof(client_id_value), "%s_%s",
			 DEFAULT_MQTT_CLIENTID, clientId);

		rc = nvStoreAwsClientId(client_id_value,
					strlen(client_id_value) + 1);
		if (rc <= 0) {
			AWS_SVC_LOG_ERR("Could not write AWS client ID (%d)",
					rc);
			return AWS_SVC_ERR_INIT_CLIENT_ID;
		}
	}
	awsSetClientId(client_id_value);

	rc = nvReadAwsRootCa(root_ca_value, sizeof(root_ca_value));
	if (rc <= 0) {
		/* Setting does not exist, init it */
		rc = nvStoreAwsRootCa((u8_t *)aws_root_ca,
				      strlen(aws_root_ca) + 1);
		if (rc <= 0) {
			AWS_SVC_LOG_ERR("Could not write AWS client ID (%d)",
					rc);
			return AWS_SVC_ERR_INIT_CLIENT_ID;
		}
		aws_svc_set_root_ca(aws_root_ca);
	}
	awsSetRootCa(root_ca_value);

	rc = nvReadDevCert(client_cert_value, sizeof(client_cert_value));
	if (rc > 0) {
		isClientCertStored = true;
	}

	rc = nvReadDevKey(client_key_value, sizeof(client_key_value));
	if (rc > 0) {
		isClientKeyStored = true;
	}

	return AWS_SVC_ERR_NONE;
}

bool aws_svc_client_cert_is_stored(void)
{
	return isClientCertStored;
}

bool aws_svc_client_key_is_stored(void)
{
	return isClientKeyStored;
}

const char *aws_svc_get_client_cert(void)
{
	return (const char *)client_cert_value;
}

const char *aws_svc_get_client_key(void)
{
	return (const char *)client_key_value;
}

int aws_svc_save_clear_settings(bool save)
{
	int rc = 0;

	if (save) {
		rc = nvStoreAwsEndpoint(endpoint_value,
					strlen(endpoint_value) + 1);
		if (rc < 0) {
			goto exit;
		}
		rc = nvStoreAwsClientId(client_id_value,
					strlen(client_id_value) + 1);
		if (rc < 0) {
			goto exit;
		}
		rc = nvStoreAwsRootCa(root_ca_value, strlen(root_ca_value) + 1);
		if (rc < 0) {
			goto exit;
		}
		rc = nvStoreDevCert(client_cert_value,
				    strlen(client_cert_value) + 1);
		if (rc < 0) {
			goto exit;
		} else if (rc > 0) {
			isClientCertStored = true;
		}
		rc = nvStoreDevKey(client_key_value,
				   strlen(client_key_value) + 1);
		if (rc < 0) {
			goto exit;
		} else if (rc > 0) {
			isClientKeyStored = true;
		}
		AWS_SVC_LOG_INF("Saved AWS settings");
	} else {
		AWS_SVC_LOG_INF("Cleared AWS settings");
		nvDeleteAwsClientId();
		nvDeleteAwsEndpoint();
		nvDeleteAwsRootCa();
		nvDeleteDevCert();
		nvDeleteDevKey();
		isClientCertStored = true;
		isClientKeyStored = true;
	}
exit:
	return rc;
}
```
