## CMakeLists.txt
```
cmake_minimum_required(VERSION 3.13.1)
include($ENV{ZEPHYR_BASE}/cmake/app/boilerplate.cmake NO_POLICY_SCOPE)
project(regression_test)

FILE(GLOB app_sources src/*.c)
target_sources(app PRIVATE ${app_sources})
include_directories(${CMAKE_SOURCE_DIR}/include)

# Include git info in build
# Get the current working branch
execute_process(
  COMMAND git rev-parse --abbrev-ref HEAD
  WORKING_DIRECTORY ${CMAKE_SOURCE_DIR}
  OUTPUT_VARIABLE GIT_BRANCH
  OUTPUT_STRIP_TRAILING_WHITESPACE
)

# Get the latest abbreviated commit hash of the working branch
execute_process(
  COMMAND git log -1 --format=%h
  WORKING_DIRECTORY ${CMAKE_SOURCE_DIR}
  OUTPUT_VARIABLE GIT_COMMIT_HASH
  OUTPUT_STRIP_TRAILING_WHITESPACE
)

message(STATUS "Git current branch: ${GIT_BRANCH}")
message(STATUS "Git commit hash: ${GIT_COMMIT_HASH}")
message(STATUS "Generating version.h")

configure_file(
  ${CMAKE_SOURCE_DIR}/include/version.h.in
  ${CMAKE_BINARY_DIR}/generated/version.h
)

include_directories(${CMAKE_BINARY_DIR}/generated)
# END Include git info in build
```

## prj.conf
```kconfig
CONFIG_PRINTK=y

CONFIG_SHELL=y
CONFIG_KERNEL_SHELL=y
CONFIG_DEVICE_SHELL=y

# Networing
CONFIG_NET_SHELL=y

# turn on log system
CONFIG_LOG=y
CONFIG_MODEM_LOG_LEVEL_DBG=y

# disable HL7800 modem
CONFIG_MODEM_HL7800=n
```

## src/main.c
```c
/* main.c - Application main entry point */

#include <zephyr.h>
#include <misc/printk.h>
#include <version.h>
#include <gpio.h>
#include <shell/shell.h>
#include <shell/shell_uart.h>
#include <stdio.h>
#include "nrf.h"
#include "nrf_power.h"
#include "Bootloader_External_Settings.h"

#define GPREGRET_BOOTLOADER_UART_START_VALUE       0xb1
#define MAX_DATA_SIZE                              140
#define DISPLAY_NO_DATA                            '1'
#define DISPLAY_ASCII                              '2'
#define DISPLAY_HEX_BYTE_ENDIAN_FLIP               '3'
#define DISPLAY_HEX_QUAD_ENDIAN_FLIP               '4'

/* BOOTLOADER */
#define BOOTLOADER_STORAGE_FUNCTION_GET_ADDRESS    0xfc02b /* Address of function for loading settings from bootloader */
typedef int (*bootloader_function_get_t)(uint32_t nIndex, uint8_t nPartition, uint8_t nSubKey, uint8_t *pBuffer, uint32_t nBufferSize, uint32_t *pFullSettingSize, uint16_t *pFlags); /* Bootloader function for getting variables */

BootloaderExternalSettingsInfoStruct *pBootloaderExternalSettingsInfo;

static int ubldr_boot(const struct shell *shell, size_t argc, char **argv)
{
    ARG_UNUSED(argc);
    ARG_UNUSED(argv);

    //Enter UART bootloader: clear the current general purpose register and set it to the UART bootloader value
    nrf_power_gpregret_set(GPREGRET_BOOTLOADER_UART_START_VALUE);
    NVIC_SystemReset();

    return 0;
}

static int ubldr_get(const struct shell *shell, size_t argc, char **argv)
{
    ARG_UNUSED(argc);

    const u8_t *cmd = argv[1];

    uint32_t nCmdID = strtoul(cmd, NULL, 16);

    bootloader_function_get_t bldrload = (bootloader_function_get_t)BOOTLOADER_STORAGE_FUNCTION_GET_ADDRESS;

    uint16_t nFlags = 0;
    uint32_t nDataLen = 0;
    uint32_t resCode;
    resCode = bldrload(nCmdID, 0, 0, NULL, 0, &nDataLen, &nFlags);

    printk("  Ret: %d, Len: %d, Flg: %x, ", resCode, nDataLen, nFlags);
    if (argc > 2)
    {
        const u8_t *cmd = argv[2];
        if (cmd[0] == DISPLAY_NO_DATA)
        {
            printk("\r\n");
            return 0;
        }
    }

    if (resCode == 0)
    {
        uint8_t pData[nDataLen+1];
        uint8_t pDataDupe[(nDataLen*2)+1];
        resCode = bldrload(nCmdID, 0, 0, pData, nDataLen, NULL, NULL);

        pDataDupe[0] = 0;
        if (pData != NULL)
        {
            uint8_t i = 0;
            if (argc > 2)
            {
                const u8_t *cmd = argv[2];
                if (cmd[0] == DISPLAY_ASCII)
                {
                    printk("Data: %s", pData);
                }
                else
                {
                    while (i < nDataLen)
                    {
                        if (cmd[0] == DISPLAY_HEX_BYTE_ENDIAN_FLIP)
                        {
                            sprintf(pDataDupe, "%s%02X%02X", pDataDupe, pData[i+1], pData[i]);
                        }
                        else if (cmd[0] == DISPLAY_HEX_QUAD_ENDIAN_FLIP)
                        {
                            sprintf(pDataDupe, "%s%02X%02X", pDataDupe, pData[nDataLen-i-1], pData[nDataLen-i-2]);
                        }
                        else
                        {
                            sprintf(pDataDupe, "%s%02X%02X", pDataDupe, pData[i], pData[i+1]);
                        }

                        i += 2;
                    }
                    printk("Data: %s", pDataDupe);
                }
            }
            else
            {
                while (i < nDataLen)
                {
                    sprintf(pDataDupe, "%s%02X%02X", pDataDupe, pData[i], pData[i+1]);
                    i += 2;
                }
                printk("Data: %s", pDataDupe);
            }
        }
        else
        {
            printk("failed.");
        }
    }
    printk("  \r\n");

    return 0;
}

static int ubldr_getb(const struct shell *shell, size_t argc, char **argv)
{
    ARG_UNUSED(argc);

    const u8_t *cmd = argv[1];
    u8_t nPartition = strtoul(argv[2], NULL, 16);

    uint32_t nCmdID = strtoul(cmd, NULL, 16);

    bootloader_function_get_t bldrload = (bootloader_function_get_t)BOOTLOADER_STORAGE_FUNCTION_GET_ADDRESS;

    uint16_t nFlags = 0;
    uint32_t nDataLen = 0;
    uint32_t resCode;
    resCode = bldrload(nCmdID, nPartition, 0, NULL, 0, &nDataLen, &nFlags);

    printk("  Partition: %d, Ret: %d, Len: %d, Flg: %x, ", nPartition, resCode, nDataLen, nFlags);
    if (argc > 3)
    {
        const u8_t *cmd = argv[3];
        if (cmd[0] == DISPLAY_NO_DATA)
        {
            printk("\r\n");
            return 0;
        }
    }

    if (resCode == 0)
    {
        uint8_t pData[nDataLen+1];
        uint8_t pDataDupe[(nDataLen*2)+1];
        resCode = bldrload(nCmdID, nPartition, 0, pData, nDataLen, NULL, NULL);

        pDataDupe[0] = 0;
        if (pData != NULL)
        {
            uint8_t i = 0;
            if (argc > 3)
            {
                const u8_t *cmd = argv[3];
                if (cmd[0] == DISPLAY_ASCII)
                {
                    printk("Data: %s", pData);
                }
                else
                {
                    while (i < nDataLen)
                    {
                        if (cmd[0] == DISPLAY_HEX_BYTE_ENDIAN_FLIP)
                        {
                            sprintf(pDataDupe, "%s%02X%02X", pDataDupe, pData[i+1], pData[i]);
                        }
                        else if (cmd[0] == DISPLAY_HEX_QUAD_ENDIAN_FLIP)
                        {
                            sprintf(pDataDupe, "%s%02X%02X", pDataDupe, pData[nDataLen-i-1], pData[nDataLen-i-2]);
                        }
                        else
                        {
                            sprintf(pDataDupe, "%s%02X%02X", pDataDupe, pData[i], pData[i+1]);
                        }

                        i += 2;
                    }
                    printk("Data: %s", pDataDupe);
                }
            }
            else
            {
                while (i < nDataLen)
                {
                    sprintf(pDataDupe, "%s%02X%02X", pDataDupe, pData[i], pData[i+1]);
                    i += 2;
                }
                printk("Data: %s", pDataDupe);
            }
        }
        else
        {
            printk("failed.");
        }
    }
    printk("  \r\n");

    return 0;
}

static int ubldr_getinfo(const struct shell *shell, size_t argc, char **argv)
{
    ARG_UNUSED(argc);

    const u8_t *cmd = argv[1];
    u8_t nPartition = strtoul(argv[2], NULL, 16);

    uint32_t nCmdID = strtoul(cmd, NULL, 16);
    void *pDataAddr = NULL;
    uint32_t nDataSize = 0;
    uint8_t nTmpVal;
    uint8_t nOutputType;

//0 = numeric, decimal
//1 = numeric, hex
//2 = numeric, hex, 8 characters (32 bits)
//3 = byte array
//4 = string

    if (nCmdID == 0)
    {
        //Checksum
        pDataAddr = &pBootloaderExternalSettingsInfo->Checksum;
        nDataSize = sizeof(pBootloaderExternalSettingsInfo->Checksum);
        nOutputType = 2;
    }
    else if (nCmdID == 1)
    {
        //External function address
        pDataAddr = &pBootloaderExternalSettingsInfo->ExternalFunctionAddress;
        nDataSize = sizeof(pBootloaderExternalSettingsInfo->ExternalFunctionAddress);
        nOutputType = 2;
    }
    else if (nCmdID == 2)
    {
        //Header version
        pDataAddr = &pBootloaderExternalSettingsInfo->HeaderVersion;
        nDataSize = sizeof(pBootloaderExternalSettingsInfo->HeaderVersion);
        nOutputType = 0;
    }
    else if (nCmdID == 3)
    {
        //External function version
        pDataAddr = &pBootloaderExternalSettingsInfo->ExternalFunctionVersion;
        nDataSize = sizeof(pBootloaderExternalSettingsInfo->ExternalFunctionVersion);
        nOutputType = 0;
    }
    else if (nCmdID == 4)
    {
        //Header size
        pDataAddr = &pBootloaderExternalSettingsInfo->HeaderSize;
        nDataSize = sizeof(pBootloaderExternalSettingsInfo->HeaderSize);
        nOutputType = 2;
    }
    else if (nCmdID == 5)
    {
        //Build date
        pDataAddr = pBootloaderExternalSettingsInfo->BuildDate;
        nDataSize = sizeof(sizeof(__DATE__));
        nOutputType = 4;
    }
    else if (nCmdID == 6)
    {
        //Checksum type
        pDataAddr = &pBootloaderExternalSettingsInfo->ChecksumType;
        nDataSize = sizeof(pBootloaderExternalSettingsInfo->ChecksumType);
        nOutputType = 1;
    }
    else if (nCmdID == 5)
    {
        //Areas
        pDataAddr = &pBootloaderExternalSettingsInfo->Areas;
        nDataSize = sizeof(pBootloaderExternalSettingsInfo->Areas);
        nOutputType = 0;
    }

//NOTE: following will blindly use array ID even if it is not valid - regression testing ONLY!

    else if (nCmdID == 0x40)
    {
        //Area: Start address
        pDataAddr = &pBootloaderExternalSettingsInfo->AreaInfo[nPartition].StartAddress;
        nDataSize = sizeof(pBootloaderExternalSettingsInfo->AreaInfo[0].StartAddress);
        nOutputType = 2;
    }
    else if (nCmdID == 0x41)
    {
        //Area: Size
        pDataAddr = &pBootloaderExternalSettingsInfo->AreaInfo[nPartition].Size;
        nDataSize = sizeof(pBootloaderExternalSettingsInfo->AreaInfo[0].Size);
        nOutputType = 2;
    }
    else if (nCmdID == 0x42)
    {
        //Area: Checksum
        pDataAddr = &pBootloaderExternalSettingsInfo->AreaInfo[nPartition].Checksum;
        nDataSize = sizeof(pBootloaderExternalSettingsInfo->AreaInfo[0].Checksum);
        nOutputType = 2;
    }
    else if (nCmdID == 0x43)
    {
        //Area: Version
        pDataAddr = &pBootloaderExternalSettingsInfo->AreaInfo[nPartition].Version;
        nDataSize = sizeof(pBootloaderExternalSettingsInfo->AreaInfo[0].Version);
        nOutputType = 0;
    }
    else if (nCmdID == 0x44)
    {
        //Area: Type
        nTmpVal = pBootloaderExternalSettingsInfo->AreaInfo[nPartition].Type;
        pDataAddr = &nTmpVal;
        nDataSize = sizeof(nTmpVal);
        nOutputType = 0;
    }
    else if (nCmdID == 0x45)
    {
        //Area: Access
        nTmpVal = pBootloaderExternalSettingsInfo->AreaInfo[nPartition].Access;
        pDataAddr = &nTmpVal;
        nDataSize = sizeof(nTmpVal);
        nOutputType = 0;
    }
    else if (nCmdID == 0x46)
    {
        //Area: Signature type
        nTmpVal = pBootloaderExternalSettingsInfo->AreaInfo[nPartition].SignatureType;
        pDataAddr = &nTmpVal;
        nDataSize = sizeof(nTmpVal);
        nOutputType = 0;
    }
    else if (nCmdID == 0x47)
    {
        //Area: Signature
        pDataAddr = pBootloaderExternalSettingsInfo->AreaInfo[nPartition].Signature;
        nDataSize = SIGNATURE_SIZE;
        nOutputType = 3;
    }

    if (pDataAddr == NULL || nDataSize == 0)
    {
        //Nothing to output
        printk("  Cmd: %d, Area: %d, Ret: 1  \r\n", nCmdID, nPartition);
    }
    else
    {
        //Something to output
        printk("  Cmd: %d, Area: %d, Ret: 0, Len: %d, Data: ", nCmdID, nPartition, nDataSize);
        if (nOutputType == 0)
        {
            //Numeric, decimal
            if (nDataSize == 1)
            {
                printk("%d", *(uint8_t*)pDataAddr);
            }
            else if (nDataSize == 2)
            {
                printk("%d", *(uint16_t*)pDataAddr);
            }
            else
            {
                printk("%d", *(uint32_t*)pDataAddr);
            }
        }
        else if (nOutputType == 1)
        {
            //Numeric, hex
            if (nDataSize == 1)
            {
                printk("%x", *(uint8_t*)pDataAddr);
            }
            else if (nDataSize == 2)
            {
                printk("%x", *(uint16_t*)pDataAddr);
            }
            else
            {
                printk("%x", *(uint32_t*)pDataAddr);
            }
        }
        else if (nOutputType == 2)
        {
            //Numeric, hex, 8 characters (32 bit)
            if (nDataSize == 1)
            {
                printk("%08x", *(uint8_t*)pDataAddr);
            }
            else if (nDataSize == 2)
            {
                printk("%08x", *(uint16_t*)pDataAddr);
            }
            else
            {
                printk("%08x", *(uint32_t*)pDataAddr);
            }
        }
        else if (nOutputType == 3)
        {
            //Byte array
            uint8_t pDataDupe[(nDataSize*2)+1];
            uint32_t i = 0;
            pDataDupe[0] = 0;
            while (i < nDataSize)
            {
                sprintf(pDataDupe, "%s%02X%02X", pDataDupe, ((uint8_t*) pDataAddr)[i], ((uint8_t*)pDataAddr)[i+1]);
                i += 2;
            }
            printk("%s", pDataDupe);
        }
        else if (nOutputType == 4)
        {
            //String
            printk("%s", pDataAddr);
        }
    }

    printk("  \r\n");

    return 0;
}

SHELL_STATIC_SUBCMD_SET_CREATE(
    ubldr_cmds, SHELL_CMD(boot, NULL, "Boot into universal bootloader", ubldr_boot),
    SHELL_CMD_ARG(get, NULL, "Get universal bootloader info", ubldr_get,
                  2, 1),
    SHELL_CMD_ARG(getb, NULL, "Get extended universal bootloader info", ubldr_getb,
                  3, 1),
    SHELL_CMD_ARG(getinfo, NULL, "Get universal bootloader struct info", ubldr_getinfo,
                  2, 1),
    SHELL_SUBCMD_SET_END /* Array terminated. */
);
SHELL_CMD_REGISTER(ubldr, &ubldr_cmds, "Universal Bootloader commands", NULL);


void main(void)
{
    printk("Universal Bootloader Regression Test\r\nBranch: %s\r\nCommit: %s\r\nSystem up time %d us\r\n\r\n",
           GIT_BRANCH, GIT_COMMIT_HASH,
           SYS_CLOCK_HW_CYCLES_TO_NS(k_cycle_get_32()) / 1000);

    //Create sturct object at correct address
    pBootloaderExternalSettingsInfo = (uint32_t*)BOOTLOADER_EXTERNAL_STRUCT_ADDR;
}
```

## src/Bootloader_External_Settings.h
```c
/******************************************************************************
**              Copyright (C) 2019 Laird Connectivity
**
** Project:     Pinnacle 100 Bootloader
**
** Module:      Bootloader_External_Settings.h
**
** Notes:
*******************************************************************************/
#ifndef BOOTLOADER_EXTERNAL_SETTINGS_H__
#define BOOTLOADER_EXTERNAL_SETTINGS_H__

/******************************************************************************/
/* Include Files*/
/******************************************************************************/
//#include "target.h"
#define SIGNATURE_SIZE                                  64                             //Size (in bytes) of a signature


/******************************************************************************/
/* External Variable Declarations                                             */
/******************************************************************************/

//From linker: start address and size (not size of function itself) of bootloader storage section
//extern uint32_t __bootloader_storage_lookup_start__[];
//extern uint32_t __bootloader_storage_lookup_size__[];

/******************************************************************************/
/* Local Defines*/
/******************************************************************************/

#define BOOTLOADER_STORAGE_HEADER_INFO_VERSION                        1             //Version of the information struct header
#define BOOTLOADER_STORAGE_CODE_VERSION                               1             //Version of this part of the code

#define BL_INFO_HEADER_MAX_SIZE                                       320           //Total size of the information struct (including padding)
#define BL_INFO_HEADER_PADDING                                        52            //Padding of information struct, should be above value minus actual used size

//Indexes of WORM variables in the bootloader
#define BOOTLOADER_STORAGE_INDEX_LICENSE                              0x00000000
#define BOOTLOADER_STORAGE_INDEX_BT_ADDR                              0x00000001
#define BOOTLOADER_STORAGE_INDEX_CUSTOMER_PK_SET                      0x00000002
#define BOOTLOADER_STORAGE_INDEX_CUSTOMER_PK                          0x00000003
#define BOOTLOADER_STORAGE_INDEX_READBACK_PROTECTION                  0x00000004
#define BOOTLOADER_STORAGE_INDEX_CPU_DEBUG_PROTECTION                 0x00000005
#define BOOTLOADER_STORAGE_INDEX_BLOCK_UART_BLDR_READBACK             0x00000006
#define BOOTLOADER_STORAGE_INDEX_QSPI_MODE                            0x00000007
#define BOOTLOADER_STORAGE_INDEX_QSPI_CHECKED                         0x0000000a    //If the QSPI contents have been checked by the bootloader e.g. license is valid
#define BOOTLOADER_STORAGE_INDEX_QSPI_HEADER_CRC                      0x0000000b    //Checksum of the QSPI header contents, for checking it hasn't been altered
#define BOOTLOADER_STORAGE_INDEX_QSPI_HEADER_SHA256                   0x0000000c    //SHA256 hash of the QSPI header contents, for checking it hasn't been altered
#define BOOTLOADER_STORAGE_INDEX_QSPI_CUSTOMER_SPACE_START_OFFSET     0x0000000d    //Starting QSPI sectors for use by customers
#define BOOTLOADER_STORAGE_INDEX_QSPI_CUSTOMER_SPACE_START_SECTOR     0x0000000e    //
#define BOOTLOADER_STORAGE_INDEX_QSPI_CUSTOMER_SPACE_SECTORS          0x0000000f    //
#define BOOTLOADER_STORAGE_INDEX_QSPI_CUSTOMER_SPACE_SECTOR_SIZE      0x00000010    //
#define BOOTLOADER_STORAGE_INDEX_SECTION_VERSION                      0x00000020
#ifdef BOOTLOADER_STORAGE_FOR_CUSTOMER_WORM
#define BOOTLOADER_STORAGE_INDEX_CUSTOMER_REG32                       0x00000041
#define BOOTLOADER_STORAGE_INDEX_CUSTOMER_REG64                       0x00000042
#define BOOTLOADER_STORAGE_INDEX_CUSTOMER_REG128                      0x00000043
#endif

//For DFU queries over UART
#define BOOTLOADER_STORAGE_INDEX_CODE_FUNCTION_VERSION_DFU_QUERY      0xff
#define BOOTLOADER_STORAGE_INDEX_CODE_STRUCT_VERSION_DFU_QUERY        0xfe

//
#define BOOTLOADER_STORAGE_INDEX_CHECKSUM_DFU_QUERY                   0x00
#define BOOTLOADER_STORAGE_INDEX_FUNCTION_ADDRESS_DFU_QUERY           0x01
#define BOOTLOADER_STORAGE_INDEX_HEADER_VERSION_DFU_QUERY             0x02
#define BOOTLOADER_STORAGE_INDEX_BUILD_DATE_DFU_QUERY                 0x03
#define BOOTLOADER_STORAGE_INDEX_HEADER_SIZE_DFU_QUERY                0x04
#define BOOTLOADER_STORAGE_INDEX_CHECKSUM_TYPE_DFU_QUERY              0x05
#define BOOTLOADER_STORAGE_INDEX_AREAS_DFU_QUERY                      0x06
#define BOOTLOADER_STORAGE_INDEX_AREA_INFO_START_DFU_QUERY            0x40
#define BOOTLOADER_STORAGE_INDEX_AREA_INFO_ADDRESS_DFU_QUERY          0x00
#define BOOTLOADER_STORAGE_INDEX_AREA_INFO_SIZE_DFU_QUERY             0x01
#define BOOTLOADER_STORAGE_INDEX_AREA_INFO_CHECKSUM_DFU_QUERY         0x02
#define BOOTLOADER_STORAGE_INDEX_AREA_INFO_VERSION_DFU_QUERY          0x03
#define BOOTLOADER_STORAGE_INDEX_AREA_INFO_TYPE_DFU_QUERY             0x04
#define BOOTLOADER_STORAGE_INDEX_AREA_INFO_ACCESS_DFU_QUERY           0x05
#define BOOTLOADER_STORAGE_INDEX_AREA_INFO_SIGNATURE_TYPE_DFU_QUERY   0x06
#define BOOTLOADER_STORAGE_INDEX_AREA_INFO_SIGNATURE_DFU_QUERY        0x07
#define BOOTLOADER_STORAGE_AREA_INFO_PARTITION_BITS                   0xf0
#define BOOTLOADER_STORAGE_AREA_INFO_PARTITION_SHIFT_BITS             4
#define BOOTLOADER_STORAGE_AREA_INFO_QUERY_BITS                       0x0f

//Result codes for the bootloader storage retrieval function
enum BOOTLOADER_STORAGE_CODES
{
    BOOTLOADER_STORAGE_CODE_SUCCESS                                   = 0,
    BOOTLOADER_STORAGE_CODE_INVALID_ID                                = 5,
    BOOTLOADER_STORAGE_CODE_NOT_PRESENT                               = 6,
    BOOTLOADER_STORAGE_CODE_DISCREPANCY_DETECTED                      = 7,
    BOOTLOADER_STORAGE_CODE_INVALID_PARTITION                         = 8,
    BOOTLOADER_STORAGE_CODE_INVALID_SUB_ID                            = 9,
};

//Types of variables returned
#define BOOTLOADER_STORAGE_FLAG_NUMERIC_LITTLE_ENDIAN                 0b1           //Little endian number
#define BOOTLOADER_STORAGE_FLAG_NUMERIC_BIG_ENDIAN                    0b10          //Big endian number (not used)
#define BOOTLOADER_STORAGE_FLAG_BYTE_ARRAY                            0b100         //Byte array
#define BOOTLOADER_STORAGE_FLAG_BYTE_ARRAY_16                         0b1000        //Byte array but 16-bit shifts, basically used for license
#define BOOTLOADER_STORAGE_FLAG_STRING_NOT_TERMINATED                 0b10000       //String without any termination character (not used)
#define BOOTLOADER_STORAGE_FLAG_STRING_NULL_TERMINATED                0b100000      //String with null termination character (not used)

//Start address of where the bootloader settings are stored
#define BOOTLOADER_STORAGE_MEMORY_START_ADDR                          BOOTLOADER_BACKUP_SETTINGS_ADDRESS
#define BOOTLOADER_EXTERNAL_STRUCT_ADDR                               0xfcec0

/******************************************************************************/
/* Local Forward Class,Struct & Union Declarations*/
/******************************************************************************/

enum BL_INFO_SECTION_TYPES
{
    BL_INFO_SECTION_TYPE_MBR = 0,
    BL_INFO_SECTION_TYPE_BOOTLOADER,
    BL_INFO_SECTION_TYPE_EXTERNAL_FUNCTION,

    BL_INFO_SECTION_TYPE_MAX
};

enum BL_INFO_ACCESS_TYPES
{
    BL_INFO_ACCESS_TYPE_NONE = 0,
    BL_INFO_ACCESS_TYPE_READ = 1,
    BL_INFO_ACCESS_TYPE_WRITE = 2,
    BL_INFO_ACCESS_TYPE_EXECUTE = 4
};

enum BL_INFO_SIGNATURE_TYPES
{
    BL_INFO_SIGNATURE_TYPE_INVALID = 0,
    BL_INFO_SIGNATURE_TYPE_BOOTLOADER_KEY
};

enum BL_INFO_CHECKSUM_TYPES
{
    BL_INFO_CHECKSUM_TYPE_NORDIC_CRC16 = 0,
    BL_INFO_CHECKSUM_TYPE_NORDIC_CRC32,
    BL_INFO_CHECKSUM_TYPE_RESERVED,
    BL_INFO_CHECKSUM_TYPE_LAIRD_CRC32
};

//This structure holds information on an area
typedef struct
{
    uint32_t                 StartAddress;                           //Start address of area
    uint32_t                 Size;                                   //Size of area
    uint32_t                 Checksum;                               //CRC32 of area
    uint16_t                 Version;                                //Version of area
    uint8_t                  Type : 3;                               //Type of area
    uint8_t                  Access : 3;                             //Access e.g. if read access is allowed after bootloader has finished booting
    uint8_t                  SignatureType : 2;                      //Type of signature
    uint8_t                  Signature[SIGNATURE_SIZE];              //Signature of area

} BootloaderAreaInfoStruct;

//This structure holds information on the external settings function
typedef struct
{
    uint32_t                 Checksum;                               //CRC32 of this data
    uint32_t                 ExternalFunctionAddress;                //Address of function
    uint16_t                 HeaderVersion;                          //Version of this data
    uint16_t                 ExternalFunctionVersion;                //Version of function
    uint16_t                 HeaderSize;                             //Size of data in this header
    char                     BuildDate[sizeof(__DATE__)];            //Build date
    uint8_t                  ChecksumType;                           //Type of checksums used in this header
    uint8_t                  Areas;                                  //Number of areas in this section
    BootloaderAreaInfoStruct AreaInfo[BL_INFO_SECTION_TYPE_MAX];     //Information on each section

    uint8_t                  RESERVED_8[BL_INFO_HEADER_PADDING];     //For future use, padding for a total of 384 bytes
} BootloaderExternalSettingsInfoStruct;

/******************************************************************************/
/* Local Functions or Private Members*/
/******************************************************************************/

/*=============================================================================*/
// Typedef for external settings function for external applications
/*=============================================================================*/
//typedef uint8_t (*bootloader_function_setting_t)(uint32_t nIndex, uint8_t nPartition, uint8_t nSubKey, uint8_t *pBuffer, uint32_t nBufferSize, uint32_t *pFullSettingSize, uint16_t *pFlags);

/*=============================================================================*/
// Returns data from the bootloader settings area
/*=============================================================================*/
//__attribute__((section(".bootloader_storage_lookup"))) __attribute__((used))
//uint8_t
//GetBootloaderSetting(
//    uint32_t nIndex,
//    uint8_t nPartition,
//    uint8_t nSubKey,
//    uint8_t *pBuffer,
//    uint32_t nBufferSize,
//    uint32_t *pFullSettingSize,
//    uint16_t *pFlags
//    );

/*=============================================================================*/
/* External Bootloader function which is used to do a memcpy without external  */
/* function calls to code that might be read/execute protected                 */
/*=============================================================================*/
//__attribute__((section(".bootloader_storage_lookup"))) __attribute__((used))
//static
//void
//ExternalMemCpy(
//    void *pDest,
//    void *pSrc,
//    uint32_t nSize
//    );

/*=============================================================================*/
/* External Bootloader function which is used to do a memory erase check       */
/* without external function calls to code that might be read/execute          */
/* protected                                                                   */
/*=============================================================================*/
//__attribute__((section(".bootloader_storage_lookup"))) __attribute__((used))
//static
//bool
//ExternalCheckIfMemoryRegionErased(
//    uint8_t *pAddr,
//    uint8_t nLen
//    );

//extern __attribute__((section(".bootloader_storage_lookup_struct"))) __attribute__((used)) BootloaderExternalSettingsInfoStruct pBootloaderExternalSettingsInfo;

#endif
/******************************************************************************/
/* END OF FILE*/
/******************************************************************************/
```
