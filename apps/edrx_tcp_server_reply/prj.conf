## CMakeLists.txt
```
# Copyright (c) 2020 Laird Connectivity
# SPDX-License-Identifier: Apache-2.0

cmake_minimum_required(VERSION 3.13.1)
find_package(Zephyr REQUIRED HINTS $ENV{ZEPHYR_BASE})
project(edrx_tcp_server_reply)

FILE(GLOB app_sources src/*.c)
target_sources(app PRIVATE 
    ${app_sources}
    ${CMAKE_SOURCE_DIR}/../../common/src/lte.c
    ${CMAKE_SOURCE_DIR}/../../common/src/led.c)
include_directories(${CMAKE_SOURCE_DIR}/include)
include_directories(${CMAKE_SOURCE_DIR}/../../common/include)
```

## prj.conf
```kconfig
# Copyright (c) 2020 Laird Connectivity
# SPDX-License-Identifier: Apache-2.0

# CONFIG_FLASH_LOAD_OFFSET=0x0
CONFIG_MAIN_STACK_SIZE=4096

CONFIG_NEWLIB_LIBC=y

# CONFIG_SHELL=y
# CONFIG_KERNEL_SHELL=y
# CONFIG_INIT_STACKS=y

# Networking
CONFIG_NET_MGMT=y
CONFIG_NET_MGMT_EVENT=y
# Enable the DNS resolver
CONFIG_DNS_RESOLVER=y
# enable TCP
CONFIG_NET_TCP=y
CONFIG_NET_SOCKETS=y
CONFIG_NET_SOCKETS_POSIX_NAMES=y

# modem settings
CONFIG_MODEM_LOG_LEVEL_DBG=y
# CONFIG_MODEM_HL7800_BAND_1=n
# CONFIG_MODEM_HL7800_BAND_2=n
# CONFIG_MODEM_HL7800_BAND_3=n
# CONFIG_MODEM_HL7800_BAND_4=n
# CONFIG_MODEM_HL7800_BAND_5=n
# CONFIG_MODEM_HL7800_BAND_8=n
# CONFIG_MODEM_HL7800_BAND_9=n
# CONFIG_MODEM_HL7800_BAND_10=n
# CONFIG_MODEM_HL7800_BAND_12=n
# CONFIG_MODEM_HL7800_BAND_13=n
# CONFIG_MODEM_HL7800_BAND_14=n
# CONFIG_MODEM_HL7800_BAND_17=n
# CONFIG_MODEM_HL7800_BAND_18=n
# CONFIG_MODEM_HL7800_BAND_19=n
# CONFIG_MODEM_HL7800_BAND_20=y
# CONFIG_MODEM_HL7800_BAND_25=n
# CONFIG_MODEM_HL7800_BAND_26=n
# CONFIG_MODEM_HL7800_BAND_27=n
# CONFIG_MODEM_HL7800_BAND_28=n
# CONFIG_MODEM_HL7800_BAND_66=n
# modem low power
CONFIG_MODEM_HL7800_LOW_POWER_MODE=y
CONFIG_MODEM_HL7800_EDRX=y

# Logging
CONFIG_LOG=y
CONFIG_LOG_BUFFER_SIZE=10240
CONFIG_LOG_STRDUP_MAX_STRING=256
CONFIG_LOG_STRDUP_BUF_COUNT=64

# Debug
# CONFIG_NO_OPTIMIZATIONS=y
# CONFIG_DEBUG_OPTIMIZATIONS=y
# enable to use thread names
CONFIG_THREAD_NAME=y
CONFIG_SEGGER_SYSTEMVIEW=y
CONFIG_USE_SEGGER_RTT=y
```

## src/main.c
```c
/*
 * Copyright (c) 2020 Laird Connectivity
 *
 * SPDX-License-Identifier: Apache-2.0
 */

#include <zephyr.h>
#include <power/power.h>
#include <string.h>
#include <net/socket.h>
#define LOG_LEVEL CONFIG_LOG_DEFAULT_LEVEL
#include <logging/log.h>
LOG_MODULE_REGISTER(edrx_tcp);

#include "config.h"
#include "led.h"
#include "lte.h"

K_SEM_DEFINE(lte_event_sem, 0, 1);

static enum lte_event lte_status = LTE_EVT_DISCONNECTED;
static char response[128];

static void lteEvent(enum lte_event event)
{
	lte_status = event;
	k_sem_give(&lte_event_sem);
}

static int tcp_connection()
{
	int ret, len, sock = 0;
	struct sockaddr_in dest;

	sock = socket(AF_INET, SOCK_STREAM, IPPROTO_TCP);
	if (sock < 0) {
		LOG_ERR("creating socket failed");
		return 1;
	}

	dest.sin_family = AF_INET;
	ret = net_addr_pton(AF_INET, SERVER_IP_ADDR, &dest.sin_addr);
	if (ret < 0) {
		LOG_ERR("setting dest IP addr failed (%d)", ret);
		return ret;
	}
	dest.sin_port = htons(SERVER_PORT);

	ret = connect(sock, (struct sockaddr *)&dest, sizeof(dest));
	if (ret < 0) {
		LOG_ERR("connect socket failed (%d)", ret);
		return ret;
	}

	while (true) {
		LOG_INF("Receiving data...");
		len = recv(sock, response, sizeof(response) - 1, 0);

		if (len == -EAGAIN) {
			LOG_ERR("RX timeout (%d)", len);
			break;
		} else if (len == -EWOULDBLOCK) {
			LOG_ERR("RX EWOULDBLOCK (%d)", len);
			break;
		} else if (len < 0) {
			LOG_ERR("RX unknown err (%d)", len);
			break;
		} else if (len == 0) {
			/* socket shutdown properly */
			LOG_INF("Socket closed");
			break;
		}

		response[len] = 0;
		LOG_INF("RX: %s", response);
	}

	close(sock);
	return ret;
}

/* Application main Thread */
void main(void)
{
	LOG_INF("*** eDRX TCP Server Reply test on %s ***", CONFIG_BOARD);

	led_init();

	/* init LTE */
	lteRegisterEventCallback(lteEvent);
	int rc = lteInit();
	if (rc < 0) {
		LOG_INF("LTE init (%d)", rc);
		goto exit;
	}

	if (!lteIsReady()) {
		while (lte_status != LTE_EVT_READY) {
			/* Wait for LTE read evt */
			k_sem_reset(&lte_event_sem);
			LOG_INF("Waiting for LTE to be ready...");
			k_sem_take(&lte_event_sem, K_FOREVER);
		}
	}
	LOG_INF("LTE ready!");

	while (1) {
		tcp_connection();
		LOG_INF("App sleeping for %d seconds", SLEEP_TIME_SECONDS);
		k_sleep(K_SECONDS(SLEEP_TIME_SECONDS));
	}
exit:
	LOG_ERR("Exiting main()");
	return;
}
```

## include/config.h
```c
/*
 * Copyright (c) 2020 Laird Connectivity
 *
 * SPDX-License-Identifier: Apache-2.0
 */

#ifndef CONFIG_H
#define CONFIG_H

#define SLEEP_TIME_SECONDS 60
#define SERVER_IP_ADDR "18.232.90.30"
#define SERVER_PORT 50000

#endif
```
