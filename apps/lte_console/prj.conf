## CMakeLists.txt
```
# Copyright (c) 2020-2023 Laird Connectivity
# SPDX-License-Identifier: Apache-2.0

cmake_minimum_required(VERSION 3.20.0)

find_package(Zephyr REQUIRED HINTS $ENV{ZEPHYR_BASE})
project(LTE_Console)

FILE(GLOB app_sources src/*.c)
target_sources(app PRIVATE
  ${app_sources}
  ${CMAKE_SOURCE_DIR}/../../common/src/led.c
)

include_directories(${CMAKE_SOURCE_DIR}/include)
include_directories(${CMAKE_SOURCE_DIR}/../../common/include)

# Include git info in build
# Get the current working branch
execute_process(
  COMMAND git rev-parse --abbrev-ref HEAD
  WORKING_DIRECTORY ${CMAKE_SOURCE_DIR}
  OUTPUT_VARIABLE GIT_BRANCH
  OUTPUT_STRIP_TRAILING_WHITESPACE
)

# Get the latest abbreviated commit hash of the working branch
execute_process(
  COMMAND git log -1 --format=%h
  WORKING_DIRECTORY ${CMAKE_SOURCE_DIR}
  OUTPUT_VARIABLE GIT_COMMIT_HASH
  OUTPUT_STRIP_TRAILING_WHITESPACE
)

message(STATUS "Git current branch: ${GIT_BRANCH}")
message(STATUS "Git commit hash: ${GIT_COMMIT_HASH}")
message(STATUS "Generating version.h")

configure_file(
  ${CMAKE_SOURCE_DIR}/include/version.h.in
  ${CMAKE_BINARY_DIR}/generated/version.h
)

include_directories(${CMAKE_BINARY_DIR}/generated)
# END Include git info in build
```

## prj.conf
```kconfig
# Copyright (c) 2020-2023 Laird Connectivity
# SPDX-License-Identifier: Apache-2.0

# CONFIG_NO_OPTIMIZATIONS=y
# CONFIG_DEBUG_OPTIMIZATIONS=y

CONFIG_MAIN_STACK_SIZE=2048
CONFIG_HEAP_MEM_POOL_SIZE=4096

CONFIG_THREAD_NAME=y
CONFIG_THREAD_MONITOR=y
CONFIG_INIT_STACKS=y

CONFIG_SHELL=y
CONFIG_SHELL_WILDCARD=n
CONFIG_KERNEL_SHELL=y
CONFIG_DEVICE_SHELL=y
CONFIG_FILE_SYSTEM_SHELL=y

# turn on log system
CONFIG_LOG=y
# extra logging buffer for better debug
CONFIG_LOG_BUFFER_SIZE=10240

# modem settings
CONFIG_MODEM=y
CONFIG_MODEM_HL7800=y
CONFIG_MODEM_HL7800_FW_UPDATE=y
CONFIG_MODEM_LOG_LEVEL_DBG=y
CONFIG_MODEM_HL7800_RAT_M1=y
# modem bands
CONFIG_MODEM_HL7800_CONFIGURE_BANDS=n
# CONFIG_MODEM_HL7800_BAND_1=n
# CONFIG_MODEM_HL7800_BAND_2=n
# CONFIG_MODEM_HL7800_BAND_3=n
# CONFIG_MODEM_HL7800_BAND_4=n
# CONFIG_MODEM_HL7800_BAND_5=n
# CONFIG_MODEM_HL7800_BAND_8=n
# CONFIG_MODEM_HL7800_BAND_9=n
# CONFIG_MODEM_HL7800_BAND_10=n
# CONFIG_MODEM_HL7800_BAND_12=n
# CONFIG_MODEM_HL7800_BAND_13=n
# CONFIG_MODEM_HL7800_BAND_14=n
# CONFIG_MODEM_HL7800_BAND_17=n
# CONFIG_MODEM_HL7800_BAND_18=n
# CONFIG_MODEM_HL7800_BAND_19=n
# CONFIG_MODEM_HL7800_BAND_20=y
# CONFIG_MODEM_HL7800_BAND_25=n
# CONFIG_MODEM_HL7800_BAND_26=n
# CONFIG_MODEM_HL7800_BAND_27=n
# CONFIG_MODEM_HL7800_BAND_28=n
# CONFIG_MODEM_HL7800_BAND_66=n
# CONFIG_MODEM_HL7800_LOW_POWER_MODE=y
# CONFIG_MODEM_HL7800_EDRX=y
# CONFIG_MODEM_HL7800_PSM=y
# CONFIG_MODEM_HL7800_PSM_PERIODIC_TAU="10100010" # 2 minutes
# CONFIG_MODEM_HL7800_PSM_ACTIVE_TIME="00001111" # 30 seconds

# Networking
CONFIG_NETWORKING=y
CONFIG_NET_IPV4=y
CONFIG_NET_IPV6=y
CONFIG_NET_SOCKETS=y
CONFIG_NET_TCP=y
CONFIG_NET_SHELL=y

# Enable the DNS resolver
CONFIG_DNS_RESOLVER=y
CONFIG_NET_SOCKETS_DNS_TIMEOUT=20000

CONFIG_LCZ=y
CONFIG_LCZ_LED=y
```

## src/main.c
```c
/*
 * Copyright (c) 2020-2023 Laird Connectivity
 *
 * SPDX-License-Identifier: Apache-2.0
 */

/**************************************************************************************************/
/* Includes                                                                                       */
/**************************************************************************************************/
#include <zephyr/logging/log.h>
LOG_MODULE_REGISTER(lte_console, LOG_LEVEL_DBG);

#include <stdlib.h>

#include <zephyr/drivers/gpio.h>
#include <zephyr/shell/shell.h>
#include <zephyr/shell/shell_uart.h>
#include <zephyr/kernel.h>
#ifdef CONFIG_MODEM_HL7800
#include <zephyr/drivers/modem/hl7800.h>
#endif

#include "led.h"
#include "version.h"

/**************************************************************************************************/
/* Local Constant, Macro and Type Definitions                                                     */
/**************************************************************************************************/

#define HEARTBEAT_INTERVAL K_SECONDS(2)
#define APN_MSG		   "APN: [%s]"

/**************************************************************************************************/
/* Local Data Definitions                                                                         */
/**************************************************************************************************/
static struct mdm_hl7800_apn *lte_apn_config;
static struct mdm_hl7800_callback_agent hl7800_evt_agent;

static struct lcz_led_blink_pattern heartbeat_pattern = {
	.on_time = 30, .off_time = 75, .repeat_count = 2};

/**************************************************************************************************/
/* Local Function Definitions                                                                     */
/**************************************************************************************************/

#ifdef CONFIG_MODEM_HL7800

static int shell_hl_apn_cmd(const struct shell *shell, size_t argc, char **argv)
{
	int rc = 0;

	size_t val_len;

	if (argc == 2) {
		/* set the value */
		val_len = strlen(argv[1]);
		if (val_len > MDM_HL7800_APN_MAX_SIZE) {
			rc = -EINVAL;
			shell_error(shell, "APN too long [%d]", val_len);
			goto done;
		}

		rc = mdm_hl7800_update_apn(argv[1]);
		if (rc >= 0) {
			shell_print(shell, APN_MSG, argv[1]);
		} else {
			shell_error(shell, "Could not set APN [%d]", rc);
		}
	} else if (argc == 1) {
		/* read the value */
		shell_print(shell, APN_MSG, lte_apn_config->value);
	} else {
		shell_error(shell, "Invalid param");
		rc = -EINVAL;
	}
done:
	return rc;
}

static int shell_hl_iccid_cmd(const struct shell *shell, size_t argc, char **argv)
{
	int rc = 0;

	shell_print(shell, "%s", mdm_hl7800_get_iccid());

	return rc;
}

static int shell_hl_imei_cmd(const struct shell *shell, size_t argc, char **argv)
{
	int rc = 0;

	shell_print(shell, "%s", mdm_hl7800_get_imei());

	return rc;
}

static int shell_hl_pwr_off(const struct shell *shell, size_t argc, char **argv)
{
	ARG_UNUSED(argc);
	ARG_UNUSED(argv);

	return mdm_hl7800_power_off();
}

static int shell_hl_reset(const struct shell *shell, size_t argc, char **argv)
{
	ARG_UNUSED(argc);
	ARG_UNUSED(argv);

	return mdm_hl7800_reset();
}

static int hl7800_wake(const struct shell *shell, size_t argc, char **argv)
{
	ARG_UNUSED(argc);

	int val = strtol(argv[1], NULL, 10);
	mdm_hl7800_wakeup(val);

	return 0;
}

static int shell_hl_send_at_cmd(const struct shell *shell, size_t argc, char **argv)
{
	int rc = 0;

	if ((argc == 2) && (argv[0] != NULL) && (argv[1] != NULL)) {
		rc = mdm_hl7800_send_at_cmd(argv[1]);
		if (rc < 0) {
			shell_error(shell, "Command not accepted");
		}
	} else {
		shell_error(shell, "Wrong number of parameters");

		rc = -EINVAL;
	}

	return rc;
}

#ifdef CONFIG_MODEM_HL7800_FW_UPDATE
static int shell_hl_fup_cmd(const struct shell *shell, size_t argc, char **argv)
{
	int rc = 0;

	if ((argc == 2) && (argv[1] != NULL)) {
		rc = mdm_hl7800_update_fw(argv[1]);
		if (rc < 0) {
			shell_error(shell, "Command error");
		}
	} else {
		shell_error(shell, "Invalid parameter");
		rc = -EINVAL;
	}

	return rc;
}
#endif

static int shell_hl_sn_cmd(const struct shell *shell, size_t argc, char **argv)
{
	int rc = 0;

	shell_print(shell, "%s", mdm_hl7800_get_sn());

	return rc;
}

static int shell_hl_ver_cmd(const struct shell *shell, size_t argc, char **argv)
{
	int rc = 0;

	shell_print(shell, "%s", mdm_hl7800_get_fw_version());

	return rc;
}

static int shell_hl_site_survey_cmd(const struct shell *shell, size_t argc, char **argv)
{
	int rc = 0;

	shell_print(shell, "survey status: %d", mdm_hl7800_perform_site_survey());

	/* Results are printed to shell by lte.site_survey_handler() */

	return rc;
}

static void hl7800_event_callback(enum mdm_hl7800_event event, void *event_data)
{
	switch (event) {
	case HL7800_EVENT_APN_UPDATE:
		lte_apn_config = (struct mdm_hl7800_apn *)event_data;
		break;
	default:
		break;
	}
}

/**************************************************************************************************/
/* Global Function Definitions                                                                    */
/**************************************************************************************************/

SHELL_STATIC_SUBCMD_SET_CREATE(
	hl_cmds, SHELL_CMD(apn, NULL, "HL7800 APN", shell_hl_apn_cmd),
	SHELL_CMD_ARG(cmd, NULL,
		      "Send AT command (only for advanced debug)"
		      "hl cmd <at command>",
		      shell_hl_send_at_cmd, 2, 0),
#ifdef CONFIG_MODEM_HL7800_FW_UPDATE
	SHELL_CMD_ARG(fup, NULL, "Update HL7800 firmware", shell_hl_fup_cmd, 2, 0),
#endif
	SHELL_CMD(iccid, NULL, "HL7800 SIM card ICCID", shell_hl_iccid_cmd),
	SHELL_CMD(imei, NULL, "HL7800 IMEI", shell_hl_imei_cmd),
	SHELL_CMD(pwr_off, NULL, "Power off HL7800", shell_hl_pwr_off),
	SHELL_CMD(reset, NULL, "Reset HL7800", shell_hl_reset),
	SHELL_CMD(sn, NULL, "HL7800 serial number", shell_hl_sn_cmd),
	SHELL_CMD(survey, NULL, "HL7800 site survey", shell_hl_site_survey_cmd),
	SHELL_CMD(ver, NULL, "HL7800 firmware version", shell_hl_ver_cmd),
	SHELL_CMD_ARG(wake, NULL, "Wake/Sleep HL7800", hl7800_wake, 2, 0),

	SHELL_SUBCMD_SET_END /* Array terminated. */
);
SHELL_CMD_REGISTER(hl, &hl_cmds, "HL7800 commands", NULL);
#endif /* CONFIG_MODEM_HL7800 */

int main(void)
{
	LOG_INF("Pinnacle 100 LTE Console %d.%d.%d\r\n"
		"Branch: %s\r\n"
		"Commit: %s\r\n",
		APP_MAJOR, APP_MINOR, APP_PATCH, GIT_BRANCH, GIT_COMMIT_HASH);

#ifdef CONFIG_MODEM_HL7800
	hl7800_evt_agent.event_callback = hl7800_event_callback;
	mdm_hl7800_register_event_callback(&hl7800_evt_agent);
	mdm_hl7800_generate_status_events();
#endif

	while (1) {
		lcz_led_blink(GREEN_LED, &heartbeat_pattern, true);

		k_sleep(HEARTBEAT_INTERVAL);
	}

	return -1;
}
```

## include/app_bt.h
```c
#ifndef APP_BT_H
#define APP_BT_H

#define ADVERT_BUTTON_PORT      SW1_GPIO_CONTROLLER
#define ADVERT_BUTTON           SW1_GPIO_PIN
#define ADVERT_LED_PORT         LED2_GPIO_CONTROLLER
#define ADVERT_LED              LED2_GPIO_PIN
#define LED_OFF     0
#define LED_ON      1

void app_bt_thread();

#endif
```

## include/app_led.h
```c
/*
 * Copyright (c) 2020 Laird Connectivity
 *
 * SPDX-License-Identifier: Apache-2.0
 */

#ifndef APP_LED_H
#define APP_LED_H

#define LED_OFF 0
#define LED_ON 1

#define LED1_NODE DT_ALIAS(led0)
#define LED2_NODE DT_ALIAS(led1)
#define LED3_NODE DT_ALIAS(led2)
#define LED4_NODE DT_ALIAS(led3)

#define LED1_DEV DT_GPIO_LABEL(LED1_NODE, gpios)
#define LED1 DT_GPIO_PIN(LED1_NODE, gpios)
#define LED2_DEV DT_GPIO_LABEL(LED2_NODE, gpios)
#define LED2 DT_GPIO_PIN(LED2_NODE, gpios)
#define LED3_DEV DT_GPIO_LABEL(LED3_NODE, gpios)
#define LED3 DT_GPIO_PIN(LED3_NODE, gpios)
#define LED4_DEV DT_GPIO_LABEL(LED4_NODE, gpios)
#define LED4 DT_GPIO_PIN(LED4_NODE, gpios)

#define BLUE_LED LED1
#define BLUE_LED_DEV LED1_DEV
#define GREEN1_LED LED2
#define GREEN1_LED_DEV LED2_DEV
#define RED_LED LED3
#define RED_LED_DEV LED3_DEV
#define GREEN2_LED LED4
#define GREEN2_LED_DEV LED4_DEV

#define HEARTBEAT_LED GREEN1_LED
#define HEARTBEAT_ON_TIME K_MSEC(25)
#define HEARTBEAT_OFF_TIME K_MSEC(50)

/**
 *  Init the LEDs for the board
 */
void led_init(void);

/**
 * This will flash the heart beat LED twice.
 * This function will block for the amount of time it takes to flash the LED
 */
void ledHeartBeat(void);

#endif
```

## include/console_rx.h
```c
#ifndef CONSOLE_RX_H
#define CONSOLE_RX_H

#define MAX_CMD_SIZE    256

#define CMD_R           'r'
#define CMD_W           'w'
#define CMD_S           's'
#define CMD_B           'b'

#define GPREGRET_ENTER_BOOTLOADER 0xb1

#define CMD_RESP_OK          "\n#"

#endif
```

## include/hl7800.h
```c
#ifndef HL7800_H
#define HL7800_H

#define SIO_LTE_IO_CONTROLLER "GPIO_1"
#define SIO_LTE_RESET 15      //M2.71
#define SIO_LTE_WAKE 13       //M2.48
#define SIO_LTE_POWER_ON 2    //M2.67
#define SIO_LTE_TX_ON 3       //M2.44
#define SIO_LTE_GPS_EN 12     //M2.46
#define SIO_LTE_FAST_SHUTD 14 //M2.50

#define SIO_LTE_UART_IO_CONTROLLER "GPIO_0"
#define SIO_LTE_CTS 15
#define SIO_LTE_RTS 13

#define LTE_UART_DEV "UART_1"
#define LTE_UART_RX_READ_SIZE 64                    // size in bytes
#define LTE_UART_RX_PIPE_SIZE 1024                  // size in bytes
#define LTE_UART_RX_TIMEOUT 25                      // time in ms
#define LTE_BOOT_TIME 10                            // time in seconds
#define LTE_DEFAULT_RESPONSE_WAIT_TIME K_MSEC(7000) // time in ms

enum LteProcessCmdStates
{
    CMD_STATE_FIND_MSG_START_1,
    CMD_STATE_FIND_MSG_START_2,
    CMD_STATE_GET_REST,
    CMD_STATE_GET_OK,
    CMD_STATE_GET_ERROR,
    CMD_STATE_GET_EXT_ERROR
};

void toggleLteReset();
void toggleLteWake();
void sendLteCmd(char *cmd);
void waitForLteCmdResponse();

#endif
```

## src/app_bt.c
```c
#include <bluetooth/bluetooth.h>
#include <bluetooth/hci.h>
#include <bluetooth/conn.h>
#include <bluetooth/uuid.h>
#include <bluetooth/gatt.h>

#include <gatt/hrs.h>
#include <gatt/bas.h>
#include <gatt/cts.h>

#include <settings/settings.h>

#include <gpio.h>

#include "app_bt.h"

/* ********** DEFINES ********** */
#define DEVICE_NAME CONFIG_BT_DEVICE_NAME
#define DEVICE_NAME_LEN (sizeof(DEVICE_NAME) - 1)
#define MAX_DATA 74

#ifdef SW1_GPIO_INT_CONF
#define EDGE SW1_GPIO_INT_CONF
#else
/*
 * If SW0_GPIO_INT_CONF not defined used default EDGE value.
 * Change this to use a different interrupt trigger
 */
#define EDGE (GPIO_INT_EDGE | GPIO_INT_ACTIVE_LOW)
#endif

/* ********** FUNCTION DEFINITIONS ********** */
static ssize_t read_vnd(struct bt_conn *conn, const struct bt_gatt_attr *attr,
                        void *buf, u16_t len, u16_t offset);
static ssize_t write_vnd(struct bt_conn *conn, const struct bt_gatt_attr *attr,
                         const void *buf, u16_t len, u16_t offset,
                         u8_t flags);
static void vnd_ccc_cfg_changed(const struct bt_gatt_attr *attr, u16_t value);
static void indicate_cb(struct bt_conn *conn, const struct bt_gatt_attr *attr,
                        u8_t err);
static ssize_t read_long_vnd(struct bt_conn *conn,
                             const struct bt_gatt_attr *attr, void *buf,
                             u16_t len, u16_t offset);
static ssize_t write_long_vnd(struct bt_conn *conn,
                              const struct bt_gatt_attr *attr, const void *buf,
                              u16_t len, u16_t offset, u8_t flags);
static ssize_t read_signed(struct bt_conn *conn, const struct bt_gatt_attr *attr,
                           void *buf, u16_t len, u16_t offset);
static ssize_t write_signed(struct bt_conn *conn, const struct bt_gatt_attr *attr,
                            const void *buf, u16_t len, u16_t offset,
                            u8_t flags);
static void connected(struct bt_conn *conn, u8_t err);
static void disconnected(struct bt_conn *conn, u8_t reason);
static void bt_ready(int err);
static void auth_passkey_display(struct bt_conn *conn, unsigned int passkey);
static void auth_cancel(struct bt_conn *conn);
static void advertButtonInit();
void advertButtonPressed(struct device *gpiob, struct gpio_callback *cb,
                         u32_t pins);
static void advertLedInit();
static void flashAdvertLed();

/* Custom Service Variables */
static struct bt_uuid_128 vnd_uuid = BT_UUID_INIT_128(
    0xf0, 0xde, 0xbc, 0x9a, 0x78, 0x56, 0x34, 0x12,
    0x78, 0x56, 0x34, 0x12, 0x78, 0x56, 0x34, 0x12);

static struct bt_uuid_128 vnd_enc_uuid = BT_UUID_INIT_128(
    0xf1, 0xde, 0xbc, 0x9a, 0x78, 0x56, 0x34, 0x12,
    0x78, 0x56, 0x34, 0x12, 0x78, 0x56, 0x34, 0x12);

static struct bt_uuid_128 vnd_auth_uuid = BT_UUID_INIT_128(
    0xf2, 0xde, 0xbc, 0x9a, 0x78, 0x56, 0x34, 0x12,
    0x78, 0x56, 0x34, 0x12, 0x78, 0x56, 0x34, 0x12);

static u8_t vnd_value[] = {'V', 'e', 'n', 'd', 'o', 'r'};
static struct bt_gatt_ccc_cfg vnd_ccc_cfg[BT_GATT_CCC_MAX] = {};
static u8_t simulate_vnd;
static u8_t indicating;
static struct bt_gatt_indicate_params ind_params;
static int signed_value;

static u8_t vnd_long_value[] = {
    'V', 'e', 'n', 'd', 'o', 'r', ' ', 'd', 'a', 't', 'a', '1',
    'V', 'e', 'n', 'd', 'o', 'r', ' ', 'd', 'a', 't', 'a', '2',
    'V', 'e', 'n', 'd', 'o', 'r', ' ', 'd', 'a', 't', 'a', '3',
    'V', 'e', 'n', 'd', 'o', 'r', ' ', 'd', 'a', 't', 'a', '4',
    'V', 'e', 'n', 'd', 'o', 'r', ' ', 'd', 'a', 't', 'a', '5',
    'V', 'e', 'n', 'd', 'o', 'r', ' ', 'd', 'a', 't', 'a', '6',
    '.', ' '};

static const struct bt_uuid_128 vnd_long_uuid = BT_UUID_INIT_128(
    0xf3, 0xde, 0xbc, 0x9a, 0x78, 0x56, 0x34, 0x12,
    0x78, 0x56, 0x34, 0x12, 0x78, 0x56, 0x34, 0x12);

static struct bt_gatt_cep vnd_long_cep = {
    .properties = BT_GATT_CEP_RELIABLE_WRITE,
};

static const struct bt_uuid_128 vnd_signed_uuid = BT_UUID_INIT_128(
    0xf3, 0xde, 0xbc, 0x9a, 0x78, 0x56, 0x34, 0x13,
    0x78, 0x56, 0x34, 0x12, 0x78, 0x56, 0x34, 0x13);

/* Vendor Primary Service Declaration */
static struct bt_gatt_attr vnd_attrs[] = {
    /* Vendor Primary Service Declaration */
    BT_GATT_PRIMARY_SERVICE(&vnd_uuid),
    BT_GATT_CHARACTERISTIC(&vnd_enc_uuid.uuid,
                           BT_GATT_CHRC_READ | BT_GATT_CHRC_WRITE |
                               BT_GATT_CHRC_INDICATE,
                           BT_GATT_PERM_READ_ENCRYPT |
                               BT_GATT_PERM_WRITE_ENCRYPT,
                           read_vnd, write_vnd, vnd_value),
    BT_GATT_CCC(vnd_ccc_cfg, vnd_ccc_cfg_changed),
    BT_GATT_CHARACTERISTIC(&vnd_auth_uuid.uuid,
                           BT_GATT_CHRC_READ | BT_GATT_CHRC_WRITE,
                           BT_GATT_PERM_READ_AUTHEN |
                               BT_GATT_PERM_WRITE_AUTHEN,
                           read_vnd, write_vnd, vnd_value),
    BT_GATT_CHARACTERISTIC(&vnd_long_uuid.uuid, BT_GATT_CHRC_READ | BT_GATT_CHRC_WRITE | BT_GATT_CHRC_EXT_PROP,
                           BT_GATT_PERM_READ | BT_GATT_PERM_WRITE |
                               BT_GATT_PERM_PREPARE_WRITE,
                           read_long_vnd, write_long_vnd, &vnd_long_value),
    BT_GATT_CEP(&vnd_long_cep),
    BT_GATT_CHARACTERISTIC(&vnd_signed_uuid.uuid, BT_GATT_CHRC_READ | BT_GATT_CHRC_WRITE | BT_GATT_CHRC_AUTH,
                           BT_GATT_PERM_READ | BT_GATT_PERM_WRITE,
                           read_signed, write_signed, &signed_value),
};

static struct bt_gatt_service vnd_svc = BT_GATT_SERVICE(vnd_attrs);

static const struct bt_data ad[] = {
    BT_DATA_BYTES(BT_DATA_FLAGS, (BT_LE_AD_GENERAL | BT_LE_AD_NO_BREDR)),
    BT_DATA_BYTES(BT_DATA_UUID16_ALL,
                  0x0d, 0x18, 0x0f, 0x18, 0x05, 0x18),
    BT_DATA_BYTES(BT_DATA_UUID128_ALL,
                  0xf0, 0xde, 0xbc, 0x9a, 0x78, 0x56, 0x34, 0x12,
                  0x78, 0x56, 0x34, 0x12, 0x78, 0x56, 0x34, 0x12),
};

static const struct bt_data sd[] = {
    BT_DATA(BT_DATA_NAME_COMPLETE, DEVICE_NAME, DEVICE_NAME_LEN),
};

static struct bt_conn_cb conn_callbacks = {
    .connected = connected,
    .disconnected = disconnected,
};

static struct bt_conn_auth_cb auth_cb_display = {
    .passkey_display = auth_passkey_display,
    .passkey_entry = NULL,
    .cancel = auth_cancel,
};

static struct device *advertButton_dev;
static struct device *advertLed_dev;
static struct gpio_callback gpio_cb;
static bool bAdvertising = 0;
static bool bConnected = 0;
static bool bSignalAdvertising = 0;

/* ********** FUNCTIONS ********** */
static ssize_t read_vnd(struct bt_conn *conn, const struct bt_gatt_attr *attr,
                        void *buf, u16_t len, u16_t offset)
{
    const char *value = attr->user_data;

    return bt_gatt_attr_read(conn, attr, buf, len, offset, value,
                             strlen(value));
}

static ssize_t write_vnd(struct bt_conn *conn, const struct bt_gatt_attr *attr,
                         const void *buf, u16_t len, u16_t offset,
                         u8_t flags)
{
    u8_t *value = attr->user_data;

    if (offset + len > sizeof(vnd_value))
    {
        return BT_GATT_ERR(BT_ATT_ERR_INVALID_OFFSET);
    }

    memcpy(value + offset, buf, len);

    return len;
}

static void vnd_ccc_cfg_changed(const struct bt_gatt_attr *attr, u16_t value)
{
    simulate_vnd = (value == BT_GATT_CCC_INDICATE) ? 1 : 0;
}

static void indicate_cb(struct bt_conn *conn, const struct bt_gatt_attr *attr,
                        u8_t err)
{
    printk("Indication %s\n", err != 0 ? "fail" : "success");
    indicating = 0;
}

static ssize_t read_long_vnd(struct bt_conn *conn,
                             const struct bt_gatt_attr *attr, void *buf,
                             u16_t len, u16_t offset)
{
    const char *value = attr->user_data;

    return bt_gatt_attr_read(conn, attr, buf, len, offset, value,
                             sizeof(vnd_long_value));
}

static ssize_t write_long_vnd(struct bt_conn *conn,
                              const struct bt_gatt_attr *attr, const void *buf,
                              u16_t len, u16_t offset, u8_t flags)
{
    u8_t *value = attr->user_data;

    if (flags & BT_GATT_WRITE_FLAG_PREPARE)
    {
        return 0;
    }

    if (offset + len > sizeof(vnd_long_value))
    {
        return BT_GATT_ERR(BT_ATT_ERR_INVALID_OFFSET);
    }

    memcpy(value + offset, buf, len);

    return len;
}

static ssize_t read_signed(struct bt_conn *conn, const struct bt_gatt_attr *attr,
                           void *buf, u16_t len, u16_t offset)
{
    const char *value = attr->user_data;

    return bt_gatt_attr_read(conn, attr, buf, len, offset, value,
                             sizeof(signed_value));
}

static ssize_t write_signed(struct bt_conn *conn, const struct bt_gatt_attr *attr,
                            const void *buf, u16_t len, u16_t offset,
                            u8_t flags)
{
    u8_t *value = attr->user_data;

    if (offset + len > sizeof(signed_value))
    {
        return BT_GATT_ERR(BT_ATT_ERR_INVALID_OFFSET);
    }

    memcpy(value + offset, buf, len);

    return len;
}

static void connected(struct bt_conn *conn, u8_t err)
{
    if (err)
    {
        bConnected = 0;
        printk("Connection failed (err %u)\n", err);
    }
    else
    {
        bConnected = 1;
        bAdvertising = 0;
        printk("Connected\n");
    }
}

static void disconnected(struct bt_conn *conn, u8_t reason)
{
    bConnected = 0;
    bAdvertising = 1;
    printk("Disconnected (reason %u)\n", reason);
}

static void bt_ready(int err)
{
    if (err)
    {
        printk("Bluetooth init failed (err %d)\n", err);
        return;
    }

    printk("Bluetooth initialized\n");

    hrs_init(0x01);
    bas_init();
    cts_init();
    bt_gatt_service_register(&vnd_svc);

    if (IS_ENABLED(CONFIG_SETTINGS))
    {
        settings_load();
    }
}

static void startAdvertising()
{
    int err = bt_le_adv_start(BT_LE_ADV_CONN, ad, ARRAY_SIZE(ad),
                              sd, ARRAY_SIZE(sd));
    if (err)
    {
        bAdvertising = 0;
        printk("Advertising failed to start (err %d)\n", err);
        return;
    }

    bAdvertising = 1;
    printk("Advertising successfully started\n");
}

static void stopAdvertising()
{
    int err = bt_le_adv_stop();
    if (err)
    {
        printk("Advertising failed to stop (err %d)\n", err);
        return;
    }

    bAdvertising = 0;
    printk("Advertising stopped\n");
}

static void auth_passkey_display(struct bt_conn *conn, unsigned int passkey)
{
    char addr[BT_ADDR_LE_STR_LEN];

    bt_addr_le_to_str(bt_conn_get_dst(conn), addr, sizeof(addr));

    printk("Passkey for %s: %06u\n", addr, passkey);
}

static void auth_cancel(struct bt_conn *conn)
{
    char addr[BT_ADDR_LE_STR_LEN];

    bt_addr_le_to_str(bt_conn_get_dst(conn), addr, sizeof(addr));

    printk("Pairing cancelled: %s\n", addr);
}

static void advertButtonInit()
{
    int ret;

    advertButton_dev = device_get_binding(ADVERT_BUTTON_PORT);
    if (!advertButton_dev)
    {
        printk("Cannot find %s!\n", ADVERT_BUTTON_PORT);
        return;
    }

    ret = gpio_pin_configure(advertButton_dev, ADVERT_BUTTON,
                             GPIO_DIR_IN | GPIO_INT | GPIO_PUD_PULL_UP | EDGE);
    if (ret)
    {
        printk("Error configuring GPIO %d!\n", ADVERT_BUTTON);
    }

    gpio_init_callback(&gpio_cb, advertButtonPressed, BIT(ADVERT_BUTTON));
    ret = gpio_add_callback(advertButton_dev, &gpio_cb);
    if (ret)
    {
        printk("Error adding GPIO %d callback!\n", ADVERT_BUTTON);
    }

    ret = gpio_pin_enable_callback(advertButton_dev, ADVERT_BUTTON);
    if (ret)
    {
        printk("Error enabling GPIO %d callback!\n", ADVERT_BUTTON);
    }
}

void advertButtonPressed(struct device *gpiob, struct gpio_callback *cb,
                         u32_t pins)
{
    // Set flag to BT app thread can start advertising
    bSignalAdvertising = 1;
}

static void advertLedInit()
{
    int ret;

    advertLed_dev = device_get_binding(ADVERT_LED_PORT);
    if (!advertLed_dev)
    {
        printk("Cannot find %s!\n", ADVERT_LED_PORT);
        return;
    }

    ret = gpio_pin_configure(advertLed_dev, ADVERT_LED, (GPIO_DIR_OUT));
    if (ret)
    {
        printk("Error configuring GPIO %d!\n", ADVERT_LED);
    }

    ret = gpio_pin_write(advertLed_dev, ADVERT_LED, LED_OFF);
    if (ret)
    {
        printk("Error setting GPIO %d!\n", ADVERT_LED);
    }
}

static void flashAdvertLed()
{
    int ret;
    ret = gpio_pin_write(advertLed_dev, ADVERT_LED, LED_ON);
    if (ret)
    {
        printk("Error setting GPIO %d!\n", ADVERT_LED);
    }
    k_sleep(25);
    ret = gpio_pin_write(advertLed_dev, ADVERT_LED, LED_OFF);
    if (ret)
    {
        printk("Error setting GPIO %d!\n", ADVERT_LED);
    }
}

void app_bt_thread()
{
    int err;

    err = bt_enable(bt_ready);
    if (err)
    {
        printk("Bluetooth init failed (err %d)\n", err);
        return;
    }

    bt_conn_cb_register(&conn_callbacks);
    bt_conn_auth_cb_register(&auth_cb_display);

    advertLedInit();
    advertButtonInit();

    while (1)
    {
        k_sleep(MSEC_PER_SEC);

        if (bSignalAdvertising)
        {
            bSignalAdvertising = 0;
            if (!bAdvertising && !bConnected)
            {
                startAdvertising();
            }
            else if (bAdvertising)
            {
                stopAdvertising();
            }
        }

        if (bAdvertising)
        {
            flashAdvertLed();
        }

        /* Current Time Service updates only when time is changed */
        cts_notify();

        /* Heartrate measurements simulation */
        hrs_notify();

        /* Battery level simulation */
        bas_notify();

        /* Vendor indication simulation */
        if (simulate_vnd)
        {
            if (indicating)
            {
                continue;
            }

            ind_params.attr = &vnd_attrs[2];
            ind_params.func = indicate_cb;
            ind_params.data = &indicating;
            ind_params.len = sizeof(indicating);

            if (bt_gatt_indicate(NULL, &ind_params) == 0)
            {
                indicating = 1;
            }
        }
    }
}

// BT thread is currently disabled. Uncomment below to add BT thread.
// K_THREAD_DEFINE(app_bt_id, 512, app_bt_thread, NULL, NULL, NULL,
//                 7, 0, K_NO_WAIT);
```

## src/app_led.c
```c
/*
 * Copyright (c) 2020 Laird Connectivity
 *
 * SPDX-License-Identifier: Apache-2.0
 */

#include <logging/log.h>
#define LOG_LEVEL LOG_LEVEL_INF
LOG_MODULE_REGISTER(app_led);

#include <drivers/gpio.h>

#include "app_led.h"

#define LED_LOG_ERR(...) LOG_ERR(__VA_ARGS__)

static struct device *led1_dev;
static struct device *led2_dev;
static struct device *led3_dev;
static struct device *led4_dev;

void led_init(void)
{
	int ret;

	led1_dev = device_get_binding(LED1_DEV);
	if (!led1_dev) {
		LED_LOG_ERR("Cannot find %s!", STRINGIFY(LED1_DEV));
		return;
	}
	led2_dev = device_get_binding(LED2_DEV);
	if (!led2_dev) {
		LED_LOG_ERR("Cannot find %s!", STRINGIFY(LED2_DEV));
		return;
	}
	led3_dev = device_get_binding(LED3_DEV);
	if (!led3_dev) {
		LED_LOG_ERR("Cannot find %s!", STRINGIFY(LED3_DEV));
		return;
	}
	led4_dev = device_get_binding(LED4_DEV);
	if (!led4_dev) {
		LED_LOG_ERR("Cannot find %s!", STRINGIFY(LED4_DEV));
		return;
	}

	/* LED1 */
	ret = gpio_pin_configure(led1_dev, LED1, GPIO_OUTPUT);
	if (ret) {
		LED_LOG_ERR("Error configuring GPIO %s!", STRINGIFY(LED1));
	}
	ret = gpio_pin_set(led1_dev, LED1, LED_OFF);
	if (ret) {
		LED_LOG_ERR("Error setting GPIO %s!", STRINGIFY(LED1));
	}

	/* LED2 */
	ret = gpio_pin_configure(led2_dev, LED2, GPIO_OUTPUT);
	if (ret) {
		LED_LOG_ERR("Error configuring GPIO %s!", STRINGIFY(LED2));
	}
	ret = gpio_pin_set(led2_dev, LED2, LED_OFF);
	if (ret) {
		LED_LOG_ERR("Error setting GPIO %s!", STRINGIFY(LED2));
	}

	/* LED3 */
	ret = gpio_pin_configure(led3_dev, LED3, GPIO_OUTPUT);
	if (ret) {
		LED_LOG_ERR("Error configuring GPIO %s!", STRINGIFY(LED3));
	}
	ret = gpio_pin_set(led3_dev, LED3, LED_OFF);
	if (ret) {
		LED_LOG_ERR("Error setting GPIO %s!", STRINGIFY(LED3));
	}

	/* LED4 */
	ret = gpio_pin_configure(led4_dev, LED4, GPIO_OUTPUT);
	if (ret) {
		LED_LOG_ERR("Error configuring GPIO %s!", STRINGIFY(LED4));
	}
	ret = gpio_pin_set(led4_dev, LED4, LED_OFF);
	if (ret) {
		LED_LOG_ERR("Error setting GPIO %s!", STRINGIFY(LED4));
	}
}

void ledHeartBeat(void)
{
	int ret;
	/* flash LED twice quickly */
	for (uint8_t i = 0; i < 2; i++) {
		ret = gpio_pin_set(led2_dev, HEARTBEAT_LED, LED_ON);
		if (ret) {
			LED_LOG_ERR("Error setting GPIO %s!",
				    STRINGIFY(HEARTBEAT_LED));
		}
		k_sleep(HEARTBEAT_ON_TIME);
		ret = gpio_pin_set(led2_dev, HEARTBEAT_LED, LED_OFF);
		if (ret) {
			LED_LOG_ERR("Error setting GPIO %s!",
				    STRINGIFY(HEARTBEAT_LED));
		}
		k_sleep(HEARTBEAT_OFF_TIME);
	}
}
```

## src/console_rx.c
```c
#include <string.h>
#include <zephyr.h>
#include <misc/printk.h>
#include <misc/reboot.h>
#include <console.h>

#include "console_rx.h"
#include "hl7800.h"

static void process_cmd(char *cmdStr);
static void parse_cmd(char *cmdStr);
static void console_rx_thread();

static void process_cmd(char *cmdStr)
{
    int len = strlen(cmdStr);
    if (len == 0)
    {
        printk(CMD_RESP_OK);
    }
    else
    {
        parse_cmd(cmdStr);
    }
}

static void parse_cmd(char *cmdStr)
{
    int len = strlen(cmdStr);
    if (len == 1)
    {
        switch (cmdStr[0])
        {
        case CMD_R:
            toggleLteReset();
            break;
        case CMD_W:
            toggleLteWake();
            break;
        case CMD_B:
            sys_reboot(GPREGRET_ENTER_BOOTLOADER);
            break;
        default:
            printk("Unknown cmd \"%s\"\n#", cmdStr);
            break;
        }
    }
    else
    {
        if (cmdStr[0] == 'a' && cmdStr[1] == 't')
        {
            char sendCmd[len + 1];
            memset(sendCmd, 0, sizeof(sendCmd));
            // copy bytes
            strncpy(sendCmd, cmdStr, len);
            // add cmd ending
            strcat(sendCmd, "\r");
            sendLteCmd(sendCmd);
        }
        else
        {
            printk("Unknown cmd \"%s\"\n#", cmdStr);
        }
    }
}

static void console_rx_thread()
{
    console_getline_init();

    while (1)
    {
        char *s = console_getline();
        process_cmd(s);
    }
}

K_THREAD_DEFINE(console_rx, 512, console_rx_thread, NULL, NULL, NULL,
                7, 0, K_NO_WAIT);
```

## src/console_rx.h
```c
#ifndef CONSOLE_RX_H
#define CONSOLE_RX_H

#define MAX_CMD_SIZE    256

#define CMD_R           'r'
#define CMD_W           'w'
#define CMD_S           's'

#define CMD_RESP_OK          "\n#"

#endif
```

## src/cts.c
```c
/* Workaround build system bug that will put objects in source dir */
#include "../../zephyr/samples/bluetooth/gatt/cts.c"
```

## src/dis.c
```c
/* Workaround build system bug that will put objects in source dir */
#include "../../zephyr/samples/bluetooth/gatt/dis.c"
```

## src/hl7800.c
```c
#include <zephyr.h>
#include <misc/printk.h>
#include <string.h>
#include <gpio.h>
#include <uart.h>

#include "hl7800.h"

static struct device *gpio0_dev;
static struct device *gpio1_dev;
static struct device *lte_uart_dev;

static int lteResetState = 0;
static int lteWakeState = 0;
static u8_t lte_uart_rx_buf[LTE_UART_RX_READ_SIZE];
static u8_t lte_rx_msg_buf[LTE_UART_RX_PIPE_SIZE];
static char lte_temp_msg[LTE_UART_RX_PIPE_SIZE];
static int lte_tmp_msg_index = 0;
static int parseCmdState = CMD_STATE_FIND_MSG_START_1;
static bool lteBooted = false;
static int lteBytesRxd = 0;
static int lteBytesProc = 0;

K_PIPE_DEFINE(lte_rx_pipe, LTE_UART_RX_PIPE_SIZE, 1);
K_SEM_DEFINE(lte_rx_sem, 0, 1);
K_SEM_DEFINE(lte_boot_sem, 0, 1);
K_SEM_DEFINE(lte_event_sem, 0, 1);
K_SEM_DEFINE(lte_rx_cmd_sem, 0, 1);

static void initIO();
static void lteUartInit();
static void lte_uart_isr(struct device *dev);
void toggleLteReset();
void toggleLteWake();
static void process_lte_rx();
static void parse_lte_cmd(u8_t *msg, int size);
static int addToLteTempMsg(char *bytes, int length);
static void start_lte_rx_timer();
static void stop_lte_rx_timer();
static void start_lte_boot_timer();
static void stop_lte_boot_timer();
static void lte_rx_timer_handler(struct k_timer *timer_id);
static void lte_boot_timer_handler(struct k_timer *timer_id);
void sendLteCmd(char *cmd);
void waitForLteCmdResponse(s32_t timeout);
static void queryLteInfo();
static void setLteUartRts(bool high);
static void hl7800_thread();
static void hl7800_rx_thread();

K_TIMER_DEFINE(lte_rx_timer, lte_rx_timer_handler, NULL);
K_TIMER_DEFINE(lte_boot_timer, lte_boot_timer_handler, NULL);

K_THREAD_DEFINE(hl7800rx, 512, hl7800_rx_thread, NULL, NULL, NULL,
                6, 0, K_NO_WAIT);

K_THREAD_DEFINE(hl7800, 512, hl7800_thread, NULL, NULL, NULL,
                7, 0, K_NO_WAIT);

// init the control IO for the HL7800
static void initIO()
{
    int ret;
    int pinState;

    // Open the GPIO1 device
    gpio1_dev = device_get_binding(SIO_LTE_IO_CONTROLLER);
    if (!gpio1_dev)
    {
        printk("Cannot find %s!\n", SIO_LTE_IO_CONTROLLER);
        return;
    }

    // Open the GPIO0 device
    gpio0_dev = device_get_binding(SIO_LTE_UART_IO_CONTROLLER);
    if (!gpio0_dev)
    {
        printk("Cannot find %s!\n", SIO_LTE_UART_IO_CONTROLLER);
        return;
    }

    // LTE reset
    ret = gpio_pin_configure(gpio1_dev, SIO_LTE_RESET, (GPIO_DIR_OUT | GPIO_DS_DISCONNECT_HIGH));
    if (ret)
    {
        printk("Error configuring GPIO %d!\n", ret);
    }
    lteResetState = 1;
    ret = gpio_pin_write(gpio1_dev, SIO_LTE_RESET, lteResetState);
    if (ret)
    {
        printk("Error setting GPIO %d!\n", ret);
    }
    toggleLteReset();
    k_sleep(50);
    toggleLteReset();

    // LTE wake
    ret = gpio_pin_configure(gpio1_dev, SIO_LTE_WAKE, (GPIO_DIR_OUT | GPIO_DS_DISCONNECT_LOW));
    if (ret)
    {
        printk("Error configuring GPIO %d!\n", ret);
    }
    lteWakeState = 1;
    ret = gpio_pin_write(gpio1_dev, SIO_LTE_WAKE, lteWakeState);
    if (ret)
    {
        printk("Error setting GPIO %d!\n", ret);
    }
    else
    {
        printk("SIO_LTE_WAKE set to %d\n", lteWakeState);
    }
    // ret = gpio_pin_configure(gpio1_dev, SIO_LTE_WAKE, GPIO_DIR_IN);
    // if (ret)
    // {
    //     printk("Error configuring GPIO %d!\n", ret);
    // }
    // else
    // {
    //     printk("SIO_LTE_WAKE config as input\n");
    // }

    // LTE pwr on
    ret = gpio_pin_configure(gpio1_dev, SIO_LTE_POWER_ON, (GPIO_DIR_OUT | GPIO_DS_DISCONNECT_HIGH));
    if (ret)
    {
        printk("Error configuring GPIO %d!\n", ret);
    }
    pinState = 1;
    ret = gpio_pin_write(gpio1_dev, SIO_LTE_POWER_ON, pinState);
    if (ret)
    {
        printk("Error setting GPIO %d!\n", ret);
    }
    else
    {
        printk("SIO_LTE_POWER_ON set to %d\n", pinState);
    }
    // ret = gpio_pin_configure(gpio1_dev, SIO_LTE_POWER_ON, GPIO_DIR_IN);
    // if (ret)
    // {
    //     printk("Error configuring GPIO %d!\n", ret);
    // }
    // else
    // {
    //     printk("SIO_LTE_POWER_ON config as input\n");
    // }

    // LTE fast shutdown
    ret = gpio_pin_configure(gpio1_dev, SIO_LTE_FAST_SHUTD, (GPIO_DIR_OUT | GPIO_DS_DISCONNECT_HIGH));
    if (ret)
    {
        printk("Error configuring GPIO %d!\n", ret);
    }
    pinState = 1;
    ret = gpio_pin_write(gpio1_dev, SIO_LTE_FAST_SHUTD, pinState);
    if (ret)
    {
        printk("Error setting GPIO %d!\n", ret);
    }
    else
    {
        printk("SIO_LTE_FAST_SHUTD set to %d\n", pinState);
    }
    // ret = gpio_pin_configure(gpio1_dev, SIO_LTE_FAST_SHUTD, GPIO_DIR_IN);
    // if (ret)
    // {
    //     printk("Error configuring GPIO %d!\n", ret);
    // }
    // else
    // {
    //     printk("SIO_LTE_FAST_SHUTD config as input\n");
    // }

    // LTE gps enable
    ret = gpio_pin_configure(gpio1_dev, SIO_LTE_GPS_EN, GPIO_DIR_IN);
    if (ret)
    {
        printk("Error configuring GPIO %d!\n", ret);
    }
    else
    {
        printk("SIO_LTE_GPS_EN config as input\n");
    }

    // LTE TX on
    ret = gpio_pin_configure(gpio1_dev, SIO_LTE_TX_ON, GPIO_DIR_IN);
    if (ret)
    {
        printk("Error configuring GPIO %d!\n", ret);
    }
    else
    {
        printk("SIO_LTE_TX_ON config as input\n");
    }

    // LTE UART CTS
    ret = gpio_pin_configure(gpio0_dev, SIO_LTE_CTS, GPIO_DIR_IN);
    if (ret)
    {
        printk("Error configuring GPIO %d!\n", ret);
    }
    else
    {
        printk("SIO_LTE_CTS config as input\n");
    }

    // LTE UART RTS
    ret = gpio_pin_configure(gpio0_dev, SIO_LTE_RTS, GPIO_DIR_OUT);
    if (ret)
    {
        printk("Error configuring GPIO %d!\n", ret);
    }
    pinState = 0;
    ret = gpio_pin_write(gpio0_dev, SIO_LTE_RTS, pinState);
    if (ret)
    {
        printk("Error setting GPIO %d!\n", ret);
    }
    else
    {
        printk("SIO_LTE_RTS set to %d\n", pinState);
    }
}

static void lteUartInit()
{
    lte_uart_dev = device_get_binding(LTE_UART_DEV);
    if (lte_uart_dev == NULL)
    {
        printk("Error opening LTE UART\n");
        return;
    }

    uart_irq_callback_set(lte_uart_dev, lte_uart_isr);
    uart_irq_rx_enable(lte_uart_dev);
}

static void lte_uart_isr(struct device *dev)
{
    int len, ret;
    size_t bytes_written;

    /* Verify uart_irq_update() */
    if (!uart_irq_update(dev))
    {
        printk("retval should always be 1\n");
        return;
    }

    while (uart_irq_update(dev) &&
           uart_irq_rx_ready(dev))
    {
        len = uart_fifo_read(lte_uart_dev, lte_uart_rx_buf, sizeof(lte_uart_rx_buf));

        if (len > 0)
        {
            lteBytesRxd += len;
            ret = k_pipe_put(&lte_rx_pipe,
                             lte_uart_rx_buf,
                             len, &bytes_written,
                             len, K_NO_WAIT);
            if (ret < 0)
            {
                printk("UART pip write error %d\n", ret);
            }
            else
            {
                k_sem_give(&lte_rx_sem);
            }
        }
    }
}

void toggleLteReset()
{
    int ret;

    if (lteResetState)
    {
        // set it low
        ret = gpio_pin_write(gpio1_dev, SIO_LTE_RESET, 0);
        printk("t:%d LTE reset is low\n", k_uptime_get_32());
        lteResetState = 0;
        lteBooted = false;
        stop_lte_boot_timer();
    }
    else
    {
        // set it high
        ret = gpio_pin_write(gpio1_dev, SIO_LTE_RESET, 1);
        printk("t:%d LTE reset is high\n", k_uptime_get_32());
        lteResetState = 1;
        start_lte_boot_timer();
    }
}

void toggleLteWake()
{
    int ret;

    if (lteWakeState)
    {
        // set it low
        ret = gpio_pin_write(gpio1_dev, SIO_LTE_WAKE, 0);
        printk("t:%d LTE wake is low\n", k_uptime_get_32());
        lteWakeState = 0;
    }
    else
    {
        // set it high
        ret = gpio_pin_write(gpio1_dev, SIO_LTE_WAKE, 1);
        printk("t:%d LTE wake is high\n", k_uptime_get_32());
        lteWakeState = 1;
    }
}

static void process_lte_rx()
{
    int rc;
    size_t bytesRead;
    rc = k_sem_take(&lte_rx_sem, K_FOREVER);
    do
    {
        rc = k_pipe_get(&lte_rx_pipe,
                        lte_rx_msg_buf,
                        sizeof(lte_rx_msg_buf),
                        &bytesRead, 1, 1);
        if (rc >= 0)
        {
            parse_lte_cmd(lte_rx_msg_buf, bytesRead);
        }
    } while (rc >= 0);
}

// TODO: evaluate how to frame RX messages properly. Commented out code for framing RX messages.
static void parse_lte_cmd(u8_t *msg, int size)
{
    int index = 0;
    int cpySize = 0;
    lteBytesProc += size;
    do
    {
        switch (parseCmdState)
        {
        case CMD_STATE_FIND_MSG_START_1:
            printk("t:%d LTE msg:\n", k_uptime_get_32());
            lte_tmp_msg_index = 0;
            parseCmdState = CMD_STATE_GET_REST;
            break;
        case CMD_STATE_GET_REST:
            // Continue receiving message
            stop_lte_rx_timer();
            cpySize = size - index;
            int bytesAdded = addToLteTempMsg(&msg[index], cpySize);
            index += bytesAdded;
            if (bytesAdded != cpySize)
            {
                // could not add everything because buffer is full
                // print what we have and start over
                setLteUartRts(true); // Disable LTE UART RX (software flow control)
                printk("%s", lte_temp_msg);
                // "clear" the buffer by starting at index 0
                lte_tmp_msg_index = 0;
                setLteUartRts(false); // Allow LTE UART RX again
            }
            else
            {
                start_lte_rx_timer();
            }
            break;
        };
    } while (index < size);
}

static int addToLteTempMsg(char *bytes, int length)
{
    int bytesAdded = 0;
    int end = lte_tmp_msg_index + length;
    int bufferSize = sizeof(lte_temp_msg);

    if (lte_tmp_msg_index >= bufferSize)
    {
        return bytesAdded;
    }

    if (end > bufferSize - 1)
    {
        int bytesToAdd = bufferSize - lte_tmp_msg_index - 1; // add one less byte so the string is null terminated
        strncpy(&lte_temp_msg[lte_tmp_msg_index], bytes, bytesToAdd);
        lte_tmp_msg_index += bytesToAdd;
        bytesAdded = bytesToAdd;
    }
    else
    {
        strncpy(&lte_temp_msg[lte_tmp_msg_index], bytes, length);
        lte_tmp_msg_index += length;
        bytesAdded = length;
    }

    return bytesAdded;
}

static void start_lte_rx_timer()
{
    k_timer_start(&lte_rx_timer, K_MSEC(LTE_UART_RX_TIMEOUT), 0);
}

static void stop_lte_rx_timer()
{
    k_timer_stop(&lte_rx_timer);
}

static void start_lte_boot_timer()
{
    k_timer_start(&lte_boot_timer, K_SECONDS(LTE_BOOT_TIME), 0);
}

static void stop_lte_boot_timer()
{
    k_timer_stop(&lte_boot_timer);
}

static void lte_rx_timer_handler(struct k_timer *timer_id)
{
    u8_t nul = 0;
    addToLteTempMsg(&nul, 1);
    if (strlen(lte_temp_msg) > 0)
    {
        printk("%s\nBytes RXd: %d\nBytes proc: %d\n\n", lte_temp_msg, lteBytesRxd, lteBytesProc);
        if (lteBytesRxd != lteBytesProc)
        {
            printk("\n\n!!!Did not process all RX bytes!!!\n\n");
        }
        lteBytesRxd = 0;
        lteBytesProc = 0;
        k_sem_give(&lte_rx_cmd_sem);
    }
    parseCmdState = CMD_STATE_FIND_MSG_START_1;
}

static void lte_boot_timer_handler(struct k_timer *timer_id)
{
    k_sem_give(&lte_boot_sem);
    lteBooted = true;
}

// TODO: use message queue to send commands to the HL7800 so the sending thread is not blocked
void sendLteCmd(char *cmd)
{
    int sendLen = strlen(cmd);
    if (sendLen > 0)
    {
        printk("t:%d Send LTE msg: %s\n\n", k_uptime_get_32(), cmd);
        k_sem_reset(&lte_rx_cmd_sem);
        for (int i = 0; i < sendLen; i++)
        {
            uart_poll_out(lte_uart_dev, cmd[i]);
        }
    }
}

void waitForLteCmdResponse(s32_t timeout)
{
    k_sem_take(&lte_rx_cmd_sem, timeout);
}

static void queryLteInfo()
{
    sendLteCmd("ati9\r");
    waitForLteCmdResponse(K_FOREVER);
    sendLteCmd("at+kgsn=3\r");
    waitForLteCmdResponse(K_FOREVER);
    sendLteCmd("at+cgsn\r");
    waitForLteCmdResponse(K_FOREVER);
    sendLteCmd("at+ksrep?\r");
    waitForLteCmdResponse(K_FOREVER);
    sendLteCmd("at+ksleep?\r");
    waitForLteCmdResponse(K_FOREVER);
    sendLteCmd("at+cpsms?\r");
    waitForLteCmdResponse(K_FOREVER);
    sendLteCmd("at+kbndcfg?\r");
    waitForLteCmdResponse(K_FOREVER);
}

static void setLteUartRts(bool high)
{
    int ret;

    if (high)
    {
        ret = gpio_pin_write(gpio0_dev, SIO_LTE_RTS, 1);
        if (ret)
        {
            printk("Error setting SIO_LTE_RTS high %d!\n", ret);
        }
    }
    else
    {
        ret = gpio_pin_write(gpio0_dev, SIO_LTE_RTS, 0);
        if (ret)
        {
            printk("Error setting SIO_LTE_RTS low %d!\n", ret);
        }
    }
}

static void hl7800_thread()
{
    initIO();
    lteUartInit();
    k_sem_take(&lte_boot_sem, K_FOREVER);
    printk("LTE booted, time:%d\n", k_uptime_get_32());
    queryLteInfo();

    while (1)
    {
        k_sem_take(&lte_event_sem, K_FOREVER);
        printk("LTE event received, do some work.\n");
    }
}

static void hl7800_rx_thread()
{
    while (1)
    {
        process_lte_rx();
    }
}
```

## src/hl7800.h
```c
#ifndef HL7800_H
#define HL7800_H

#define SIO_LTE_IO_CONTROLLER "GPIO_1"
#define SIO_LTE_RESET 15      //M2.71
#define SIO_LTE_WAKE 13       //M2.48
#define SIO_LTE_POWER_ON 2    //M2.67
#define SIO_LTE_TX_ON 3       //M2.44
#define SIO_LTE_GPS_EN 12     //M2.46
#define SIO_LTE_FAST_SHUTD 14 //M2.50

#define LTE_UART_DEV "UART_1"
#define LTE_UART_RX_READ_SIZE 64            // size in bytes
#define LTE_UART_RX_PIPE_SIZE 1024          // size in bytes
#define LTE_UART_RX_TIMEOUT 25              // time in ms
#define LTE_BOOT_TIME 15                    // time in seconds
#define LTE_DEFAULT_RESPONSE_WAIT_TIME 7000 // time in ms

enum LteProcessCmdStates
{
    CMD_STATE_FIND_MSG_START_1,
    CMD_STATE_FIND_MSG_START_2,
    CMD_STATE_GET_REST,
    CMD_STATE_GET_OK,
    CMD_STATE_GET_ERROR,
    CMD_STATE_GET_EXT_ERROR
};

void toggleLteReset();
void toggleLteWake();
void sendLteCmd(char *cmd);
void waitForLteCmdResponse();

#endif
```
